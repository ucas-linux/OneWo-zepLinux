## zephyr/drivers/serial/Kconfig.as32x601
```kconfig
# SPDX-License-Identifier: Apache-2.0

config UART_AS32X601
	bool "Ansilic AS32X601 UART driver"
	default y
	depends on SERIAL
	depends on SOC_SERIES_AS32X601
	select SERIAL_HAS_DRIVER
	select PINCTRL
	help
	  Enable native UART driver for Ansilic AS32X601 USART instances.
```
