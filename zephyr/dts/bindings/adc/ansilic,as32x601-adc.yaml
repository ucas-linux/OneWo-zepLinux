## zephyr/dts/bindings/adc/ansilic,as32x601-adc.yaml
```yaml
# SPDX-License-Identifier: Apache-2.0

description: Ansilic AS32X601 ADC controller

compatible: "ansilic,as32x601-adc"

include: [adc-controller.yaml, base.yaml, pinctrl-device.yaml]

properties:
  reg:
    required: true

  "#io-channel-cells":
    const: 1

io-channel-cells:
  - input
```

## zephyr/dts/bindings/can/ansilic,as32x601-canfd.yaml
```yaml
# SPDX-License-Identifier: Apache-2.0

description: Ansilic AS32X601 CANFD controller

compatible: "ansilic,as32x601-canfd"

include: [can-fd-controller.yaml, pinctrl-device.yaml]

properties:
  reg:
    required: true

  interrupts:
    required: true

  pinctrl-0:
    required: true

  pinctrl-names:
    required: true
```

## zephyr/dts/bindings/ethernet/ansilic,as32x601-eth.yaml
```yaml
# Copyright (c) 2026 Ansilic Technology Co., Ltd.
# SPDX-License-Identifier: Apache-2.0

description: Ansilic AS32X601 Ethernet controller (Core10100 MAC)

compatible: "ansilic,as32x601-eth"

include:
  - name: ethernet-controller.yaml
  - name: pinctrl-device.yaml

properties:
  reg:
    required: true

  interrupts:
    required: true

  local-mac-address:
    required: false
```

## zephyr/dts/bindings/flash_controller/ansilic,as32x601-qspi-nor.yaml
```yaml
# SPDX-License-Identifier: Apache-2.0
description: |
  Ansilic AS32X601 QSPI controller with attached external NOR flash.
  Combined driver: controller + flash chip are one device exposing
  Zephyr's flash_driver_api.

compatible: "ansilic,as32x601-qspi-nor"

include: [flash-controller.yaml, pinctrl-device.yaml]

properties:
  reg:               { required: true }
  reg-names:         { required: true }
  clock-frequency:   { type: int, required: true }
  pinctrl-0:         { required: true }
  pinctrl-names:     { required: true }
  prescaler:         { type: int, required: true }
  cs-high-time:      { type: int, required: true }
  size:              { type: int, required: true }
  sector-size:       { type: int, required: true }
  page-size:         { type: int, required: true }
  write-block-size:  { type: int, required: true }
  erase-block-size:  { type: int, required: true }
  jedec-id:          { type: uint8-array, required: false }
  quad-enable-requirements:
    type: string
    enum: ["S25FL512S", "NONE"]
    default: "NONE"
```

## zephyr/samples/basic/irq_latency_cyclictest_once/sample.yaml
```yaml
sample:
  name: One-shot cyclictest style latency

tests:
  sample.basic.irq_latency_cyclictest_once:
    tags:
      - samples
      - timing
```

## zephyr/samples/basic/irq_latency_isr_100/sample.yaml
```yaml
sample:
  name: Hardware timer ISR latency 100 samples

tests:
  sample.basic.irq_latency_isr_100:
    platform_allow:
      - rocket_pi/stm32f401xe
    integration_platforms:
      - rocket_pi/stm32f401xe
    tags:
      - samples
      - counter
```

## zephyr/samples/basic/pb1_pb2_benchmark/sample.yaml
```yaml
sample:
  name: PB1 PB2 benchmark suite

tests:
  sample.basic.pb1_pb2_benchmark:
    platform_allow:
      - rocket_pi/stm32f401xe
    integration_platforms:
      - rocket_pi/stm32f401xe
    tags:
      - samples
      - gpio
      - irq
      - timing
```

## zephyr/samples/basic/pb1_pb2_extended/sample.yaml
```yaml
sample:
  name: PB1 PB2 extended interconnect test

tests:
  sample.basic.pb1_pb2_extended:
    platform_allow:
      - rocket_pi/stm32f401xe
    integration_platforms:
      - rocket_pi/stm32f401xe
    tags:
      - samples
      - gpio
```

## zephyr/soc/ansilic/Kconfig
```kconfig
# SPDX-License-Identifier: Apache-2.0

config SOC_FAMILY_ANSILIC
	bool
	select RISCV
	select BUILD_OUTPUT_HEX
	imply XIP

if SOC_FAMILY_ANSILIC

config VECTOR_TABLE_SIZE
	int "Number of Interrupt and Exception Vectors"
	range 16 256

rsource "*/Kconfig"

endif # SOC_FAMILY_ANSILIC
```

## zephyr/soc/ansilic/as32x601/Kconfig.defconfig
```kconfig
# SPDX-License-Identifier: Apache-2.0

if SOC_AS32X601

rsource "Kconfig.defconfig.*"

endif # SOC_AS32X601
```

## zephyr/soc/ansilic/as32x601/Kconfig.defconfig.as32x601
```kconfig
# SPDX-License-Identifier: Apache-2.0

if SOC_AS32X601

config INCLUDE_RESET_VECTOR
	default y

config PLIC
	default n

config RISCV_HAS_PLIC
	default y if AS32X601_PLIC

config SYS_CLOCK_EXISTS
	default y

config SYS_CLOCK_HW_CYCLES_PER_SEC
	default 180000000

config VECTOR_TABLE_SIZE
	default 64

config NUM_IRQS
	default 64

config RISCV_SOC_INTERRUPT_INIT
	default y

config MAX_IRQ_PER_AGGREGATOR
	default 64 if AS32X601_PLIC

config 2ND_LVL_ISR_TBL_OFFSET
	default 12 if AS32X601_PLIC

config 2ND_LVL_INTR_00_OFFSET
	default 11 if AS32X601_PLIC

config GEN_IRQ_START_VECTOR
	default 0

config RISCV_SOC_HAS_GP_RELATIVE_ADDRESSING
	default y

config FPU
	default y

config FLOAT_HARD
	default y if FPU

config CPU_HAS_FPU
	default y

config CPU_HAS_FPU_DOUBLE_PRECISION
	default y

config RISCV_ISA_EXT_F
	default y

config RISCV_ISA_EXT_D
	default y

config RISCV_ISA_EXT_C
	default y

config SOC_PREP_HOOK
	default y

config SOC_EARLY_INIT_HOOK
	default y

config SOC_RESET_HOOK
	default y

config ARCH_HAS_CUSTOM_CPU_IDLE
	default y

endif # SOC_AS32X601
```

## zephyr/soc/ansilic/as32x601/Kconfig.soc
```kconfig
# SPDX-License-Identifier: Apache-2.0

config SOC_SERIES_AS32X601
	bool "Ansilic AS32X601 series"
	depends on SOC_FAMILY_ANSILIC

config SOC_SERIES
	default "as32x601" if SOC_SERIES_AS32X601

rsource "Kconfig.soc.*"
```

## zephyr/soc/ansilic/as32x601/Kconfig.soc.as32x601
```kconfig
# SPDX-License-Identifier: Apache-2.0

config SOC_AS32X601
	bool "AS32X601"
	select SOC_SERIES_AS32X601
```

## zephyr/subsys/fs/vfs_core/Kconfig
```kconfig
# Copyright (c) 2024 OneWo-zepLinux Project
# SPDX-License-Identifier: Apache-2.0

config VFS_CORE
	bool "VFS Core Layer"
	help
	  Enable the VFS (Virtual File System) core layer. This provides
	  an inode-based abstraction layer for file systems, inspired by
	  embox's VFS architecture.

if VFS_CORE

config VFS_MAX_DRIVERS
	int "Maximum number of VFS drivers"
	default 8
	help
	  Maximum number of VFS drivers that can be registered.

config RAMFS
	bool "RAMFS - In-Memory File System"
	default y
	help
	  Enable RAMFS, a simple in-memory file system. This is useful
	  for temporary storage and testing.

if RAMFS

config RAMFS_MAX_SIZE
	int "Maximum RAMFS size in bytes"
	default 1048576
	help
	  Maximum size of RAMFS in bytes. Default is 1MB.

endif # RAMFS

endif # VFS_CORE
```

## zephyr/tests/subsys/fs/vfs_ramfs/testcase.yaml
```yaml
tests:
  filesystem.vfs_ramfs:
    tags: filesystem vfs ramfs
    platform_allow:
      - qemu_cortex_m3
      - native_sim
      - as32x601_evb/as32x601
    integration_platforms:
      - qemu_cortex_m3
    harness: console
    harness_config:
      type: multi_line
      ordered: false
      regex:
        - "RAMFS mounted at /ram"
        - "File operations test passed"
        - "Directory operations test passed"
        - "File in directory test passed"
        - "File seek test passed"
        - "File truncate test passed"
        - "File unlink test passed"
        - "Stat operations test passed"
        - "Statvfs test passed"
```
