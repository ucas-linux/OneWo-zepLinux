## CMakeLists.txt
```
# SPDX-License-Identifier: Apache-2.0
cmake_minimum_required(VERSION 3.20.0)
find_package(Zephyr REQUIRED HINTS $ENV{ZEPHYR_BASE})
project(anl_loader_qemu)
target_sources(app PRIVATE src/main.c src/anl_loader.c)
```

## prj.conf
```kconfig
CONFIG_PRINTK=y
CONFIG_HEAP_MEM_POOL_SIZE=16384
CONFIG_MAIN_STACK_SIZE=4096
CONFIG_UART_AS32X601=n

# Process model
CONFIG_PROCESS_MODEL=y
CONFIG_MAX_PROCESS_COUNT=8
CONFIG_MAX_FD_PER_PROCESS=4

# Thread support
CONFIG_NUM_PREEMPT_PRIORITIES=15
CONFIG_DYNAMIC_THREAD=y
CONFIG_THREAD_STACK_INFO=y
CONFIG_THREAD_NAME=y

# Event support for signals
CONFIG_EVENTS=y
```

## src/main.c
```c
#include <zephyr/kernel.h>
#include <zephyr/device.h>
#include <zephyr/drivers/uart.h>
#include <zephyr/kernel/process.h>
#include <string.h>
#include <stdlib.h>
#include "anl_loader.h"
#include "shell_process.h"
#include "signal.h"

static const struct device *uart_dev;

/* Exported symbols available to loaded ANL modules */
static void anl_printk_wrapper(const char *fmt)
{
    printk("%s", fmt);
}

const struct anl_export _anl_exports[] = {
    { "printk",          (uintptr_t)anl_printk_wrapper },
    { "k_msleep",        (uintptr_t)k_msleep },
    { "new_task",        (uintptr_t)new_task },
    { "waitpid",         (uintptr_t)waitpid },
    { "process_current", (uintptr_t)process_current },
};
const int _anl_exports_count = 5;

static uint8_t anl_buf[4096];

static int hex_nibble(char c)
{
    if (c >= '0' && c <= '9') return c - '0';
    if (c >= 'a' && c <= 'f') return c - 'a' + 10;
    if (c >= 'A' && c <= 'F') return c - 'A' + 10;
    return -1;
}

static void uart_putc(char c)
{
    uart_poll_out(uart_dev, c);
}

static void uart_puts(const char *s)
{
    while (*s) {
        if (*s == '\n') uart_putc('\r');
        uart_putc(*s++);
    }
}

static int readline(char *buf, int maxlen)
{
    int i = 0;
    while (i < maxlen - 1) {
        unsigned char c;
        while (uart_poll_in(uart_dev, &c) != 0)
            k_sleep(K_MSEC(1));

        /* Handle Ctrl+C (0x03) - send SIGINT to foreground process */
        if (c == 0x03) {
            uart_puts("^C\r\n");
            pid_t fg_pgid = signal_get_foreground_pgid();
            if (fg_pgid > 0) {
                printk("[Shell] Sending SIGINT to PID %d\n", fg_pgid);
                kill(fg_pgid, SIGINT);
            }
            buf[i] = '\0';
            return i;
        }

        /* Handle Ctrl+D (0x04) - send SIGTSTP to foreground process */
        if (c == 0x04) {
            uart_puts("^D\r\n");
            pid_t fg_pgid = signal_get_foreground_pgid();
            if (fg_pgid > 0) {
                printk("[Shell] Sending SIGTSTP (suspend) to PID %d\n", fg_pgid);
                kill(fg_pgid, SIGTSTP);
            } else {
                /* No foreground process - EOF behavior */
                buf[i] = '\0';
                return i;
            }
            buf[i] = '\0';
            return i;
        }

        if (c == '\r' || c == '\n') {
            buf[i] = '\0';
            uart_puts("\r\n");
            return i;
        }
        if (c == '\b' || c == 127) {
            if (i > 0) { i--; uart_puts("\b \b"); }
            continue;
        }
        uart_putc(c);
        buf[i++] = c;
    }
    buf[i] = '\0';
    return i;
}

static void cmd_load(char *args)
{
    char *name = args;
    char *hex = strchr(args, ' ');
    if (!hex) { uart_puts("usage: load <name> <hexdata>\n"); return; }
    *hex++ = '\0';

    size_t hexlen = strlen(hex);
    if (hexlen & 1) { uart_puts("error: odd hex length\n"); return; }
    size_t binlen = hexlen / 2;
    if (binlen > sizeof(anl_buf)) { uart_puts("error: too large\n"); return; }

    for (size_t i = 0; i < binlen; i++) {
        int hi = hex_nibble(hex[i*2]);
        int lo = hex_nibble(hex[i*2+1]);
        if (hi < 0 || lo < 0) { uart_puts("error: bad hex\n"); return; }
        anl_buf[i] = (uint8_t)((hi << 4) | lo);
    }

    printk("loaded %zu bytes, running '%s'...\n", binlen, name);
    int ret = anl_load(name, anl_buf, binlen);
    printk("anl_load returned %d\n", ret);
}

/* fork example: child process entry */
struct fork_arg {
    int id;
    int iterations;
};

static void *fork_child_main(void *arg)
{
    struct fork_arg *fa = (struct fork_arg *)arg;
    int id = fa->id;
    int iters = fa->iterations;

    printk("[child %d] started, PID=%d, parent PID=%d\n",
           id,
           process_current()->pid,
           process_current()->parent ? process_current()->parent->pid : 0);

    for (int i = 0; i < iters; i++) {
        printk("[child %d] iteration %d/%d\n", id, i + 1, iters);
        k_msleep(500);
    }

    printk("[child %d] done\n", id);
    return (void *)(intptr_t)id;
}

/* fork <nchildren> [iterations] */
static void cmd_fork(char *args)
{
    int nchildren = 1;
    int iterations = 3;

    if (args && args[0]) {
        nchildren = atoi(args);
        char *sp = strchr(args, ' ');
        if (sp) iterations = atoi(sp + 1);
    }

    if (nchildren < 1 || nchildren > 4) {
        uart_puts("usage: fork <nchildren 1-4> [iterations]\n");
        return;
    }

    printk("[parent] PID=%d, forking %d child(ren), %d iterations each\n",
           process_current()->pid, nchildren, iterations);

    /* Static arg storage — one per possible child */
    static struct fork_arg fork_args[4];
    pid_t pids[4];

    for (int i = 0; i < nchildren; i++) {
        fork_args[i].id = i + 1;
        fork_args[i].iterations = iterations;
        char name[16];
        snprintf(name, sizeof(name), "child_%d", i + 1);
        pids[i] = new_task(name, fork_child_main, &fork_args[i]);
        if (pids[i] < 0) {
            printk("[parent] failed to fork child %d: %d\n", i + 1, pids[i]);
        } else {
            printk("[parent] forked child %d with PID=%d\n", i + 1, pids[i]);
        }
    }

    /* Wait for all children */
    for (int i = 0; i < nchildren; i++) {
        if (pids[i] < 0) continue;
        int status = 0;
        pid_t ret = waitpid(pids[i], &status, 0);
        printk("[parent] child PID=%d exited with status=%d\n", ret, status);
    }

    printk("[parent] all children done\n");
}

/* ps: list processes */
static void cmd_ps(void)
{
    printk("PID  PPID  STATE       NAME\n");
    for (int i = 0; i < CONFIG_MAX_PROCESS_COUNT; i++) {
        struct z_process *proc = process_get(i);
        if (proc && proc->pid > 0) {
            const char *state = "running";
            if (signal_is_suspended(proc->pid) > 0) {
                state = "suspended";
            }
            printk("%-4d %-4d  %-10s  (pid slot %d)\n",
                   proc->pid,
                   proc->parent ? proc->parent->pid : 0,
                   state,
                   i);
        }
    }

    pid_t suspended_pid = signal_get_suspended_fg_pid();
    if (suspended_pid > 0) {
        printk("\nSuspended foreground process: %d (use 'fg' to resume)\n", suspended_pid);
    }
}

/* fg: resume suspended foreground process */
static void cmd_fg(void)
{
    pid_t suspended_pid = signal_get_suspended_fg_pid();

    if (suspended_pid <= 0) {
        uart_puts("No suspended foreground process\n");
        return;
    }

    printk("Resuming process PID=%d...\n", suspended_pid);
    int ret = signal_resume_process(suspended_pid);

    if (ret == 0) {
        printk("Process %d resumed and brought to foreground\n", suspended_pid);
    } else {
        printk("Failed to resume process %d: %d\n", suspended_pid, ret);
    }
}

/* loop: test command that loops and can be suspended */
static void *loop_thread(void *arg)
{
    int duration = (int)(intptr_t)arg;
    struct z_process *proc = process_current();

    if (duration <= 0) {
        printk("[loop] Started in PID=%d, infinite loop\n", proc->pid);
    } else {
        printk("[loop] Started in PID=%d, will loop %d times\n", proc->pid, duration);
    }
    printk("[loop] Press Ctrl+D to suspend, or Ctrl+C to interrupt\n");

    /* Set this process as foreground */
    signal_set_foreground_pgid(proc->pid);

    /* Install signal handlers */
    volatile int interrupted = 0;
    void sigint_handler(int sig) {
        interrupted = 1;
        printk("\n[loop] Interrupted by SIGINT\n");
    }
    signal(SIGINT, sigint_handler);

    /* Infinite or counted loop with CPU-intensive work to slow down QEMU */
    int count = 0;
    while (!interrupted) {
        if (duration > 0 && count >= duration) {
            break;
        }

        if (count % 100 == 0) {
            printk(".");  /* Print dot every 100 iterations */
        }

        /* Do some CPU work to consume time even in QEMU */
        volatile int dummy = 0;
        for (int i = 0; i < 10000; i++) {
            dummy += i * i;
        }

        /* Check for pending signals frequently */
        signal_check_pending();

        count++;
    }

    if (!interrupted) {
        printk("\n[loop] Completed normally after %d iterations\n", count);
    }

    /* Clear foreground */
    signal_set_foreground_pgid(0);

    return (void *)(intptr_t)0;
}

static void cmd_loop(char *args)
{
    int duration = 1000;  /* default 1000 iterations */

    if (args && args[0]) {
        duration = atoi(args);
        if (duration <= 0) duration = 1000;
    }

    /* Create a new process for the loop */
    pid_t pid = new_task("loop_test", loop_thread, (void *)(intptr_t)duration);

    if (pid < 0) {
        printk("Failed to create loop process: %d\n", pid);
        return;
    }

    printk("Loop process started with PID=%d (running in background)\n", pid);
    /* Don't waitpid() here - let it run in background so shell can handle Ctrl+D */
}

int main(void)
{
    uart_dev = DEVICE_DT_GET(DT_CHOSEN(zephyr_console));
    if (!device_is_ready(uart_dev)) {
        printk("UART not ready\n");
        return -1;
    }

    uart_puts("ANL loader + fork demo ready.\n");
    uart_puts("Commands:\n");
    uart_puts("  load <name> <hexdata> - Load ANL module\n");
    uart_puts("  fork [nchildren] [iters] - Fork test\n");
    uart_puts("  loop [seconds] - Loop test (Ctrl+D to suspend, Ctrl+C to stop)\n");
    uart_puts("  fg - Resume suspended process\n");
    uart_puts("  ps - List processes\n");
    uart_puts("anl> ");

    static char line[8192 + 64];
    while (1) {
        int len = readline(line, sizeof(line));
        if (len == 0) { uart_puts("anl> "); continue; }

        if (strncmp(line, "load ", 5) == 0)
            cmd_load(line + 5);
        else if (strncmp(line, "fork", 4) == 0)
            cmd_fork(line[4] == ' ' ? line + 5 : "");
        else if (strncmp(line, "loop", 4) == 0)
            cmd_loop(line[4] == ' ' ? line + 5 : "");
        else if (strcmp(line, "ps") == 0)
            cmd_ps();
        else if (strcmp(line, "fg") == 0)
            cmd_fg();
        else
            uart_puts("unknown command\n");

        uart_puts("anl> ");
    }
    return 0;
}
```

## src/anl_loader.c
```c
#include <zephyr/kernel.h>
#include <string.h>
#include "anl_loader.h"

/* CRC-32 (IEEE 802.3) */
static uint32_t crc32(const uint8_t *buf, size_t len)
{
    uint32_t crc = 0xFFFFFFFFU;
    for (size_t i = 0; i < len; i++) {
        crc ^= buf[i];
        for (int j = 0; j < 8; j++)
            crc = (crc >> 1) ^ (0xEDB88320U & -(crc & 1));
    }
    return ~crc;
}

int anl_validate(const uint8_t *buf, size_t len)
{
    if (len < sizeof(AnlFileHeader)) return -1;
    const AnlFileHeader *fh = (const AnlFileHeader *)buf;
    if (fh->magic != ANL_MAGIC) return -2;
    if (fh->version != ANL_VERSION) return -3;
    if (fh->file_size > len) return -4;

    /* CRC check: compute with crc32 field zeroed */
    uint8_t tmp[sizeof(uint32_t)];
    memcpy(tmp, &fh->crc32, 4);
    uint32_t stored = fh->crc32;
    /* We can't modify buf (const), so compute in two parts */
    uint32_t crc = 0xFFFFFFFFU;
    size_t crc_off = offsetof(AnlFileHeader, crc32);
    for (size_t i = 0; i < fh->file_size; i++) {
        uint8_t b = (i >= crc_off && i < crc_off + 4) ? 0 : buf[i];
        crc ^= b;
        for (int j = 0; j < 8; j++)
            crc = (crc >> 1) ^ (0xEDB88320U & -(crc & 1));
    }
    crc = ~crc;
    if (crc != stored) return -5;
    return 0;
}

const uint8_t *anl_section(const uint8_t *buf, uint16_t sh_type, uint32_t *out_size)
{
    const AnlFileHeader *fh = (const AnlFileHeader *)buf;
    const AnlSectionHeader *sh = (const AnlSectionHeader *)(buf + sizeof(AnlFileHeader));
    for (int i = 0; i < fh->shnum; i++) {
        if (sh[i].sh_type == sh_type) {
            if (out_size) *out_size = sh[i].sh_size;
            return buf + sh[i].sh_offset;
        }
    }
    return NULL;
}

static const AnlSectionHeader *get_shdr(const uint8_t *buf, int idx)
{
    const AnlFileHeader *fh = (const AnlFileHeader *)buf;
    if (idx < 0 || idx >= fh->shnum) return NULL;
    return (const AnlSectionHeader *)(buf + sizeof(AnlFileHeader)) + idx;
}

int anl_load(const char *name, const uint8_t *buf, size_t len)
{
    int ret = anl_validate(buf, len);
    if (ret) {
        printk("anl_load[%s]: validate failed %d\n", name, ret);
        return ret;
    }

    const AnlFileHeader *fh = (const AnlFileHeader *)buf;
    const AnlSectionHeader *shdrs = (const AnlSectionHeader *)(buf + sizeof(AnlFileHeader));

    /* Calculate total alloc size for SHF_ALLOC sections */
    uint32_t total = 0;
    for (int i = 0; i < fh->shnum; i++) {
        if (shdrs[i].sh_flags & SHF_ALLOC)
            total += shdrs[i].sh_size;
    }

    uint8_t *mem = k_malloc(total);
    if (!mem) {
        printk("anl_load[%s]: OOM (%u bytes)\n", name, total);
        return -ENOMEM;
    }
    memset(mem, 0, total);

    /* Map section index -> runtime base address */
    uintptr_t sec_base[16] = {0};
    uint32_t off = 0;
    for (int i = 0; i < fh->shnum && i < 16; i++) {
        if (shdrs[i].sh_flags & SHF_ALLOC) {
            sec_base[i] = (uintptr_t)(mem + off);
            if (shdrs[i].sh_type != SHT_BSS)
                memcpy(mem + off, buf + shdrs[i].sh_offset, shdrs[i].sh_size);
            off += shdrs[i].sh_size;
        }
    }

    /* Find CODE section base */
    uintptr_t code_base = 0;
    for (int i = 0; i < fh->shnum && i < 16; i++) {
        if (shdrs[i].sh_type == SHT_CODE) { code_base = sec_base[i]; break; }
    }

    /* Process RELA sections */
    for (int i = 0; i < fh->shnum; i++) {
        if (shdrs[i].sh_type != SHT_RELA) continue;
        const AnlRelaEntry *relas = (const AnlRelaEntry *)(buf + shdrs[i].sh_offset);
        uint32_t nrela = shdrs[i].sh_size / sizeof(AnlRelaEntry);
        int symtab_idx = shdrs[i].sh_link;
        const AnlSectionHeader *symsh = get_shdr(buf, symtab_idx);
        if (!symsh) continue;
        const AnlSymEntry *syms = (const AnlSymEntry *)(buf + symsh->sh_offset);
        const AnlSectionHeader *strsh = get_shdr(buf, symsh->sh_link);
        const char *strtab = strsh ? (const char *)(buf + strsh->sh_offset) : NULL;

        for (uint32_t r = 0; r < nrela; r++) {
            uint32_t sym_idx = relas[r].r_info >> 8;
            uint8_t  r_type  = relas[r].r_info & 0xFF;
            const AnlSymEntry *sym = &syms[sym_idx];

            uintptr_t S = 0;
            if (sym->st_shndx == ANL_SHNDX_UNDEF) {
                /* Dynamic symbol lookup */
                const char *sname = strtab ? strtab + sym->st_name : "";
                for (int e = 0; e < _anl_exports_count; e++) {
                    if (strcmp(_anl_exports[e].name, sname) == 0) {
                        S = _anl_exports[e].addr;
                        break;
                    }
                }
                if (!S) {
                    printk("anl_load[%s]: unresolved symbol '%s'\n", name, sname);
                    k_free(mem);
                    return -ENOENT;
                }
            } else if (sym->st_shndx < 16) {
                S = sec_base[sym->st_shndx] + sym->st_value;
            }

            /* Patch location is relative to CODE section */
            uint32_t *patch = (uint32_t *)(code_base + relas[r].r_offset);
            int32_t   A     = relas[r].r_addend;
            uintptr_t P     = (uintptr_t)patch;

            printk("  rela[%u] type=%u sym=%u S=0x%08x P=0x%08x A=%d\n",
                   r, r_type, sym_idx, (unsigned)S, (unsigned)P, A);
            switch (r_type) {
            case R_ANL_32:
            case R_ANL_ABS32:
                *patch = (uint32_t)(S + A);
                break;
            case R_ANL_PC32:
                *patch = (uint32_t)(S + A - P);
                break;
            case R_ANL_THM_CALL: {
                /* Thumb BL: encode 26-bit offset into two 16-bit halfwords */
                int32_t offset = (int32_t)(S + A - P - 4);
                uint16_t *hw = (uint16_t *)patch;
                uint32_t s  = (offset >> 24) & 1;
                uint32_t i1 = (offset >> 23) & 1;
                uint32_t i2 = (offset >> 22) & 1;
                uint32_t j1 = (~(i1 ^ s)) & 1;
                uint32_t j2 = (~(i2 ^ s)) & 1;
                uint32_t imm10 = (offset >> 12) & 0x3FF;
                uint32_t imm11 = (offset >> 1)  & 0x7FF;
                hw[0] = (uint16_t)(0xF000 | (s << 10) | imm10);
                hw[1] = (uint16_t)(0xF800 | (j1 << 13) | (j2 << 11) | imm11);
                break;
            }
            default:
                printk("anl_load[%s]: unknown reloc type %d\n", name, r_type);
                break;
            }
        }
    }

    /* Jump to entry — Thumb bit must be set */
    uintptr_t entry = code_base + fh->entry_off;
    printk("anl_load[%s]: jumping to entry 0x%08x\n", name, (unsigned)entry);
    void (*fn)(void) = (void (*)(void))(entry | 1);
    fn();

    /* Note: mem is intentionally not freed here because spawned child
     * threads may still be executing code from this module. */
    return 0;
}
```

## src/anl_loader.h
```c
#ifndef ANL_LOADER_H
#define ANL_LOADER_H

#include <stdint.h>
#include <stddef.h>

/* Magic: \x7FANL */
#define ANL_MAGIC        0x4C4E417FU
#define ANL_VERSION      1
#define ANL_ARCH_THUMB2  2

/* File flags */
#define ANL_F_PIC        (1 << 0)
#define ANL_F_DYNAMIC    (1 << 1)
#define ANL_F_STRIP      (1 << 2)

/* Section types */
#define SHT_NULL    0
#define SHT_CODE    1
#define SHT_RODATA  2
#define SHT_DATA    3
#define SHT_BSS     4
#define SHT_SYMTAB  5
#define SHT_STRTAB  6
#define SHT_RELA    7
#define SHT_DYNSYM  8
#define SHT_DYNSTR  9

/* Section flags */
#define SHF_EXEC    (1 << 0)
#define SHF_WRITE   (1 << 1)
#define SHF_ALLOC   (1 << 2)

/* Relocation types (ARM Thumb2) */
#define R_ANL_32        1
#define R_ANL_PC32      2
#define R_ANL_THM_CALL  3  /* Thumb BL/BLX */
#define R_ANL_ABS32     4

#define ANL_SHNDX_UNDEF 0xFF

#pragma pack(push, 1)

typedef struct {
    uint32_t magic;
    uint8_t  version;
    uint8_t  arch;
    uint16_t flags;
    uint32_t entry_off;
    uint16_t shnum;
    uint16_t shentsize;
    uint32_t file_size;
    uint32_t crc32;
    uint32_t symtab_idx;
    uint32_t dynsym_idx;
} AnlFileHeader;  /* 32 bytes */

typedef struct {
    uint16_t sh_type;
    uint16_t sh_flags;
    uint32_t sh_offset;
    uint32_t sh_size;
    uint32_t sh_addr;
    uint32_t sh_link;
    uint32_t sh_entsize;
} AnlSectionHeader;  /* 24 bytes */

typedef struct {
    uint32_t st_name;
    uint32_t st_value;
    uint32_t st_size;
    uint8_t  st_type;
    uint8_t  st_bind;
    uint8_t  st_shndx;
    uint8_t  reserved;
} AnlSymEntry;  /* 16 bytes */

typedef struct {
    uint32_t r_offset;
    uint32_t r_info;
    int32_t  r_addend;
} AnlRelaEntry;  /* 12 bytes */

#pragma pack(pop)

struct anl_export {
    const char *name;
    uintptr_t   addr;
};

extern const struct anl_export _anl_exports[];
extern const int _anl_exports_count;

int anl_validate(const uint8_t *buf, size_t len);
const uint8_t *anl_section(const uint8_t *buf, uint16_t sh_type, uint32_t *out_size);
int anl_load(const char *name, const uint8_t *buf, size_t len);

#endif /* ANL_LOADER_H */
```

## src/shell_process.c
```c
/*
 * Copyright (c) 2024 OneWo-rtLinux Team
 * SPDX-License-Identifier: Apache-2.0
 */

#include <zephyr/kernel.h>
#include <zephyr/kernel/process.h>
#include <string.h>
#include <errno.h>
#include <stdio.h>
#include "shell_process.h"
#include "signal.h"

#define MAX_COMMANDS 16
#define TASK_STACK_SIZE 2048

static const struct shell_cmd *command_registry[MAX_COMMANDS];
static int command_count = 0;
static struct k_mutex cmd_registry_lock;

struct process_exit_msg {
	pid_t pid;
	int exit_code;
};

K_MSGQ_DEFINE(process_exit_queue, sizeof(struct process_exit_msg), 16, 4);

#define MAX_STACK_POOL 3
K_THREAD_STACK_ARRAY_DEFINE(stack_pool, MAX_STACK_POOL, TASK_STACK_SIZE);
static bool stack_pool_used[MAX_STACK_POOL];
static struct k_mutex stack_pool_lock;

static struct {
	pid_t pid;
	int stack_index;
	struct k_thread *thread;
} stack_tracker[MAX_STACK_POOL];
static struct k_mutex stack_tracker_lock;

struct task_trampoline_arg {
	void *(*run)(void *);
	void *run_arg;
};

static void task_trampoline(void *arg1, void *arg2, void *arg3)
{
	struct task_trampoline_arg *arg = (struct task_trampoline_arg *)arg1;

	k_msleep(10);

	if (!arg || !arg->run) return;

	void *result = arg->run(arg->run_arg);

	struct z_process *proc = process_current();
	if (proc) {
		struct process_exit_msg msg = {
			.pid = proc->pid,
			.exit_code = (int)(intptr_t)result,
		};
		k_msgq_put(&process_exit_queue, &msg, K_NO_WAIT);
	}

	k_free(arg);
	k_yield();
	k_msleep(100);
}

pid_t new_task(const char *name, void *(*run)(void *), void *arg)
{
	if (!run) return -EINVAL;

	struct z_process *parent = process_current();
	if (!parent) return -ESRCH;

	struct z_process *child = process_create(parent);
	if (!child) return -ENOMEM;

	/* Allocate and initialize signal state */
	child->signal_state = k_malloc(sizeof(struct process_signal));
	if (!child->signal_state) {
		process_exit(child, -ENOMEM);
		return -ENOMEM;
	}

	if (signal_process_init(child) != 0) {
		k_free(child->signal_state);
		child->signal_state = NULL;
		process_exit(child, -ENOMEM);
		return -ENOMEM;
	}

	k_thread_stack_t *stack = NULL;
	int stack_index = -1;

	k_mutex_lock(&stack_pool_lock, K_FOREVER);
	for (int i = 0; i < MAX_STACK_POOL; i++) {
		if (!stack_pool_used[i]) {
			stack_pool_used[i] = true;
			stack = &stack_pool[i][0];
			stack_index = i;
			break;
		}
	}
	k_mutex_unlock(&stack_pool_lock);

	if (!stack) {
		process_exit(child, -ENOMEM);
		return -ENOMEM;
	}

	struct k_thread *thread = k_malloc(sizeof(struct k_thread));
	if (!thread) {
		k_mutex_lock(&stack_pool_lock, K_FOREVER);
		stack_pool_used[stack_index] = false;
		k_mutex_unlock(&stack_pool_lock);
		process_exit(child, -ENOMEM);
		return -ENOMEM;
	}

	struct task_trampoline_arg *tramp_arg = k_malloc(sizeof(struct task_trampoline_arg));
	if (!tramp_arg) {
		k_free(thread);
		k_mutex_lock(&stack_pool_lock, K_FOREVER);
		stack_pool_used[stack_index] = false;
		k_mutex_unlock(&stack_pool_lock);
		process_exit(child, -ENOMEM);
		return -ENOMEM;
	}

	tramp_arg->run = run;
	tramp_arg->run_arg = arg;

	process_register_thread(child, thread);

	k_tid_t tid = k_thread_create(
		thread, stack,
		K_THREAD_STACK_SIZEOF(TASK_STACK_SIZE),
		task_trampoline, tramp_arg, NULL, NULL,
		K_PRIO_PREEMPT(7), 0, K_NO_WAIT);

	if (!tid) {
		process_unregister_thread(child, thread);
		k_free(tramp_arg);
		k_free(thread);
		k_mutex_lock(&stack_pool_lock, K_FOREVER);
		stack_pool_used[stack_index] = false;
		k_mutex_unlock(&stack_pool_lock);
		process_exit(child, -EAGAIN);
		return -EAGAIN;
	}

	k_mutex_lock(&stack_tracker_lock, K_FOREVER);
	for (int i = 0; i < MAX_STACK_POOL; i++) {
		if (stack_tracker[i].pid == 0) {
			stack_tracker[i].pid = child->pid;
			stack_tracker[i].stack_index = stack_index;
			stack_tracker[i].thread = thread;
			break;
		}
	}
	k_mutex_unlock(&stack_tracker_lock);

	if (name && name[0] != '\0') {
		k_thread_name_set(tid, name);
	}

	return child->pid;
}

pid_t waitpid(pid_t pid, int *status, int options)
{
	struct process_exit_msg msg;

	while (1) {
		int ret = k_msgq_get(&process_exit_queue, &msg, K_FOREVER);
		if (ret == 0) {
			if (msg.pid == pid || pid == -1) {
				if (status) *status = msg.exit_code;

				struct z_process *proc = process_get(msg.pid);
				if (proc && proc->main_thread) {
					int stack_index = -1;
					struct k_thread *thread = proc->main_thread;

					k_mutex_lock(&stack_tracker_lock, K_FOREVER);
					for (int i = 0; i < MAX_STACK_POOL; i++) {
						if (stack_tracker[i].pid == msg.pid) {
							stack_index = stack_tracker[i].stack_index;
							stack_tracker[i].pid = 0;
							stack_tracker[i].stack_index = -1;
							stack_tracker[i].thread = NULL;
							break;
						}
					}
					k_mutex_unlock(&stack_tracker_lock);

					k_thread_join(proc->main_thread, K_FOREVER);
					process_unregister_thread(proc, thread);
					k_free(thread);

					if (stack_index >= 0 && stack_index < MAX_STACK_POOL) {
						k_mutex_lock(&stack_pool_lock, K_FOREVER);
						stack_pool_used[stack_index] = false;
						k_mutex_unlock(&stack_pool_lock);
					}

					process_exit(proc, msg.exit_code);
				}
				return msg.pid;
			}
			k_msgq_put(&process_exit_queue, &msg, K_NO_WAIT);
			k_yield();
		}
	}

	return -ECHILD;
}

const struct shell_cmd *shell_cmd_lookup(const char *name)
{
	if (!name) return NULL;

	k_mutex_lock(&cmd_registry_lock, K_FOREVER);
	for (int i = 0; i < command_count; i++) {
		if (command_registry[i] && strcmp(command_registry[i]->name, name) == 0) {
			k_mutex_unlock(&cmd_registry_lock);
			return command_registry[i];
		}
	}
	k_mutex_unlock(&cmd_registry_lock);
	return NULL;
}

int shell_cmd_register(const struct shell_cmd *cmd)
{
	if (!cmd || !cmd->name || !cmd->exec) return -EINVAL;

	k_mutex_lock(&cmd_registry_lock, K_FOREVER);
	if (command_count >= MAX_COMMANDS) {
		k_mutex_unlock(&cmd_registry_lock);
		return -ENOMEM;
	}
	command_registry[command_count++] = cmd;
	k_mutex_unlock(&cmd_registry_lock);
	return 0;
}

void shell_process_init(void)
{
	k_mutex_init(&cmd_registry_lock);
	k_mutex_init(&stack_tracker_lock);
	k_mutex_init(&stack_pool_lock);
	command_count = 0;
	memset(command_registry, 0, sizeof(command_registry));
	memset(stack_tracker, 0, sizeof(stack_tracker));
	memset(stack_pool_used, 0, sizeof(stack_pool_used));
}

static int shell_process_init_wrapper(void)
{
	shell_process_init();
	return 0;
}

SYS_INIT(shell_process_init_wrapper, APPLICATION, CONFIG_KERNEL_INIT_PRIORITY_DEFAULT);
```

## src/shell_process.h
```c
/*
 * Copyright (c) 2024 OneWo-rtLinux Team
 *
 * SPDX-License-Identifier: Apache-2.0
 */

#ifndef SHELL_PROCESS_H_
#define SHELL_PROCESS_H_

#include <zephyr/kernel.h>
#include <zephyr/kernel/process.h>

#ifdef __cplusplus
extern "C" {
#endif

typedef int (*cmd_exec_t)(int argc, char **argv);

struct shell_cmd {
	const char *name;
	const char *brief;
	cmd_exec_t exec;
};

struct cmd_data {
	int argc;
	char **argv;
	const struct shell_cmd *cmd;
	bool on_fg;
	struct k_sem copied_sem;
	int result;
};

pid_t new_task(const char *name, void *(*run)(void *), void *arg);
pid_t waitpid(pid_t pid, int *status, int options);
int shell_exec_command(const struct shell_cmd *cmd, int argc, char **argv, bool on_fg);
const struct shell_cmd *shell_cmd_lookup(const char *name);
int shell_cmd_register(const struct shell_cmd *cmd);
void shell_process_init(void);

#ifdef __cplusplus
}
#endif

#endif /* SHELL_PROCESS_H_ */
```

## src/signal.c
```c
/*
 * Copyright (c) 2024 OneWo-rtLinux Team
 * SPDX-License-Identifier: Apache-2.0
 */

#include "signal.h"
#include <zephyr/kernel.h>
#include <zephyr/kernel/process.h>
#include <errno.h>
#include <string.h>
#include <stdio.h>

/* Foreground process group ID */
static pid_t foreground_pgid = 0;
static struct k_mutex foreground_lock;

/* Suspended process tracking */
static pid_t suspended_fg_pid = 0;
static struct k_mutex suspended_lock;

/* Default signal actions */
static void default_signal_handler(int sig)
{
	struct z_process *proc = process_current();

	/* SIGTSTP - suspend process */
	if (sig == SIGTSTP) {
		printk("[SIGNAL] Process PID=%d received SIGTSTP, calling suspend...\n", proc ? proc->pid : 0);
		int ret = signal_suspend_process(proc ? proc->pid : 0);
		printk("[SIGNAL] suspend returned %d (THIS LINE SHOULD NOT APPEAR IF SUSPENDED)\n", ret);
		return;
	}

	/* SIGCONT - continue process */
	if (sig == SIGCONT) {
		printk("[SIGNAL] Process PID=%d continued\n", proc ? proc->pid : 0);
		/* Process is already running if it's handling this signal */
		return;
	}

	printk("[SIGNAL] Process PID=%d received signal %d, default action: terminate\n",
	       proc ? proc->pid : 0, sig);

	/* For most signals, default action is to terminate */
	/* In real implementation, SIGCHLD, SIGCONT etc would be ignored by default */
}

/**
 * @brief Initialize signal subsystem for a process
 */
int signal_process_init(struct z_process *proc)
{
	if (!proc || !proc->signal_state) {
		return -EINVAL;
	}

	struct process_signal *sig = proc->signal_state;

	sig->pending_signals = 0;
	sig->blocked_signals = 0;

	/* Initialize event for this process */
	k_event_init(&sig->signal_event);

	/* Initialize mutex */
	k_mutex_init(&sig->lock);

	/* Set default handlers */
	for (int i = 0; i < _NSIG; i++) {
		sig->handlers[i] = SIG_DFL;
	}

	/* SIGCHLD and SIGCONT are ignored by default in some contexts */
	sig->handlers[SIGCHLD] = SIG_IGN;
	/* SIGCONT default action is to continue - handled in default_signal_handler */

	return 0;
}

/**
 * @brief Cleanup signal subsystem for a process
 */
void signal_process_cleanup(struct z_process *proc)
{
	if (!proc || !proc->signal_state) {
		return;
	}

	/* Clear all pending signals */
	struct process_signal *sig = proc->signal_state;
	sig->pending_signals = 0;

	/* Wake up any waiters */
	k_event_post(&sig->signal_event, 0xFFFFFFFF);
}

/**
 * @brief Send a signal to a process
 */
int kill(pid_t pid, int sig)
{
	if (sig < 0 || sig >= _NSIG) {
		return -EINVAL;
	}

	if (pid <= 0) {
		return -EINVAL; /* Process groups not fully implemented yet */
	}

	struct z_process *proc = process_get(pid);
	if (!proc || !proc->signal_state) {
		printk("[SIGNAL] kill(%d, %d) FAILED: process not found or no signal_state\n", pid, sig);
		return -ESRCH;
	}

	struct process_signal *psig = proc->signal_state;

	k_mutex_lock(&psig->lock, K_FOREVER);

	/* Set the signal bit */
	psig->pending_signals |= (1U << sig);

	/* Wake up the process by posting to its event */
	k_event_post(&psig->signal_event, (1U << sig));

	k_mutex_unlock(&psig->lock);

	printk("[SIGNAL] kill(%d, %d) SUCCESS: pending_signals=0x%08x\n",
	       pid, sig, psig->pending_signals);

	return 0;
}

/**
 * @brief Send a signal to a process group
 */
int killpg(pid_t pgid, int sig)
{
	if (sig < 0 || sig >= _NSIG) {
		return -EINVAL;
	}

	/* Simplified: send to all processes (no real process groups yet) */
	int count = 0;
	for (int i = 0; i < CONFIG_MAX_PROCESS_COUNT; i++) {
		struct z_process *proc = process_get(i);
		if (proc && proc->pid > 0) {
			if (kill(proc->pid, sig) == 0) {
				count++;
			}
		}
	}

	return count > 0 ? 0 : -ESRCH;
}

/**
 * @brief Set signal handler for current process
 */
signal_handler_t signal(int sig, signal_handler_t handler)
{
	if (sig < 0 || sig >= _NSIG) {
		return SIG_ERR;
	}

	/* SIGKILL and SIGSTOP cannot be caught */
	if (sig == SIGKILL || sig == SIGSTOP) {
		return SIG_ERR;
	}

	struct z_process *proc = process_current();
	if (!proc || !proc->signal_state) {
		return SIG_ERR;
	}

	struct process_signal *psig = proc->signal_state;

	k_mutex_lock(&psig->lock, K_FOREVER);
	signal_handler_t old_handler = psig->handlers[sig];
	psig->handlers[sig] = handler;
	k_mutex_unlock(&psig->lock);

	return old_handler;
}

/**
 * @brief Block signals
 */
int sigblock(uint32_t mask)
{
	struct z_process *proc = process_current();
	if (!proc || !proc->signal_state) {
		return -ESRCH;
	}

	struct process_signal *psig = proc->signal_state;

	k_mutex_lock(&psig->lock, K_FOREVER);
	psig->blocked_signals |= mask;
	k_mutex_unlock(&psig->lock);

	return 0;
}

/**
 * @brief Unblock signals
 */
int sigunblock(uint32_t mask)
{
	struct z_process *proc = process_current();
	if (!proc || !proc->signal_state) {
		return -ESRCH;
	}

	struct process_signal *psig = proc->signal_state;

	k_mutex_lock(&psig->lock, K_FOREVER);
	psig->blocked_signals &= ~mask;
	k_mutex_unlock(&psig->lock);

	/* Check if we just unblocked any pending signals */
	signal_check_pending();

	return 0;
}

/**
 * @brief Wait for signal event with timeout
 */
int signal_wait(k_timeout_t timeout)
{
	struct z_process *proc = process_current();
	if (!proc || !proc->signal_state) {
		return -ESRCH;
	}

	struct process_signal *psig = proc->signal_state;

	/* Wait on this process's own event object */
	uint32_t events = k_event_wait(&psig->signal_event, 0xFFFFFFFF, false, timeout);

	if (events == 0) {
		return 0; /* Timeout */
	}

	/* Find which signal was received */
	for (int sig = 1; sig < _NSIG; sig++) {
		if (events & (1U << sig)) {
			return sig;
		}
	}

	return 0;
}

/**
 * @brief Check and handle pending signals
 */
int signal_check_pending(void)
{
	struct z_process *proc = process_current();
	if (!proc || !proc->signal_state) {
		return -ESRCH;
	}

	struct process_signal *psig = proc->signal_state;

	k_mutex_lock(&psig->lock, K_FOREVER);

	/* Get unblocked pending signals */
	uint32_t deliverable = psig->pending_signals & ~psig->blocked_signals;

	/* Debug: print if any signals are pending */
	if (psig->pending_signals != 0) {
		printk("[SIGNAL] PID=%d check_pending: pending=0x%08x, blocked=0x%08x, deliverable=0x%08x\n",
		       proc->pid, psig->pending_signals, psig->blocked_signals, deliverable);
	}

	if (deliverable == 0) {
		k_mutex_unlock(&psig->lock);
		return 0;
	}

	int handled = 0;

	/* Handle each pending signal */
	for (int sig = 1; sig < _NSIG; sig++) {
		if (!(deliverable & (1U << sig))) {
			continue;
		}

		/* Clear the pending bit */
		psig->pending_signals &= ~(1U << sig);

		signal_handler_t handler = psig->handlers[sig];

		k_mutex_unlock(&psig->lock);

		/* Call handler outside of lock */
		if (handler == SIG_IGN) {
			/* Ignore */
			printk("[SIGNAL] PID=%d ignored signal %d\n", proc->pid, sig);
		} else if (handler == SIG_DFL) {
			/* Default action */
			default_signal_handler(sig);
		} else {
			/* User-defined handler */
			printk("[SIGNAL] PID=%d calling handler for signal %d\n", proc->pid, sig);
			handler(sig);
		}

		handled++;

		k_mutex_lock(&psig->lock, K_FOREVER);
	}

	k_mutex_unlock(&psig->lock);

	return handled;
}

/**
 * @brief Set foreground process group
 */
void signal_set_foreground_pgid(pid_t pgid)
{
	k_mutex_lock(&foreground_lock, K_FOREVER);
	foreground_pgid = pgid;
	k_mutex_unlock(&foreground_lock);

	printk("[SIGNAL] Foreground process group set to PID=%d\n", pgid);
}

/**
 * @brief Get foreground process group
 */
pid_t signal_get_foreground_pgid(void)
{
	k_mutex_lock(&foreground_lock, K_FOREVER);
	pid_t pgid = foreground_pgid;
	k_mutex_unlock(&foreground_lock);

	return pgid;
}

/**
 * @brief Get process signal state
 */
struct process_signal *signal_get_state(struct z_process *proc)
{
	if (!proc) {
		return NULL;
	}
	return proc->signal_state;
}

/**
 * @brief Suspend (stop) a process
 */
int signal_suspend_process(pid_t pid)
{
	if (pid <= 0) {
		return -EINVAL;
	}

	struct z_process *proc = process_get(pid);
	if (!proc || !proc->main_thread) {
		return -ESRCH;
	}

	printk("[SIGNAL] Suspending process PID=%d\n", pid);

	/* Track suspended foreground process BEFORE suspending */
	k_mutex_lock(&suspended_lock, K_FOREVER);
	if (pid == foreground_pgid) {
		suspended_fg_pid = pid;
		/* Clear foreground since it's now suspended */
		k_mutex_lock(&foreground_lock, K_FOREVER);
		foreground_pgid = 0;
		k_mutex_unlock(&foreground_lock);
		printk("[SIGNAL] Foreground process suspended. Use 'fg' to resume.\n");
	}
	k_mutex_unlock(&suspended_lock);

	/* Suspend the main thread - THIS MUST BE LAST!
	 * After this call, if we're suspending ourselves, we stop executing here.
	 * When resumed, execution will continue after k_thread_suspend returns.
	 */
	k_thread_suspend(proc->main_thread);

	return 0;
}

/**
 * @brief Resume (continue) a suspended process
 */
int signal_resume_process(pid_t pid)
{
	if (pid <= 0) {
		return -EINVAL;
	}

	struct z_process *proc = process_get(pid);
	if (!proc || !proc->main_thread) {
		return -ESRCH;
	}

	printk("[SIGNAL] Resuming process PID=%d\n", pid);

	/* Resume the main thread */
	k_thread_resume(proc->main_thread);

	/* Restore as foreground process */
	k_mutex_lock(&suspended_lock, K_FOREVER);
	if (suspended_fg_pid == pid) {
		suspended_fg_pid = 0;
		signal_set_foreground_pgid(pid);
	}
	k_mutex_unlock(&suspended_lock);

	/* Send SIGCONT to the process */
	kill(pid, SIGCONT);

	return 0;
}

/**
 * @brief Check if a process is suspended
 */
int signal_is_suspended(pid_t pid)
{
	if (pid <= 0) {
		return -EINVAL;
	}

	struct z_process *proc = process_get(pid);
	if (!proc || !proc->main_thread) {
		return -ESRCH;
	}

	/* Check if thread is suspended */
	uint8_t state = proc->main_thread->base.thread_state;
	return (state & _THREAD_SUSPENDED) ? 1 : 0;
}

/**
 * @brief Get suspended foreground process ID
 */
pid_t signal_get_suspended_fg_pid(void)
{
	k_mutex_lock(&suspended_lock, K_FOREVER);
	pid_t pid = suspended_fg_pid;
	k_mutex_unlock(&suspended_lock);
	return pid;
}

/**
 * @brief Initialize signal subsystem
 */
static int signal_subsystem_init(void)
{
	k_mutex_init(&foreground_lock);
	k_mutex_init(&suspended_lock);
	foreground_pgid = 0;
	suspended_fg_pid = 0;
	return 0;
}

SYS_INIT(signal_subsystem_init, APPLICATION, CONFIG_KERNEL_INIT_PRIORITY_DEFAULT);
```
