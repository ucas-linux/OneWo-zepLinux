## CMakeLists.txt
```
cmake_minimum_required(VERSION 3.20.0)
find_package(Zephyr REQUIRED HINTS $ENV{ZEPHYR_BASE})
project(as32x601_udp_echo)
target_sources(app PRIVATE src/main.c)
```

## prj.conf
```kconfig
CONFIG_NETWORKING=y
CONFIG_NET_IPV4=y
CONFIG_NET_IPV6=n
CONFIG_NET_UDP=y
CONFIG_NET_SOCKETS=y
CONFIG_NET_L2_ETHERNET=y
CONFIG_ETH_DRIVER=y
CONFIG_ETH_AS32X601=y
CONFIG_NET_CONFIG_SETTINGS=y
CONFIG_NET_CONFIG_NEED_IPV4=y
CONFIG_NET_CONFIG_NEED_IPV6=n
CONFIG_NET_CONFIG_MY_IPV4_ADDR="192.168.1.100"
CONFIG_NET_CONFIG_MY_IPV4_NETMASK="255.255.255.0"
CONFIG_NET_CONFIG_MY_IPV4_GW="0.0.0.0"
CONFIG_NET_PKT_RX_COUNT=32
CONFIG_NET_BUF_RX_COUNT=96
CONFIG_NET_TC_THREAD_PREEMPTIVE=y
CONFIG_MAIN_STACK_SIZE=4096
CONFIG_LOG=y
CONFIG_LOG_MODE_DEFERRED=y
CONFIG_NET_LOG=y
CONFIG_TEST_RANDOM_GENERATOR=y
```

## src/main.c
```c
/* SPDX-License-Identifier: Apache-2.0 */
/*
 * AS32X601 UDP Echo Server
 * 监听 0.0.0.0:4242，将收到的 UDP 数据原样回送给发送方。
 * PC 测试命令: echo "hello" | nc -u 192.168.1.100 4242
 */
#include <zephyr/kernel.h>
#include <zephyr/net/socket.h>
#include <zephyr/logging/log.h>
#include <errno.h>

LOG_MODULE_REGISTER(udp_echo, LOG_LEVEL_INF);

#define ECHO_PORT   4242
#define BUF_SIZE    1500

int main(void)
{
    int sock;
    struct sockaddr_in addr;
    struct sockaddr_in client;
    socklen_t clen = sizeof(client);
    static uint8_t buf[BUF_SIZE];
    ssize_t len;
    int ret;

    sock = zsock_socket(AF_INET, SOCK_DGRAM, IPPROTO_UDP);
    if (sock < 0) {
        LOG_ERR("socket() failed: %d", errno);
        return -1;
    }

    (void)memset(&addr, 0, sizeof(addr));
    addr.sin_family      = AF_INET;
    addr.sin_addr.s_addr = INADDR_ANY;
    addr.sin_port        = htons(ECHO_PORT);

    ret = zsock_bind(sock, (struct sockaddr *)&addr, sizeof(addr));
    if (ret < 0) {
        LOG_ERR("bind() failed: %d", errno);
        zsock_close(sock);
        return -1;
    }

    LOG_INF("UDP echo server listening on port %d", ECHO_PORT);

    while (1) {
        clen = sizeof(client);
        len = zsock_recvfrom(sock, buf, sizeof(buf), 0,
                             (struct sockaddr *)&client, &clen);
        if (len < 0) {
            LOG_ERR("recvfrom() error: %d", errno);
            continue;
        }

        ret = zsock_sendto(sock, buf, len, 0,
                           (struct sockaddr *)&client, clen);
        if (ret < 0) {
            LOG_ERR("sendto() error: %d", errno);
        }
    }

    zsock_close(sock);
    return 0;
}
```
