## CMakeLists.txt
```
# SPDX-License-Identifier: Apache-2.0

cmake_minimum_required(VERSION 3.20.0)

find_package(Zephyr REQUIRED HINTS $ENV{ZEPHYR_BASE})
project(as32x601_shell_process)

target_sources(app PRIVATE
    src/main.c
    src/shell_process.c
    src/commands.c
    src/debug.c
    src/bytecode_vm.c
    src/anl_loader.c
    src/signal.c
    src/vfs_commands.c
)
```

## sample.yaml
```
sample:
  name: Shell Process Execution for AS32X601
  description: Embox-style shell with process-based command execution
tests:
  sample.ansilic.as32x601_shell_process:
    platform_allow: as32x601_evb/as32x601
    integration_platforms:
      - as32x601_evb/as32x601
    tags: shell process
```

## prj.conf
```kconfig
# Shell configuration
CONFIG_SHELL=y
CONFIG_SHELL_BACKEND_SERIAL=y
CONFIG_SHELL_PROMPT_UART="shell> "
CONFIG_SHELL_CMD_BUFF_SIZE=4096
CONFIG_SHELL_PRINTF_BUFF_SIZE=256

# Process support
CONFIG_PROCESS_MODEL=y
CONFIG_MAX_PROCESS_COUNT=32
CONFIG_MAX_FD_PER_PROCESS=16

# Memory configuration
CONFIG_MAIN_STACK_SIZE=2048
CONFIG_SHELL_STACK_SIZE=2048

# Thread configuration
CONFIG_NUM_PREEMPT_PRIORITIES=15

# Logging (disable to avoid conflicts with shell)
CONFIG_LOG=n
CONFIG_BOOT_BANNER=n

# System configuration
CONFIG_CONSOLE=y
CONFIG_CONSOLE_GETCHAR=y
CONFIG_UART_CONSOLE=y
CONFIG_SERIAL=y
CONFIG_UART_AS32X601=y
CONFIG_PRINTK=y

# Dynamic memory
CONFIG_DYNAMIC_THREAD=y
CONFIG_THREAD_STACK_INFO=y
CONFIG_THREAD_NAME=y

# VFS / RAMFS
CONFIG_FILE_SYSTEM=y
CONFIG_VFS_CORE=y
CONFIG_RAMFS=y
CONFIG_HEAP_MEM_POOL_SIZE=32768
```

## src/main.c
```c
/*
 * Copyright (c) 2024 OneWo-rtLinux Team
 *
 * SPDX-License-Identifier: Apache-2.0
 *
 * Main application - Shell with process-based command execution
 * Uses Zephyr shell subsystem for proper input handling
 */

#include <zephyr/kernel.h>
#include <zephyr/shell/shell.h>
#include <zephyr/kernel/process.h>
#include <zephyr/drivers/uart.h>
#include <stdio.h>
#include <string.h>
#include <stdlib.h>
#include "shell_process.h"
#include "signal.h"

/**
 * @brief Shell command handler - hello
 *
 * This creates a new process and executes the hello command
 */
static int shell_hello_handler(const struct shell *sh, size_t argc, char **argv)
{
	const struct shell_cmd *cmd = shell_cmd_lookup("hello");
	if (!cmd) {
		shell_error(sh, "Command not found");
		return -ENOENT;
	}

	/* Execute in new process (foreground) */
	int ret = shell_exec_command(cmd, argc, argv, true);
	if (ret != 0 && ret != -EINVAL) {
		shell_error(sh, "Command failed with code %d", ret);
	}

	return ret;
}

/**
 * @brief Shell command handler - echo
 */
static int shell_echo_handler(const struct shell *sh, size_t argc, char **argv)
{
	const struct shell_cmd *cmd = shell_cmd_lookup("echo");
	if (!cmd) {
		shell_error(sh, "Command not found");
		return -ENOENT;
	}

	int ret = shell_exec_command(cmd, argc, argv, true);
	if (ret != 0 && ret != -EINVAL) {
		shell_error(sh, "Command failed with code %d", ret);
	}

	return ret;
}

/**
 * @brief Shell command handler - ps
 */
static int shell_ps_handler(const struct shell *sh, size_t argc, char **argv)
{
	const struct shell_cmd *cmd = shell_cmd_lookup("ps");
	if (!cmd) {
		shell_error(sh, "Command not found");
		return -ENOENT;
	}

	int ret = shell_exec_command(cmd, argc, argv, true);
	if (ret != 0) {
		shell_error(sh, "Command failed with code %d", ret);
	}

	return ret;
}

/**
 * @brief Shell command handler - getpid
 */
static int shell_getpid_handler(const struct shell *sh, size_t argc, char **argv)
{
	const struct shell_cmd *cmd = shell_cmd_lookup("getpid");
	if (!cmd) {
		shell_error(sh, "Command not found");
		return -ENOENT;
	}

	int ret = shell_exec_command(cmd, argc, argv, true);
	if (ret != 0) {
		shell_error(sh, "Command failed with code %d", ret);
	}

	return ret;
}

/**
 * @brief Shell command handler - info
 */
static int shell_info_handler(const struct shell *sh, size_t argc, char **argv)
{
	const struct shell_cmd *cmd = shell_cmd_lookup("info");
	if (!cmd) {
		shell_error(sh, "Command not found");
		return -ENOENT;
	}

	int ret = shell_exec_command(cmd, argc, argv, true);
	if (ret != 0) {
		shell_error(sh, "Command failed with code %d", ret);
	}

	return ret;
}

/**
 * @brief Shell command handler - sleep
 */
static int shell_sleep_handler(const struct shell *sh, size_t argc, char **argv)
{
	const struct shell_cmd *cmd = shell_cmd_lookup("sleep");
	if (!cmd) {
		shell_error(sh, "Command not found");
		return -ENOENT;
	}

	int ret = shell_exec_command(cmd, argc, argv, true);
	if (ret != 0 && ret != -EINVAL) {
		shell_error(sh, "Command failed with code %d", ret);
	}

	return ret;
}

/**
 * @brief Shell command handler - test
 */
static int shell_test_handler(const struct shell *sh, size_t argc, char **argv)
{
	const struct shell_cmd *cmd = shell_cmd_lookup("test");
	if (!cmd) {
		shell_error(sh, "Command not found");
		return -ENOENT;
	}

	int ret = shell_exec_command(cmd, argc, argv, true);
	if (ret != 0) {
		shell_error(sh, "Command failed with code %d", ret);
	}

	return ret;
}

/**
 * @brief Shell command handler - help
 */
static int shell_help_handler(const struct shell *sh, size_t argc, char **argv)
{
	const struct shell_cmd *cmd = shell_cmd_lookup("help");
	if (!cmd) {
		shell_error(sh, "Command not found");
		return -ENOENT;
	}

	int ret = shell_exec_command(cmd, argc, argv, true);
	if (ret != 0) {
		shell_error(sh, "Command failed with code %d", ret);
	}

	return ret;
}

/**
 * @brief Shell command handler - ls (bytecode VM)
 */
static int shell_ls_handler(const struct shell *sh, size_t argc, char **argv)
{
	const struct shell_cmd *cmd = shell_cmd_lookup("ls");
	if (!cmd) {
		shell_error(sh, "Command not found");
		return -ENOENT;
	}

	int ret = shell_exec_command(cmd, argc, argv, true);
	if (ret != 0) {
		shell_error(sh, "Command failed with code %d", ret);
	}

	return ret;
}

/**
 * @brief Shell command handler - upload (bytecode VM)
 */
static int shell_upload_handler(const struct shell *sh, size_t argc, char **argv)
{
	const struct shell_cmd *cmd = shell_cmd_lookup("upload");
	if (!cmd) {
		shell_error(sh, "Command not found");
		return -ENOENT;
	}

	int ret = shell_exec_command(cmd, argc, argv, true);
	if (ret != 0) {
		shell_error(sh, "Command failed with code %d", ret);
	}

	return ret;
}

/**
 * @brief Shell command handler - upload_hex (bytecode VM)
 */
static int shell_upload_hex_handler(const struct shell *sh, size_t argc, char **argv)
{
	const struct shell_cmd *cmd = shell_cmd_lookup("upload_hex");
	if (!cmd) {
		shell_error(sh, "Command not found");
		return -ENOENT;
	}

	int ret = shell_exec_command(cmd, argc, argv, true);
	if (ret != 0) {
		shell_error(sh, "Command failed with code %d", ret);
	}

	return ret;
}

/**
 * @brief Shell command handler - run (bytecode VM)
 */
static int shell_run_handler(const struct shell *sh, size_t argc, char **argv)
{
	const struct shell_cmd *cmd = shell_cmd_lookup("run");
	if (!cmd) {
		shell_error(sh, "Command not found");
		return -ENOENT;
	}

	int ret = shell_exec_command(cmd, argc, argv, true);
	if (ret != 0) {
		shell_error(sh, "Command failed with code %d", ret);
	}

	return ret;
}

/**
 * @brief Shell command handler - rm (bytecode VM)
 */
static int shell_rm_handler(const struct shell *sh, size_t argc, char **argv)
{
	const struct shell_cmd *cmd = shell_cmd_lookup("rm");
	if (!cmd) {
		shell_error(sh, "Command not found");
		return -ENOENT;
	}

	int ret = shell_exec_command(cmd, argc, argv, true);
	if (ret != 0) {
		shell_error(sh, "Command failed with code %d", ret);
	}

	return ret;
}

/* Generic handler macro to reduce boilerplate */
#define DEFINE_SHELL_HANDLER(_handler_name, _cmd_name) \
static int _handler_name(const struct shell *sh, size_t argc, char **argv) \
{ \
	const struct shell_cmd *cmd = shell_cmd_lookup(_cmd_name); \
	if (!cmd) { \
		shell_error(sh, "Command not found"); \
		return -ENOENT; \
	} \
	int ret = shell_exec_command(cmd, argc, argv, true); \
	if (ret != 0 && ret != -EINVAL) { \
		shell_error(sh, "Command failed with code %d", ret); \
	} \
	return ret; \
}

DEFINE_SHELL_HANDLER(shell_mkdir_handler, "mkdir")
DEFINE_SHELL_HANDLER(shell_cat_handler, "cat")
DEFINE_SHELL_HANDLER(shell_uptime_handler, "uptime")
DEFINE_SHELL_HANDLER(shell_mem_handler, "mem")
DEFINE_SHELL_HANDLER(shell_free_handler, "free")
DEFINE_SHELL_HANDLER(shell_clear_handler, "clear")
DEFINE_SHELL_HANDLER(shell_version_handler, "version")
DEFINE_SHELL_HANDLER(shell_date_handler, "date")
DEFINE_SHELL_HANDLER(shell_kill_handler, "kill")
DEFINE_SHELL_HANDLER(shell_benchmark_handler, "benchmark")
DEFINE_SHELL_HANDLER(shell_stress_handler, "stress")
DEFINE_SHELL_HANDLER(shell_reboot_handler, "reboot")
DEFINE_SHELL_HANDLER(shell_fork_handler, "fork")
/* loop runs in background so Ctrl+D can be processed */
static int shell_loop_handler(const struct shell *sh, size_t argc, char **argv)
{
	const struct shell_cmd *cmd = shell_cmd_lookup("loop");
	if (!cmd) {
		shell_error(sh, "Command not found");
		return -ENOENT;
	}
	/* Run loop in BACKGROUND (false) so shell can handle Ctrl+D */
	int ret = shell_exec_command(cmd, argc, argv, false);
	if (ret != 0 && ret != -EINVAL) {
		shell_error(sh, "Command failed with code %d", ret);
	}
	return ret;
}
DEFINE_SHELL_HANDLER(shell_sigint_handler, "sigint")
DEFINE_SHELL_HANDLER(shell_test_signal_handler, "test_signal")
DEFINE_SHELL_HANDLER(shell_fg_handler, "fg")
DEFINE_SHELL_HANDLER(shell_suspend_handler, "suspend")

/* Register shell commands - these bridge to our process-based execution */
SHELL_CMD_ARG_REGISTER(hello, NULL, "Print hello message (runs in new process)",
                       shell_hello_handler, 1, 10);
SHELL_CMD_ARG_REGISTER(echo, NULL, "Echo arguments (runs in new process)",
                       shell_echo_handler, 1, 10);
SHELL_CMD_ARG_REGISTER(ps, NULL, "List processes (runs in new process)",
                       shell_ps_handler, 1, 0);
SHELL_CMD_ARG_REGISTER(fg, NULL, "Resume suspended foreground process",
                       shell_fg_handler, 1, 0);
SHELL_CMD_ARG_REGISTER(suspend, NULL, "Suspend foreground process (like Ctrl+Z)",
                       shell_suspend_handler, 1, 0);
SHELL_CMD_ARG_REGISTER(getpid, NULL, "Show process ID (runs in new process)",
                       shell_getpid_handler, 1, 0);
SHELL_CMD_ARG_REGISTER(info, NULL, "Show process info (runs in new process)",
                       shell_info_handler, 1, 0);
SHELL_CMD_ARG_REGISTER(sleep, NULL, "Sleep for milliseconds (runs in new process)",
                       shell_sleep_handler, 2, 0);
SHELL_CMD_ARG_REGISTER(test, NULL, "Process creation test (runs in new process)",
                       shell_test_handler, 1, 0);
SHELL_CMD_ARG_REGISTER(prochelp, NULL, "Show process commands (runs in new process)",
                       shell_help_handler, 1, 0);
SHELL_CMD_ARG_REGISTER(uptime, NULL, "Show system uptime",
                       shell_uptime_handler, 1, 0);
SHELL_CMD_ARG_REGISTER(mem, NULL, "Show memory information",
                       shell_mem_handler, 1, 0);
SHELL_CMD_ARG_REGISTER(free, NULL, "Show free memory",
                       shell_free_handler, 1, 0);
SHELL_CMD_ARG_REGISTER(clear, NULL, "Clear screen",
                       shell_clear_handler, 1, 0);
SHELL_CMD_ARG_REGISTER(version, NULL, "Show system version",
                       shell_version_handler, 1, 0);
SHELL_CMD_ARG_REGISTER(date, NULL, "Show current tick count",
                       shell_date_handler, 1, 0);
SHELL_CMD_ARG_REGISTER(kill, NULL, "Terminate a process by PID",
                       shell_kill_handler, 2, 0);
SHELL_CMD_ARG_REGISTER(benchmark, NULL, "Run CPU benchmark",
                       shell_benchmark_handler, 1, 1);
SHELL_CMD_ARG_REGISTER(stress, NULL, "Stress test process creation",
                       shell_stress_handler, 1, 1);
SHELL_CMD_ARG_REGISTER(reboot, NULL, "Reboot the system",
                       shell_reboot_handler, 1, 0);
SHELL_CMD_ARG_REGISTER(loop, NULL, "Infinite loop for signal testing",
                       shell_loop_handler, 1, 1);
SHELL_CMD_ARG_REGISTER(sigint, NULL, "Send SIGINT to foreground process",
                       shell_sigint_handler, 1, 0);
SHELL_CMD_ARG_REGISTER(test_signal, NULL, "Self-test signal delivery",
                       shell_test_signal_handler, 1, 0);

SHELL_CMD_ARG_REGISTER(mkdir, NULL, "Create VFS directory",
                       shell_mkdir_handler, 2, 0);
SHELL_CMD_ARG_REGISTER(cat, NULL, "Print VFS file",
                       shell_cat_handler, 2, 0);

/* Bytecode VM shell commands */
SHELL_CMD_ARG_REGISTER(ls, NULL, "List programs and commands",
                       shell_ls_handler, 1, 10);
SHELL_CMD_ARG_REGISTER(upload, NULL, "Upload bytecode program",
                       shell_upload_handler, 3, 0);
SHELL_CMD_ARG_REGISTER(upload_hex, NULL, "Upload bytecode from hex string",
                       shell_upload_hex_handler, 3, 0);
SHELL_CMD_ARG_REGISTER(run, NULL, "Execute bytecode program",
                       shell_run_handler, 2, 0);
SHELL_CMD_ARG_REGISTER(rm, NULL, "Delete bytecode program",
                       shell_rm_handler, 2, 0);
SHELL_CMD_ARG_REGISTER(fork, NULL, "Fork child processes",
                       shell_fork_handler, 1, 2);

/**
 * @brief Main application entry point
 */
int main(void)
{
	printk("\n");
	printk("========================================\n");
	printk("  AS32X601 Shell with Process Support\n");
	printk("  Based on Embox process model\n");
	printk("========================================\n");
	printk("\n");

	/* Get init process info */
	struct z_process *init_proc = process_current();
	if (init_proc) {
		printk("Init process PID: %d\n", init_proc->pid);
	} else {
		printk("Warning: No init process found\n");
	}

	printk("\n");
	printk("Available commands:\n");
	printk("  echo      - Echo arguments\n");
	printk("  version   - Show system version\n");
	printk("  uptime    - Show system uptime\n");
	printk("  mem       - Show memory information\n");
	printk("  free      - Show free memory\n");
	printk("  benchmark - Run CPU benchmark\n");
	printk("  ps        - List processes\n");
	printk("  fg        - Resume suspended foreground process\n");
	printk("  hello     - Print hello message\n");
	printk("  getpid    - Show process ID\n");
	printk("  info      - Show process info\n");
	printk("  sleep     - Sleep for milliseconds\n");
	printk("  test      - Process creation test\n");
	printk("  kill      - Terminate a process\n");
	printk("  stress    - Stress test process creation\n");
	printk("  fork      - Fork child processes\n");
	printk("  loop      - Loop for signal testing (Ctrl+D to suspend, Ctrl+C to stop)\n");
	printk("  sigint    - Send SIGINT to foreground process\n");
	printk("  test_signal - Self-test signal delivery\n");
	printk("  clear     - Clear screen\n");
	printk("  date      - Show current tick count\n");
	printk("  reboot    - Reboot the system\n");
	printk("\n");
	printk("Each command runs in a separate process.\n");
	printk("Run 'test_signal' to verify signal delivery works.\n");
	printk("Press Ctrl+C to send SIGINT to foreground process.\n");
	printk("Press Ctrl+D to suspend foreground process (use 'fg' to resume).\n");
	printk("Run 'test_signal' to verify signal delivery works.\n");
	printk("Press Ctrl+C to send SIGINT to foreground process.\n");
	printk("\n");

	/* Return to let Zephyr shell handle input */
	return 0;
}
```

## src/anl_loader.c
```c
#include <zephyr/kernel.h>
#include <string.h>
#include "anl_loader.h"

/* CRC-32 (IEEE 802.3) */
static uint32_t crc32(const uint8_t *buf, size_t len)
{
    uint32_t crc = 0xFFFFFFFFU;
    for (size_t i = 0; i < len; i++) {
        crc ^= buf[i];
        for (int j = 0; j < 8; j++)
            crc = (crc >> 1) ^ (0xEDB88320U & -(crc & 1));
    }
    return ~crc;
}

int anl_validate(const uint8_t *buf, size_t len)
{
    if (len < sizeof(AnlFileHeader)) return -1;
    const AnlFileHeader *fh = (const AnlFileHeader *)buf;
    if (fh->magic != ANL_MAGIC) return -2;
    if (fh->version != ANL_VERSION) return -3;
    if (fh->file_size > len) return -4;

    /* CRC check: compute with crc32 field zeroed */
    uint8_t tmp[sizeof(uint32_t)];
    memcpy(tmp, &fh->crc32, 4);
    uint32_t stored = fh->crc32;
    /* We can't modify buf (const), so compute in two parts */
    uint32_t crc = 0xFFFFFFFFU;
    size_t crc_off = offsetof(AnlFileHeader, crc32);
    for (size_t i = 0; i < fh->file_size; i++) {
        uint8_t b = (i >= crc_off && i < crc_off + 4) ? 0 : buf[i];
        crc ^= b;
        for (int j = 0; j < 8; j++)
            crc = (crc >> 1) ^ (0xEDB88320U & -(crc & 1));
    }
    crc = ~crc;
    if (crc != stored) return -5;
    return 0;
}

const uint8_t *anl_section(const uint8_t *buf, uint16_t sh_type, uint32_t *out_size)
{
    const AnlFileHeader *fh = (const AnlFileHeader *)buf;
    const AnlSectionHeader *sh = (const AnlSectionHeader *)(buf + sizeof(AnlFileHeader));
    for (int i = 0; i < fh->shnum; i++) {
        if (sh[i].sh_type == sh_type) {
            if (out_size) *out_size = sh[i].sh_size;
            return buf + sh[i].sh_offset;
        }
    }
    return NULL;
}

static const AnlSectionHeader *get_shdr(const uint8_t *buf, int idx)
{
    const AnlFileHeader *fh = (const AnlFileHeader *)buf;
    if (idx < 0 || idx >= fh->shnum) return NULL;
    return (const AnlSectionHeader *)(buf + sizeof(AnlFileHeader)) + idx;
}

int anl_load(const char *name, const uint8_t *buf, size_t len)
{
    int ret = anl_validate(buf, len);
    if (ret) {
        printk("anl_load[%s]: validate failed %d\n", name, ret);
        return ret;
    }

    const AnlFileHeader *fh = (const AnlFileHeader *)buf;
    const AnlSectionHeader *shdrs = (const AnlSectionHeader *)(buf + sizeof(AnlFileHeader));

    /* Calculate total alloc size for SHF_ALLOC sections */
    uint32_t total = 0;
    for (int i = 0; i < fh->shnum; i++) {
        if (shdrs[i].sh_flags & SHF_ALLOC)
            total += shdrs[i].sh_size;
    }

    /* Allocate aligned memory (RISC-V requires 4-byte alignment, use 8 for safety) */
    uint8_t *mem = k_aligned_alloc(8, total);
    if (!mem) {
        printk("anl_load[%s]: OOM (%u bytes)\n", name, total);
        return -ENOMEM;
    }
    memset(mem, 0, total);

    printk("anl_load[%s]: allocated %u bytes at 0x%08x (aligned)\n",
           name, total, (unsigned)mem);

    /* Map section index -> runtime base address */
    uintptr_t sec_base[16] = {0};
    uint32_t off = 0;
    for (int i = 0; i < fh->shnum && i < 16; i++) {
        if (shdrs[i].sh_flags & SHF_ALLOC) {
            sec_base[i] = (uintptr_t)(mem + off);
            if (shdrs[i].sh_type != SHT_BSS)
                memcpy(mem + off, buf + shdrs[i].sh_offset, shdrs[i].sh_size);
            off += shdrs[i].sh_size;
        }
    }

    /* Find CODE section base */
    uintptr_t code_base = 0;
    for (int i = 0; i < fh->shnum && i < 16; i++) {
        if (shdrs[i].sh_type == SHT_CODE) { code_base = sec_base[i]; break; }
    }

    /* Process RELA sections */
    for (int i = 0; i < fh->shnum; i++) {
        if (shdrs[i].sh_type != SHT_RELA) continue;
        const AnlRelaEntry *relas = (const AnlRelaEntry *)(buf + shdrs[i].sh_offset);
        uint32_t nrela = shdrs[i].sh_size / sizeof(AnlRelaEntry);
        int symtab_idx = shdrs[i].sh_link;
        const AnlSectionHeader *symsh = get_shdr(buf, symtab_idx);
        if (!symsh) continue;
        const AnlSymEntry *syms = (const AnlSymEntry *)(buf + symsh->sh_offset);
        const AnlSectionHeader *strsh = get_shdr(buf, symsh->sh_link);
        const char *strtab = strsh ? (const char *)(buf + strsh->sh_offset) : NULL;

        for (uint32_t r = 0; r < nrela; r++) {
            uint32_t sym_idx = relas[r].r_info >> 8;
            uint8_t  r_type  = relas[r].r_info & 0xFF;
            const AnlSymEntry *sym = &syms[sym_idx];

            uintptr_t S = 0;
            if (sym->st_shndx == ANL_SHNDX_UNDEF) {
                /* Dynamic symbol lookup */
                const char *sname = strtab ? strtab + sym->st_name : "";
                for (int e = 0; e < _anl_exports_count; e++) {
                    if (strcmp(_anl_exports[e].name, sname) == 0) {
                        S = _anl_exports[e].addr;
                        break;
                    }
                }
                if (!S) {
                    printk("anl_load[%s]: unresolved symbol '%s'\n", name, sname);
                    k_free(mem);
                    return -ENOENT;
                }
            } else if (sym->st_shndx < 16) {
                S = sec_base[sym->st_shndx] + sym->st_value;
            }

            /* Patch location is relative to CODE section —
             * RV32C compressed instructions mean 32-bit insns can sit at
             * 2-byte aligned addresses, so use memcpy for all access. */
            uint8_t *patch_ptr = (uint8_t *)(code_base + relas[r].r_offset);
            int32_t   A     = relas[r].r_addend;
            uintptr_t P     = (uintptr_t)patch_ptr;

            printk("  rela[%u] type=%u sym=%u S=0x%08x P=0x%08x A=%d\n",
                   r, r_type, sym_idx, (unsigned)S, (unsigned)P, A);

            uint32_t orig;
            memcpy(&orig, patch_ptr, 4);

            uint32_t val = orig;
            switch (r_type) {
            case R_ANL_32:
            case R_ANL_ABS32:
                val = (uint32_t)(S + A);
                memcpy(patch_ptr, &val, 4);
                break;
            case R_ANL_PC32:
                val = (uint32_t)(S + A - P);
                memcpy(patch_ptr, &val, 4);
                break;
            case R_ANL_THM_CALL: {
                /* ARM Thumb BL: encode 26-bit offset into two 16-bit halfwords */
                int32_t offset = (int32_t)(S + A - P - 4);
                uint32_t s  = (offset >> 24) & 1;
                uint32_t i1 = (offset >> 23) & 1;
                uint32_t i2 = (offset >> 22) & 1;
                uint32_t j1 = (~(i1 ^ s)) & 1;
                uint32_t j2 = (~(i2 ^ s)) & 1;
                uint32_t imm10 = (offset >> 12) & 0x3FF;
                uint32_t imm11 = (offset >> 1)  & 0x7FF;
                uint16_t hw0 = (uint16_t)(0xF000 | (s << 10) | imm10);
                uint16_t hw1 = (uint16_t)(0xF800 | (j1 << 13) | (j2 << 11) | imm11);
                memcpy(patch_ptr, &hw0, 2);
                memcpy(patch_ptr + 2, &hw1, 2);
                break;
            }
            case R_ANL_HI20: {
                /* RISC-V LUI: upper 20 bits in [31:12] */
                uint32_t hi = (uint32_t)((S + A + 0x800) >> 12) & 0xFFFFF;
                val = (orig & 0xFFF) | (hi << 12);
                memcpy(patch_ptr, &val, 4);
                break;
            }
            case R_ANL_LO12_I: {
                /* RISC-V I-type: 12-bit signed immediate in [31:20] */
                uint32_t lo = (uint32_t)(S + A) & 0xFFF;
                val = (orig & 0x000FFFFF) | (lo << 20);
                memcpy(patch_ptr, &val, 4);
                break;
            }
            case R_ANL_CALL: {
                /* RISC-V CALL: AUIPC + JALR pair */
                int32_t offset = (int32_t)(S + A - P);
                int32_t hi = (offset + 0x800) >> 12;
                int32_t lo = offset & 0xFFF;

                /* Patch AUIPC */
                uint32_t auipc;
                memcpy(&auipc, patch_ptr, 4);
                uint32_t orig_auipc = auipc;
                auipc = (auipc & 0xFFF) | ((hi & 0xFFFFF) << 12);
                memcpy(patch_ptr, &auipc, 4);

                /* Patch JALR */
                uint32_t jalr;
                memcpy(&jalr, patch_ptr + 4, 4);
                uint32_t orig_jalr = jalr;
                jalr = (jalr & 0x000FFFFF) | ((lo & 0xFFF) << 20);
                memcpy(patch_ptr + 4, &jalr, 4);

                printk("    CALL: offset=0x%x hi=0x%x lo=0x%x\n", offset, hi, lo);
                printk("    auipc: 0x%08x -> 0x%08x\n", orig_auipc, auipc);
                printk("    jalr:  0x%08x -> 0x%08x\n", orig_jalr, jalr);
                break;
            }
            default:
                printk("anl_load[%s]: unknown reloc type %d\n", name, r_type);
                break;
            }

            uint32_t patched;
            memcpy(&patched, patch_ptr, 4);
            printk("    patched: 0x%08x -> 0x%08x\n", orig, patched);
        }
    }

    /* Jump to entry */
    uintptr_t entry = code_base + fh->entry_off;
    printk("anl_load[%s]: jumping to entry 0x%08x\n", name, (unsigned)entry);

    /* Debug: print first few instructions */
    uint32_t *code = (uint32_t *)code_base;
    printk("  code[0]=0x%08x code[1]=0x%08x code[2]=0x%08x\n",
           code[0], code[1], code[2]);
    printk("  code[3]=0x%08x code[4]=0x%08x code[5]=0x%08x\n",
           code[3], code[4], code[5]);

    /* Ensure all writes are visible before execution:
     * fence   - complete all prior stores (data ordering)
     * fence.i - flush I-cache so instruction fetch sees new code */
    __asm__ volatile ("fence" ::: "memory");
    __asm__ volatile ("fence.i" ::: "memory");

    /* Set Thumb bit for ARM, no modification for RISC-V */
    if (fh->arch == ANL_ARCH_THUMB2) {
        entry |= 1;  /* ARM Thumb mode requires LSB set */
    }

    void (*fn)(void) = (void (*)(void))entry;
    fn();

    /* Note: mem is intentionally not freed here because spawned child
     * threads may still be executing code from this module. */
    return 0;
}
```

## src/commands.c
```c
/*
 * Copyright (c) 2024 OneWo-rtLinux Team
 *
 * SPDX-License-Identifier: Apache-2.0
 *
 * Sample shell commands
 */

#include <zephyr/kernel.h>
#include <zephyr/kernel/process.h>
#include <zephyr/sys/reboot.h>
#include <zephyr/version.h>
#include <stdio.h>
#include <string.h>
#include <stdlib.h>
#include "shell_process.h"
#include "anl_loader.h"
#include "signal.h"

/**
 * @brief Hello command - prints greeting with process info
 */
static int cmd_hello(int argc, char **argv)
{
	struct z_process *proc = process_current();

	if (!proc) {
		printk("Hello from unknown process (proc is NULL)!\n");
		return 0;
	}

	/* Validate process structure before accessing */
	if ((uintptr_t)proc < 0x20000000 || (uintptr_t)proc > 0x20080000) {
		printk("Hello from invalid process (proc=%p)!\n", proc);
		return 0;
	}

	pid_t my_pid = proc->pid;
	printk("Hello from process PID %d!\n", my_pid);

	if (argc > 1) {
		printk("Arguments: ");
		for (int i = 1; i < argc; i++) {
			printk("%s ", argv[i]);
		}
		printk("\n");
	}

	return 0;
}

/**
 * @brief Echo command - echoes arguments
 */
static int cmd_echo(int argc, char **argv)
{
	for (int i = 1; i < argc; i++) {
		printk("%s", argv[i]);
		if (i < argc - 1) {
			printk(" ");
		}
	}
	printk("\n");

	return 0;
}

/**
 * @brief PS command - list processes (simplified)
 */
static int cmd_ps(int argc, char **argv)
{
	printk("PID  PPID  STATE       NAME\n");
	for (int i = 0; i < CONFIG_MAX_PROCESS_COUNT; i++) {
		struct z_process *proc = process_get(i);
		if (proc && proc->pid > 0) {
			const char *state = "running";
			if (signal_is_suspended(proc->pid) > 0) {
				state = "suspended";
			}
			printk("%-4d %-4d  %-10s  (pid slot %d)\n",
			       proc->pid,
			       proc->parent ? proc->parent->pid : 0,
			       state,
			       i);
		}
	}

	pid_t suspended_pid = signal_get_suspended_fg_pid();
	if (suspended_pid > 0) {
		printk("\nSuspended foreground process: %d (use 'fg' to resume)\n", suspended_pid);
	}

	return 0;
}

/**
 * @brief FG command - resume suspended foreground process
 */
static int cmd_fg(int argc, char **argv)
{
	pid_t suspended_pid = signal_get_suspended_fg_pid();

	if (suspended_pid <= 0) {
		printk("No suspended foreground process\n");
		return 0;
	}

	printk("Resuming process PID=%d...\n", suspended_pid);
	int ret = signal_resume_process(suspended_pid);

	if (ret == 0) {
		printk("Process %d resumed and brought to foreground\n", suspended_pid);
	} else {
		printk("Failed to resume process %d: %d\n", suspended_pid, ret);
	}

	return ret;
}

/**
 * @brief Suspend command - send SIGTSTP to foreground process
 * Alternative to Ctrl+D for shell environments without raw terminal input
 */
static int cmd_suspend(int argc, char **argv)
{
	pid_t fg_pgid = signal_get_foreground_pgid();

	if (fg_pgid <= 0) {
		printk("No foreground process to suspend\n");
		return 0;
	}

	printk("Sending SIGTSTP to foreground process PID=%d...\n", fg_pgid);
	int ret = kill(fg_pgid, SIGTSTP);

	if (ret == 0) {
		printk("Signal sent successfully. Use 'fg' to resume.\n");
	} else {
		printk("Failed to send signal: %d\n", ret);
	}

	return ret;
}

/**
 * @brief Sleep command - sleeps for specified milliseconds
 */
static int cmd_sleep(int argc, char **argv)
{
	if (argc < 2) {
		printk("Usage: sleep <milliseconds>\n");
		return -EINVAL;
	}

	int ms = atoi(argv[1]);
	if (ms <= 0) {
		printk("Invalid sleep time: %s\n", argv[1]);
		return -EINVAL;
	}

	printk("Sleeping for %d ms in PID %d...\n",
	       ms, process_current() ? process_current()->pid : -1);
	k_msleep(ms);
	printk("Woke up!\n");

	return 0;
}

/**
 * @brief Test command - stress test for process creation
 */
static int cmd_test(int argc, char **argv)
{
	struct z_process *proc = process_current();

	printk("Test command running in PID %d\n", proc ? proc->pid : -1);
	printk("Creating 3 child processes...\n");

	for (int i = 0; i < 3; i++) {
		struct z_process *child = process_create(proc);
		if (child) {
			printk("  Created child process PID %d\n", child->pid);
			/* Clean up immediately for test */
			process_exit(child, 0);
		} else {
			printk("  Failed to create child %d\n", i);
		}
	}

	return 0;
}

/**
 * @brief Getpid command - print current process ID
 */
static int cmd_getpid(int argc, char **argv)
{
	struct z_process *proc = process_current();
	printk("Current PID: %d\n", proc ? proc->pid : -1);

	if (proc && proc->parent) {
		printk("Parent PID: %d\n", proc->parent->pid);
	}

	return 0;
}

/**
 * @brief Info command - print process information
 */
static int cmd_info(int argc, char **argv)
{
	struct z_process *proc = process_current();

	if (!proc) {
		printk("No current process!\n");
		return -ESRCH;
	}

	printk("Process Information:\n");
	printk("  PID: %d\n", proc->pid);
	printk("  Parent PID: %d\n", proc->parent ? proc->parent->pid : 0);
	printk("  Main thread: %p\n", proc->main_thread);
	printk("  Ref count: %ld\n", (long)atomic_get(&proc->ref_count));
	printk("  Exit code: %d\n", proc->exit_code);

	return 0;
}

/**
 * @brief Uptime command - show system uptime
 */
static int cmd_uptime(int argc, char **argv)
{
	int64_t uptime_ms = k_uptime_get();
	int64_t uptime_sec = uptime_ms / 1000;
	int hours = uptime_sec / 3600;
	int minutes = (uptime_sec % 3600) / 60;
	int seconds = uptime_sec % 60;

	printk("System uptime: %d hours, %d minutes, %d seconds\n",
	       hours, minutes, seconds);
	printk("Uptime (ms): %lld\n", uptime_ms);

	return 0;
}

/**
 * @brief Memory command - show memory usage information
 */
static int cmd_mem(int argc, char **argv)
{
	struct z_process *proc = process_current();

	printk("Memory Information:\n");

	if (proc) {
		printk("  Current Process PID: %d\n", proc->pid);
		if (proc->main_thread) {
			printk("  Main thread: %p\n", proc->main_thread);
		}
	}

#ifdef CONFIG_HEAP_MEM_POOL_SIZE
	printk("  Heap configured: %d bytes\n", CONFIG_HEAP_MEM_POOL_SIZE);
#endif

	return 0;
}

/**
 * @brief Clear command - clear screen (send ANSI escape codes)
 */
static int cmd_clear(int argc, char **argv)
{
	printk("\033[2J\033[H");
	return 0;
}

/**
 * @brief Version command - show system version
 */
static int cmd_version(int argc, char **argv)
{
	printk("OneWo-zepLinux\n");
	printk("Kernel version: %s\n", KERNEL_VERSION_STRING);
	printk("Board: as32x601_evb\n");
	printk("Architecture: RISC-V\n");

	return 0;
}

/**
 * @brief Reboot command - reboot the system
 */
static int cmd_reboot(int argc, char **argv)
{
	printk("Rebooting system...\n");
	k_msleep(100); /* Give time for message to be printed */

#ifdef CONFIG_REBOOT
	sys_reboot(SYS_REBOOT_COLD);
#else
	printk("Reboot not supported on this platform\n");
#endif
	return 0;
}

/**
 * @brief Date command - show current tick count
 */
static int cmd_date(int argc, char **argv)
{
	int64_t cycles = k_cycle_get_64();
	int64_t uptime_ms = k_uptime_get();

	printk("System ticks: %lld\n", k_uptime_ticks());
	printk("System cycles: %lld\n", cycles);
	printk("Uptime (ms): %lld\n", uptime_ms);

	return 0;
}

/**
 * @brief Free command - show free memory (simplified)
 */
static int cmd_free(int argc, char **argv)
{
	printk("Memory Usage (simplified):\n");

#ifdef CONFIG_HEAP_MEM_POOL_SIZE
	printk("  Total heap: %d bytes\n", CONFIG_HEAP_MEM_POOL_SIZE);
#else
	printk("  Heap not configured\n");
#endif

	/* Show stack usage if available */
	struct z_process *proc = process_current();
	if (proc && proc->main_thread) {
		size_t unused;
		int ret = k_thread_stack_space_get(proc->main_thread, &unused);
		if (ret == 0) {
			printk("  Thread stack unused: %zu bytes\n", unused);
		}
	}

	return 0;
}

/**
 * @brief Kill command - terminate a process by PID
 */
static int cmd_kill(int argc, char **argv)
{
	if (argc < 2) {
		printk("Usage: kill <pid>\n");
		return -EINVAL;
	}

	pid_t target_pid = atoi(argv[1]);

	if (target_pid == PID_INIT) {
		printk("Cannot kill init process!\n");
		return -EPERM;
	}

	struct z_process *proc = process_current();
	if (proc && proc->pid == target_pid) {
		printk("Terminating current process PID %d...\n", target_pid);
		process_exit(proc, 0);
		return 0;
	}

	printk("Process %d not found or not accessible\n", target_pid);
	return -ESRCH;
}

/**
 * @brief Benchmark command - simple CPU benchmark
 */
static int cmd_benchmark(int argc, char **argv)
{
	int iterations = 10000;

	if (argc > 1) {
		iterations = atoi(argv[1]);
		if (iterations <= 0 || iterations > 1000000) {
			printk("Invalid iterations. Using default (10000)\n");
			iterations = 10000;
		}
	}

	printk("Running benchmark with %d iterations...\n", iterations);

	int64_t start = k_uptime_get();
	volatile uint32_t sum = 0;

	for (int i = 0; i < iterations; i++) {
		sum += i * i;
	}

	int64_t end = k_uptime_get();
	int64_t elapsed = end - start;

	printk("Completed in %lld ms\n", elapsed);
	printk("Result: %u (to prevent optimization)\n", sum);

	return 0;
}

/**
 * @brief Stress command - create multiple processes rapidly
 */
static int cmd_stress(int argc, char **argv)
{
	int count = 5;

	if (argc > 1) {
		count = atoi(argv[1]);
		if (count <= 0 || count > 20) {
			printk("Count must be between 1 and 20\n");
			return -EINVAL;
		}
	}

	struct z_process *proc = process_current();
	if (!proc) {
		printk("No current process!\n");
		return -ESRCH;
	}

	printk("Creating %d processes rapidly...\n", count);
	int success = 0;
	int64_t start = k_uptime_get();

	for (int i = 0; i < count; i++) {
		struct z_process *child = process_create(proc);
		if (child) {
			success++;
			process_exit(child, 0);
		}
		k_msleep(10); /* Small delay */
	}

	int64_t elapsed = k_uptime_get() - start;
	printk("Created %d/%d processes in %lld ms\n", success, count, elapsed);

	return 0;
}

/**
 * @brief Fork command - spawn child processes (like QEMU fork demo)
 * Usage: fork [nchildren] [iterations]
 */
struct fork_arg {
	int id;
	int iterations;
};

static void *fork_child_main(void *arg)
{
	struct fork_arg *fa = (struct fork_arg *)arg;
	int id = fa->id;
	int iters = fa->iterations;

	printk("[child %d] started, PID=%d, parent PID=%d\n",
	       id,
	       process_current()->pid,
	       process_current()->parent ? process_current()->parent->pid : 0);

	for (int i = 0; i < iters; i++) {
		printk("[child %d] iteration %d/%d\n", id, i + 1, iters);
		k_msleep(500);
	}

	printk("[child %d] done\n", id);
	return (void *)(intptr_t)id;
}

static int cmd_fork(int argc, char **argv)
{
	int nchildren = 1;
	int iterations = 3;

	if (argc >= 2) nchildren = atoi(argv[1]);
	if (argc >= 3) iterations = atoi(argv[2]);

	if (nchildren < 1 || nchildren > 4) {
		printk("usage: fork <nchildren 1-4> [iterations]\n");
		return -EINVAL;
	}

	printk("[parent] PID=%d, forking %d child(ren), %d iterations each\n",
	       process_current()->pid, nchildren, iterations);

	static struct fork_arg fork_args[4];
	pid_t pids[4];

	for (int i = 0; i < nchildren; i++) {
		fork_args[i].id = i + 1;
		fork_args[i].iterations = iterations;
		char name[16];
		snprintf(name, sizeof(name), "child_%d", i + 1);
		pids[i] = new_task(name, fork_child_main, &fork_args[i]);
		if (pids[i] < 0) {
			printk("[parent] failed to fork child %d: %d\n", i + 1, pids[i]);
		} else {
			printk("[parent] forked child %d with PID=%d\n", i + 1, pids[i]);
		}
	}

	for (int i = 0; i < nchildren; i++) {
		if (pids[i] < 0) continue;
		int status = 0;
		pid_t ret = waitpid(pids[i], &status, 0);
		printk("[parent] child PID=%d exited with status=%d\n", ret, status);
	}

	printk("[parent] all children done\n");
	return 0;
}

/**
 * @brief Help command - list available commands
 */
static int cmd_help(int argc, char **argv)
{
	printk("Available commands:\n");
	printk("  help       - Show this help message\n");
	printk("  hello      - Print hello message\n");
	printk("  echo       - Echo arguments\n");
	printk("  ps         - List processes\n");
	printk("  getpid     - Show current process ID\n");
	printk("  info       - Show detailed process info\n");
	printk("  sleep      - Sleep for specified milliseconds\n");
	printk("  test       - Run process creation test\n");
	printk("  uptime     - Show system uptime\n");
	printk("  mem        - Show memory information\n");
	printk("  free       - Show free memory\n");
	printk("  clear      - Clear screen\n");
	printk("  version    - Show system version\n");
	printk("  date       - Show current tick count\n");
	printk("  kill       - Terminate a process by PID\n");
	printk("  benchmark  - Run CPU benchmark\n");
	printk("  stress     - Stress test process creation\n");
	printk("  reboot     - Reboot the system\n");
	printk("  upload_hex - Upload ANL binary via hex string\n");
	printk("  load       - Load ANL binary (alias for upload_hex)\n");
	printk("  fork       - Fork child processes\n");
	printk("  loop       - Infinite loop for signal testing\n");
	printk("  sigint     - Send SIGINT to foreground process\n");

	return 0;
}

/* Exported symbols for ANL loader */
static void anl_printk_wrapper(const char *fmt)
{
	printk("%s", fmt);
}

const struct anl_export _anl_exports[] = {
	{ "printk",          (uintptr_t)anl_printk_wrapper },
	{ "k_msleep",        (uintptr_t)k_msleep },
	{ "new_task",        (uintptr_t)new_task },
	{ "waitpid",         (uintptr_t)waitpid },
	{ "process_current", (uintptr_t)process_current },
};
const int _anl_exports_count = 5;

static uint8_t anl_buf[8192];

static int hex_nibble(char c)
{
	if (c >= '0' && c <= '9') return c - '0';
	if (c >= 'a' && c <= 'f') return c - 'a' + 10;
	if (c >= 'A' && c <= 'F') return c - 'A' + 10;
	return -1;
}

/**
 * @brief Upload hex command - upload ANL binary via hex string
 * Usage: upload_hex <name> <hexdata>
 */
static int cmd_upload_hex(int argc, char **argv)
{
	if (argc < 3) {
		printk("Usage: upload_hex <name> <hexdata>\n");
		return -EINVAL;
	}

	char *name = argv[1];
	char *hex = argv[2];

	size_t hexlen = strlen(hex);
	if (hexlen & 1) {
		printk("Error: odd hex length\n");
		return -EINVAL;
	}

	size_t binlen = hexlen / 2;
	if (binlen > sizeof(anl_buf)) {
		printk("Error: too large (max %zu bytes)\n", sizeof(anl_buf));
		return -EINVAL;
	}

	/* Convert hex to binary */
	for (size_t i = 0; i < binlen; i++) {
		int hi = hex_nibble(hex[i*2]);
		int lo = hex_nibble(hex[i*2+1]);
		if (hi < 0 || lo < 0) {
			printk("Error: bad hex at position %zu\n", i*2);
			return -EINVAL;
		}
		anl_buf[i] = (uint8_t)((hi << 4) | lo);
	}

	printk("Loaded %zu bytes, running '%s'...\n", binlen, name);
	int ret = anl_load(name, anl_buf, binlen);
	printk("anl_load returned %d\n", ret);

	return ret;
}

/**
 * @brief Load command - alias for upload_hex
 */
static int cmd_load(int argc, char **argv)
{
	return cmd_upload_hex(argc, argv);
}

/**
 * @brief Loop command - infinite loop for signal testing
 * Sets itself as foreground and loops until interrupted by signal
 */
static int cmd_loop(int argc, char **argv)
{
	struct z_process *proc = process_current();

	/* Parse duration argument (default 10 seconds) */
	int duration_sec = 10;
	if (argc > 1) {
		duration_sec = atoi(argv[1]);
		if (duration_sec <= 0) duration_sec = 10;
	}

	printk("Loop started (PID %d). Running for %d seconds...\n", proc->pid, duration_sec);
	printk("[loop] Press Ctrl+D to suspend, or Ctrl+C to interrupt\n");

	/* Set this process as foreground to receive signals */
	signal_set_foreground_pgid(proc->pid);

	/* Install signal handler */
	volatile int interrupted = 0;
	void handler(int sig) {
		interrupted = 1;
		printk("\nLoop interrupted by signal %d\n", sig);
	}
	signal(SIGINT, handler);

	/* Loop for specified duration or until signal received */
	int count = 0;
	int max_count = duration_sec * 100;  /* 10ms per iteration */
	while (!interrupted && count < max_count) {
		if (count % 100 == 0) {
			printk(".");
		}
		/* Check for pending signals */
		signal_check_pending();
		k_msleep(10);
		count++;
	}

	if (!interrupted) {
		printk("\nLoop completed (no signal received)\n");
	}

	/* Clear foreground */
	signal_set_foreground_pgid(0);

	printk("Loop exiting.\n");
	return 0;
}

/**
 * @brief sigint command - send SIGINT to foreground process
 */
static int cmd_sigint(int argc, char **argv)
{
	pid_t fg_pgid = signal_get_foreground_pgid();

	if (fg_pgid <= 0) {
		printk("No foreground process\n");
		return -ESRCH;
	}

	printk("Sending SIGINT to foreground process (PID=%d)\n", fg_pgid);
	int ret = kill(fg_pgid, SIGINT);

	if (ret == 0) {
		printk("Signal delivered successfully\n");
	} else {
		printk("Failed to deliver signal: %d\n", ret);
	}

	return ret;
}

/**
 * @brief test_signal command - self-test signal delivery
 * Creates a child process that waits for signal, then sends it
 */
static int cmd_test_signal(int argc, char **argv)
{
	printk("=== Signal Delivery Self-Test ===\n");

	/* Child process that waits for signal */
	struct child_context {
		volatile int received;
		int signal_num;
	};
	static struct child_context ctx = {0};

	void *child_func(void *arg) {
		struct child_context *c = (struct child_context *)arg;
		struct z_process *proc = process_current();

		printk("[Child PID=%d] Installing signal handler\n", proc->pid);

		void handler(int sig) {
			c->received = 1;
			c->signal_num = sig;
			printk("[Child PID=%d] Signal %d received!\n", proc->pid, sig);
		}
		signal(SIGINT, handler);

		printk("[Child PID=%d] Waiting for signal (5 seconds)...\n", proc->pid);
		int count = 0;
		while (!c->received && count < 500) {
			/* Check for pending signals */
			signal_check_pending();
			k_msleep(10);
			count++;
		}

		if (c->received) {
			printk("[Child PID=%d] SUCCESS - Signal %d was delivered\n",
			       proc->pid, c->signal_num);
			return (void *)0;
		} else {
			printk("[Child PID=%d] TIMEOUT - No signal received\n", proc->pid);
			return (void *)-1;
		}
	}

	/* Create child process */
	ctx.received = 0;
	ctx.signal_num = 0;

	printk("[Parent] Creating child process...\n");
	pid_t child_pid = new_task("signal_test_child", child_func, &ctx);
	if (child_pid < 0) {
		printk("[Parent] Failed to create child: %d\n", child_pid);
		return child_pid;
	}

	printk("[Parent] Child created with PID=%d\n", child_pid);

	/* Give child time to install handler */
	k_msleep(100);

	/* Send signal to child */
	printk("[Parent] Sending SIGINT to child (PID=%d)...\n", child_pid);
	int ret = kill(child_pid, SIGINT);
	if (ret != 0) {
		printk("[Parent] kill() failed: %d\n", ret);
		return ret;
	}
	printk("[Parent] Signal sent successfully\n");

	/* Wait for child to complete */
	printk("[Parent] Waiting for child to exit...\n");
	int status;
	pid_t waited = waitpid(child_pid, &status, 0);

	if (waited == child_pid) {
		printk("[Parent] Child exited with status %d\n", status);
		if (status == 0) {
			printk("\n=== TEST PASSED ===\n");
			printk("Signal was successfully delivered and handled!\n");
		} else {
			printk("\n=== TEST FAILED ===\n");
		}
	} else {
		printk("[Parent] waitpid failed: %d\n", waited);
		return -1;
	}

	return status;
}

/* Register commands using the macro */
SHELL_CMD_REGISTER(hello, "Print hello message", cmd_hello);
SHELL_CMD_REGISTER(echo, "Echo arguments", cmd_echo);
SHELL_CMD_REGISTER(ps, "List processes", cmd_ps);
SHELL_CMD_REGISTER(fg, "Resume suspended foreground process", cmd_fg);
SHELL_CMD_REGISTER(suspend, "Suspend foreground process (like Ctrl+Z)", cmd_suspend);
SHELL_CMD_REGISTER(sleep, "Sleep for milliseconds", cmd_sleep);
SHELL_CMD_REGISTER(test, "Process creation test", cmd_test);
SHELL_CMD_REGISTER(loop, "Loop for signal testing (Ctrl+D to suspend, Ctrl+C to stop)", cmd_loop);
SHELL_CMD_REGISTER(sigint, "Send SIGINT to foreground process", cmd_sigint);
SHELL_CMD_REGISTER(test_signal, "Self-test signal delivery", cmd_test_signal);
SHELL_CMD_REGISTER(getpid, "Show process ID", cmd_getpid);
SHELL_CMD_REGISTER(info, "Show process info", cmd_info);
SHELL_CMD_REGISTER(uptime, "Show system uptime", cmd_uptime);
SHELL_CMD_REGISTER(mem, "Show memory information", cmd_mem);
SHELL_CMD_REGISTER(free, "Show free memory", cmd_free);
SHELL_CMD_REGISTER(clear, "Clear screen", cmd_clear);
SHELL_CMD_REGISTER(version, "Show system version", cmd_version);
SHELL_CMD_REGISTER(date, "Show current tick count", cmd_date);
SHELL_CMD_REGISTER(kill, "Terminate a process", cmd_kill);
SHELL_CMD_REGISTER(benchmark, "Run CPU benchmark", cmd_benchmark);
SHELL_CMD_REGISTER(stress, "Stress test process creation", cmd_stress);
SHELL_CMD_REGISTER(reboot, "Reboot the system", cmd_reboot);
SHELL_CMD_REGISTER(help, "Show available commands", cmd_help);
SHELL_CMD_REGISTER(upload_hex, "Upload ANL binary via hex", cmd_upload_hex);
SHELL_CMD_REGISTER(load, "Load ANL binary", cmd_load);
SHELL_CMD_REGISTER(fork, "Fork child processes", cmd_fork);
```

## src/debug.c
```c
/*
 * Copyright (c) 2024 OneWo-rtLinux Team
 *
 * SPDX-License-Identifier: Apache-2.0
 *
 * Debug utilities for stack trace
 */

#include <zephyr/kernel.h>
#include <zephyr/sys/printk.h>

/**
 * @brief Print current thread stack trace
 */
void print_stack_trace(void)
{
	struct k_thread *current = k_current_get();

	printk("\n=== Stack Trace ===\n");
	printk("Current thread: %p\n", current);

	if (current) {
		printk("Thread name: %s\n", k_thread_name_get(current));
		printk("Thread ID: %p\n", current);
		printk("Thread stack: %p\n", current->stack_info.start);
		printk("Thread stack size: %zu\n", current->stack_info.size);
	}

	/* Get frame pointer and print backtrace */
	register unsigned long fp __asm__("s0");
	register unsigned long sp __asm__("sp");
	register unsigned long ra __asm__("ra");

	printk("\nRegisters:\n");
	printk("  fp (s0) = 0x%08lx\n", fp);
	printk("  sp      = 0x%08lx\n", sp);
	printk("  ra      = 0x%08lx\n", ra);

	printk("\nStack frames:\n");
	unsigned long *frame = (unsigned long *)fp;
	int depth = 0;

	while (frame && depth < 10) {
		unsigned long return_addr = *(frame - 1);
		unsigned long prev_fp = *(frame - 2);

		printk("  [%d] fp=0x%08lx, ra=0x%08lx\n",
		       depth, (unsigned long)frame, return_addr);

		/* Validate frame pointer */
		if (prev_fp == 0 || prev_fp < 0x20000000 || prev_fp > 0x20080000) {
			printk("  [%d] Invalid frame pointer, stopping\n", depth);
			break;
		}

		frame = (unsigned long *)prev_fp;
		depth++;
	}

	printk("===================\n\n");
}
```

## src/test_simple.c
```c
/*
 * Simple test command that doesn't create a new thread
 */

#include <zephyr/kernel.h>
#include <zephyr/kernel/process.h>
#include <stdio.h>
#include "shell_process.h"

/**
 * @brief Simple PS command - runs in same thread
 */
static int cmd_ps_simple(int argc, char **argv)
{
	printk("=== SIMPLE PS (no thread creation) ===\n");
	printk("PID    PPID   Command\n");
	printk("------------------------\n");

	/* Get current process */
	struct z_process *current = process_current();
	if (!current || current->pid == PID_INVALID) {
		printk("ERROR: Invalid current process\n");
		return -1;
	}

	/* Print current process */
	printk("%-6d %-6d %s\n", (int)current->pid, 0, "ps_simple");

	/* Print init process */
	printk("%-6d %-6d %s\n", (int)PID_INIT, 0, "init");

	printk("=== SIMPLE PS DONE - returning ===\n");
	return 0;
}

/* Register command */
SHELL_CMD_REGISTER(ps_simple, "List processes (no thread)", cmd_ps_simple);
```
