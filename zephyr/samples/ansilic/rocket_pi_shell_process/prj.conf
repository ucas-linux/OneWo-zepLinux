## CMakeLists.txt
```
# SPDX-License-Identifier: Apache-2.0

cmake_minimum_required(VERSION 3.20.0)

find_package(Zephyr REQUIRED HINTS $ENV{ZEPHYR_BASE})
project(rocket_pi_shell_process)

target_sources(app PRIVATE
    src/main.c
    src/shell_process.c
    src/commands.c
    src/debug.c
    src/bytecode_vm.c
    src/anl_loader.c
    src/signal.c
    src/vfs_commands.c
)
```

## sample.yaml
```
sample:
  description: RocketPi Shell with Process Support and Signal Handling
  name: RocketPi Shell Process
common:
  tags: shell process signal
  platform_allow: rocket_pi
  integration_platforms:
    - rocket_pi
  harness: console
  harness_config:
    type: multi_line
    ordered: false
    regex:
      - "RocketPi Shell with Process Support"
      - "Init process PID:"
```

## prj.conf
```kconfig
# Shell configuration
CONFIG_SHELL=y
CONFIG_SHELL_BACKEND_SERIAL=y
CONFIG_SHELL_BACKEND_SERIAL_API_POLLING=y
CONFIG_SHELL_BACKEND_SERIAL_RX_POLL_PERIOD=10
CONFIG_SHELL_PROMPT_UART="shell> "
CONFIG_SHELL_CMD_BUFF_SIZE=4096
CONFIG_SHELL_PRINTF_BUFF_SIZE=256

# Process support
CONFIG_PROCESS_MODEL=y
CONFIG_MAX_PROCESS_COUNT=32
CONFIG_MAX_FD_PER_PROCESS=16

# Memory configuration
CONFIG_MAIN_STACK_SIZE=2048
CONFIG_SHELL_STACK_SIZE=2048

# Thread configuration
CONFIG_NUM_PREEMPT_PRIORITIES=15

# Logging (disable to avoid conflicts with shell)
CONFIG_LOG=n
CONFIG_BOOT_BANNER=n

# System configuration
CONFIG_CONSOLE=y
CONFIG_CONSOLE_GETCHAR=y
CONFIG_UART_CONSOLE=y
CONFIG_SERIAL=y
CONFIG_PRINTK=y
CONFIG_REBOOT=y

# Dynamic memory
CONFIG_DYNAMIC_THREAD=y
CONFIG_THREAD_STACK_INFO=y
CONFIG_THREAD_NAME=y

# VFS / RAMFS
CONFIG_FILE_SYSTEM=y
CONFIG_VFS_CORE=y
CONFIG_RAMFS=y
CONFIG_HEAP_MEM_POOL_SIZE=24576
```

## src/main.c
```c
/*
 * Copyright (c) 2024 OneWo-rtLinux Team
 *
 * SPDX-License-Identifier: Apache-2.0
 *
 * Main application - Shell with process-based command execution
 * Uses Zephyr shell subsystem for proper input handling
 * RocketPi (STM32F401) version
 */

#include <zephyr/kernel.h>
#include <zephyr/shell/shell.h>
#include <zephyr/kernel/process.h>
#include <zephyr/drivers/uart.h>
#include <stdio.h>
#include <string.h>
#include <stdlib.h>
#include "shell_process.h"
#include "signal.h"

/**
 * @brief Shell command handler - hello
 *
 * This creates a new process and executes the hello command
 */
static int shell_hello_handler(const struct shell *sh, size_t argc, char **argv)
{
	const struct shell_cmd *cmd = shell_cmd_lookup("hello");
	if (!cmd) {
		shell_error(sh, "Command not found");
		return -ENOENT;
	}

	/* Execute in new process (foreground) */
	int ret = shell_exec_command(cmd, argc, argv, true);
	if (ret != 0 && ret != -EINVAL) {
		shell_error(sh, "Command failed with code %d", ret);
	}

	return ret;
}

/**
 * @brief Shell command handler - echo
 */
static int shell_echo_handler(const struct shell *sh, size_t argc, char **argv)
{
	const struct shell_cmd *cmd = shell_cmd_lookup("echo");
	if (!cmd) {
		shell_error(sh, "Command not found");
		return -ENOENT;
	}

	int ret = shell_exec_command(cmd, argc, argv, true);
	if (ret != 0 && ret != -EINVAL) {
		shell_error(sh, "Command failed with code %d", ret);
	}

	return ret;
}

/**
 * @brief Shell command handler - ps
 */
static int shell_ps_handler(const struct shell *sh, size_t argc, char **argv)
{
	const struct shell_cmd *cmd = shell_cmd_lookup("ps");
	if (!cmd) {
		shell_error(sh, "Command not found");
		return -ENOENT;
	}

	int ret = shell_exec_command(cmd, argc, argv, true);
	if (ret != 0) {
		shell_error(sh, "Command failed with code %d", ret);
	}

	return ret;
}

/**
 * @brief Shell command handler - getpid
 */
static int shell_getpid_handler(const struct shell *sh, size_t argc, char **argv)
{
	const struct shell_cmd *cmd = shell_cmd_lookup("getpid");
	if (!cmd) {
		shell_error(sh, "Command not found");
		return -ENOENT;
	}

	int ret = shell_exec_command(cmd, argc, argv, true);
	if (ret != 0) {
		shell_error(sh, "Command failed with code %d", ret);
	}

	return ret;
}

/**
 * @brief Shell command handler - info
 */
static int shell_info_handler(const struct shell *sh, size_t argc, char **argv)
{
	const struct shell_cmd *cmd = shell_cmd_lookup("info");
	if (!cmd) {
		shell_error(sh, "Command not found");
		return -ENOENT;
	}

	int ret = shell_exec_command(cmd, argc, argv, true);
	if (ret != 0) {
		shell_error(sh, "Command failed with code %d", ret);
	}

	return ret;
}

/**
 * @brief Shell command handler - sleep
 */
static int shell_sleep_handler(const struct shell *sh, size_t argc, char **argv)
{
	const struct shell_cmd *cmd = shell_cmd_lookup("sleep");
	if (!cmd) {
		shell_error(sh, "Command not found");
		return -ENOENT;
	}

	int ret = shell_exec_command(cmd, argc, argv, true);
	if (ret != 0 && ret != -EINVAL) {
		shell_error(sh, "Command failed with code %d", ret);
	}

	return ret;
}

/**
 * @brief Shell command handler - test
 */
static int shell_test_handler(const struct shell *sh, size_t argc, char **argv)
{
	const struct shell_cmd *cmd = shell_cmd_lookup("test");
	if (!cmd) {
		shell_error(sh, "Command not found");
		return -ENOENT;
	}

	int ret = shell_exec_command(cmd, argc, argv, true);
	if (ret != 0) {
		shell_error(sh, "Command failed with code %d", ret);
	}

	return ret;
}

/**
 * @brief Shell command handler - help
 */
static int shell_help_handler(const struct shell *sh, size_t argc, char **argv)
{
	const struct shell_cmd *cmd = shell_cmd_lookup("help");
	if (!cmd) {
		shell_error(sh, "Command not found");
		return -ENOENT;
	}

	int ret = shell_exec_command(cmd, argc, argv, true);
	if (ret != 0) {
		shell_error(sh, "Command failed with code %d", ret);
	}

	return ret;
}

/**
 * @brief Shell command handler - ls (bytecode VM)
 */
static int shell_ls_handler(const struct shell *sh, size_t argc, char **argv)
{
	const struct shell_cmd *cmd = shell_cmd_lookup("ls");
	if (!cmd) {
		shell_error(sh, "Command not found");
		return -ENOENT;
	}

	int ret = shell_exec_command(cmd, argc, argv, true);
	if (ret != 0) {
		shell_error(sh, "Command failed with code %d", ret);
	}

	return ret;
}

/**
 * @brief Shell command handler - upload (bytecode VM)
 */
static int shell_upload_handler(const struct shell *sh, size_t argc, char **argv)
{
	const struct shell_cmd *cmd = shell_cmd_lookup("upload");
	if (!cmd) {
		shell_error(sh, "Command not found");
		return -ENOENT;
	}

	int ret = shell_exec_command(cmd, argc, argv, true);
	if (ret != 0) {
		shell_error(sh, "Command failed with code %d", ret);
	}

	return ret;
}

/**
 * @brief Shell command handler - upload_hex (bytecode VM)
 */
static int shell_upload_hex_handler(const struct shell *sh, size_t argc, char **argv)
{
	const struct shell_cmd *cmd = shell_cmd_lookup("upload_hex");
	if (!cmd) {
		shell_error(sh, "Command not found");
		return -ENOENT;
	}

	int ret = shell_exec_command(cmd, argc, argv, true);
	if (ret != 0) {
		shell_error(sh, "Command failed with code %d", ret);
	}

	return ret;
}

/**
 * @brief Shell command handler - run (bytecode VM)
 */
static int shell_run_handler(const struct shell *sh, size_t argc, char **argv)
{
	const struct shell_cmd *cmd = shell_cmd_lookup("run");
	if (!cmd) {
		shell_error(sh, "Command not found");
		return -ENOENT;
	}

	int ret = shell_exec_command(cmd, argc, argv, true);
	if (ret != 0) {
		shell_error(sh, "Command failed with code %d", ret);
	}

	return ret;
}

/**
 * @brief Shell command handler - rm (bytecode VM)
 */
static int shell_rm_handler(const struct shell *sh, size_t argc, char **argv)
{
	const struct shell_cmd *cmd = shell_cmd_lookup("rm");
	if (!cmd) {
		shell_error(sh, "Command not found");
		return -ENOENT;
	}

	int ret = shell_exec_command(cmd, argc, argv, true);
	if (ret != 0) {
		shell_error(sh, "Command failed with code %d", ret);
	}

	return ret;
}

/* Generic handler macro to reduce boilerplate */
#define DEFINE_SHELL_HANDLER(_handler_name, _cmd_name) \
static int _handler_name(const struct shell *sh, size_t argc, char **argv) \
{ \
	const struct shell_cmd *cmd = shell_cmd_lookup(_cmd_name); \
	if (!cmd) { \
		shell_error(sh, "Command not found"); \
		return -ENOENT; \
	} \
	int ret = shell_exec_command(cmd, argc, argv, true); \
	if (ret != 0 && ret != -EINVAL) { \
		shell_error(sh, "Command failed with code %d", ret); \
	} \
	return ret; \
}

DEFINE_SHELL_HANDLER(shell_mkdir_handler, "mkdir")
DEFINE_SHELL_HANDLER(shell_cat_handler, "cat")
DEFINE_SHELL_HANDLER(shell_uptime_handler, "uptime")
DEFINE_SHELL_HANDLER(shell_mem_handler, "mem")
DEFINE_SHELL_HANDLER(shell_free_handler, "free")
DEFINE_SHELL_HANDLER(shell_clear_handler, "clear")
DEFINE_SHELL_HANDLER(shell_version_handler, "version")
DEFINE_SHELL_HANDLER(shell_date_handler, "date")
DEFINE_SHELL_HANDLER(shell_kill_handler, "kill")
DEFINE_SHELL_HANDLER(shell_benchmark_handler, "benchmark")
DEFINE_SHELL_HANDLER(shell_stress_handler, "stress")
DEFINE_SHELL_HANDLER(shell_reboot_handler, "reboot")
DEFINE_SHELL_HANDLER(shell_fork_handler, "fork")
/* loop runs in background so Ctrl+D can be processed */
static int shell_loop_handler(const struct shell *sh, size_t argc, char **argv)
{
	const struct shell_cmd *cmd = shell_cmd_lookup("loop");
	if (!cmd) {
		shell_error(sh, "Command not found");
		return -ENOENT;
	}
	/* Run loop in BACKGROUND (false) so shell can handle Ctrl+D */
	int ret = shell_exec_command(cmd, argc, argv, false);
	if (ret != 0 && ret != -EINVAL) {
		shell_error(sh, "Command failed with code %d", ret);
	}
	return ret;
}
DEFINE_SHELL_HANDLER(shell_sigint_handler, "sigint")
DEFINE_SHELL_HANDLER(shell_test_signal_handler, "test_signal")
DEFINE_SHELL_HANDLER(shell_fg_handler, "fg")
DEFINE_SHELL_HANDLER(shell_suspend_handler, "suspend")

/* Register shell commands - these bridge to our process-based execution */
SHELL_CMD_ARG_REGISTER(hello, NULL, "Print hello message (runs in new process)",
                       shell_hello_handler, 1, 10);
SHELL_CMD_ARG_REGISTER(echo, NULL, "Echo arguments (runs in new process)",
                       shell_echo_handler, 1, 10);
SHELL_CMD_ARG_REGISTER(ps, NULL, "List processes (runs in new process)",
                       shell_ps_handler, 1, 0);
SHELL_CMD_ARG_REGISTER(fg, NULL, "Resume suspended foreground process",
                       shell_fg_handler, 1, 0);
SHELL_CMD_ARG_REGISTER(suspend, NULL, "Suspend foreground process (like Ctrl+Z)",
                       shell_suspend_handler, 1, 0);
SHELL_CMD_ARG_REGISTER(getpid, NULL, "Show process ID (runs in new process)",
                       shell_getpid_handler, 1, 0);
SHELL_CMD_ARG_REGISTER(info, NULL, "Show process info (runs in new process)",
                       shell_info_handler, 1, 0);
SHELL_CMD_ARG_REGISTER(sleep, NULL, "Sleep for milliseconds (runs in new process)",
                       shell_sleep_handler, 2, 0);
SHELL_CMD_ARG_REGISTER(test, NULL, "Process creation test (runs in new process)",
                       shell_test_handler, 1, 0);
SHELL_CMD_ARG_REGISTER(prochelp, NULL, "Show process commands (runs in new process)",
                       shell_help_handler, 1, 0);
SHELL_CMD_ARG_REGISTER(uptime, NULL, "Show system uptime",
                       shell_uptime_handler, 1, 0);
SHELL_CMD_ARG_REGISTER(mem, NULL, "Show memory information",
                       shell_mem_handler, 1, 0);
SHELL_CMD_ARG_REGISTER(free, NULL, "Show free memory",
                       shell_free_handler, 1, 0);
SHELL_CMD_ARG_REGISTER(clear, NULL, "Clear screen",
                       shell_clear_handler, 1, 0);
SHELL_CMD_ARG_REGISTER(version, NULL, "Show system version",
                       shell_version_handler, 1, 0);
SHELL_CMD_ARG_REGISTER(date, NULL, "Show current tick count",
                       shell_date_handler, 1, 0);
SHELL_CMD_ARG_REGISTER(kill, NULL, "Terminate a process by PID",
                       shell_kill_handler, 2, 0);
SHELL_CMD_ARG_REGISTER(benchmark, NULL, "Run CPU benchmark",
                       shell_benchmark_handler, 1, 1);
SHELL_CMD_ARG_REGISTER(stress, NULL, "Stress test process creation",
                       shell_stress_handler, 1, 1);
SHELL_CMD_ARG_REGISTER(reboot, NULL, "Reboot the system",
                       shell_reboot_handler, 1, 0);
SHELL_CMD_ARG_REGISTER(loop, NULL, "Infinite loop for signal testing",
                       shell_loop_handler, 1, 1);
SHELL_CMD_ARG_REGISTER(sigint, NULL, "Send SIGINT to foreground process",
                       shell_sigint_handler, 1, 0);
SHELL_CMD_ARG_REGISTER(test_signal, NULL, "Self-test signal delivery",
                       shell_test_signal_handler, 1, 0);

SHELL_CMD_ARG_REGISTER(mkdir, NULL, "Create VFS directory",
                       shell_mkdir_handler, 2, 0);
SHELL_CMD_ARG_REGISTER(cat, NULL, "Print VFS file",
                       shell_cat_handler, 2, 0);

/* Bytecode VM shell commands */
SHELL_CMD_ARG_REGISTER(ls, NULL, "List programs and commands",
                       shell_ls_handler, 1, 1);
SHELL_CMD_ARG_REGISTER(upload, NULL, "Upload bytecode program",
                       shell_upload_handler, 3, 0);
SHELL_CMD_ARG_REGISTER(upload_hex, NULL, "Upload bytecode from hex string",
                       shell_upload_hex_handler, 3, 0);
SHELL_CMD_ARG_REGISTER(run, NULL, "Execute bytecode program",
                       shell_run_handler, 2, 0);
SHELL_CMD_ARG_REGISTER(rm, NULL, "Delete bytecode program",
                       shell_rm_handler, 2, 0);
SHELL_CMD_ARG_REGISTER(fork, NULL, "Fork child processes",
                       shell_fork_handler, 1, 2);

/**
 * @brief Main application entry point
 */
int main(void)
{
	printk("\n");
	printk("========================================\n");
	printk("  RocketPi Shell with Process Support\n");
	printk("  Based on Embox process model\n");
	printk("========================================\n");
	printk("\n");

	/* Get init process info */
	struct z_process *init_proc = process_current();
	if (init_proc) {
		printk("Init process PID: %d\n", init_proc->pid);
	} else {
		printk("Warning: No init process found\n");
	}

	printk("\n");
	printk("Available commands:\n");
	printk("  echo      - Echo arguments\n");
	printk("  version   - Show system version\n");
	printk("  uptime    - Show system uptime\n");
	printk("  mem       - Show memory information\n");
	printk("  free      - Show free memory\n");
	printk("  benchmark - Run CPU benchmark\n");
	printk("  ps        - List processes\n");
	printk("  fg        - Resume suspended foreground process\n");
	printk("  hello     - Print hello message\n");
	printk("  getpid    - Show process ID\n");
	printk("  info      - Show process info\n");
	printk("  sleep     - Sleep for milliseconds\n");
	printk("  test      - Process creation test\n");
	printk("  kill      - Terminate a process\n");
	printk("  stress    - Stress test process creation\n");
	printk("  fork      - Fork child processes\n");
	printk("  loop      - Loop for signal testing (Ctrl+D to suspend, Ctrl+C to stop)\n");
	printk("  sigint    - Send SIGINT to foreground process\n");
	printk("  test_signal - Self-test signal delivery\n");
	printk("  clear     - Clear screen\n");
	printk("  date      - Show current tick count\n");
	printk("  reboot    - Reboot the system\n");
	printk("\n");
	printk("Each command runs in a separate process.\n");
	printk("Run 'test_signal' to verify signal delivery works.\n");
	printk("Press Ctrl+C to send SIGINT to foreground process.\n");
	printk("Press Ctrl+D to suspend foreground process (use 'fg' to resume).\n");
	printk("\n");

	/* Return to let Zephyr shell handle input */
	return 0;
}
```

## src/anl_loader.c
```c
#include <zephyr/kernel.h>
#include <string.h>
#include "anl_loader.h"

/* CRC-32 (IEEE 802.3) */
static uint32_t crc32(const uint8_t *buf, size_t len)
{
    uint32_t crc = 0xFFFFFFFFU;
    for (size_t i = 0; i < len; i++) {
        crc ^= buf[i];
        for (int j = 0; j < 8; j++)
            crc = (crc >> 1) ^ (0xEDB88320U & -(crc & 1));
    }
    return ~crc;
}

int anl_validate(const uint8_t *buf, size_t len)
{
    if (len < sizeof(AnlFileHeader)) return -1;
    const AnlFileHeader *fh = (const AnlFileHeader *)buf;
    if (fh->magic != ANL_MAGIC) return -2;
    if (fh->version != ANL_VERSION) return -3;
    if (fh->file_size > len) return -4;

    /* CRC check: compute with crc32 field zeroed */
    uint8_t tmp[sizeof(uint32_t)];
    memcpy(tmp, &fh->crc32, 4);
    uint32_t stored = fh->crc32;
    /* We can't modify buf (const), so compute in two parts */
    uint32_t crc = 0xFFFFFFFFU;
    size_t crc_off = offsetof(AnlFileHeader, crc32);
    for (size_t i = 0; i < fh->file_size; i++) {
        uint8_t b = (i >= crc_off && i < crc_off + 4) ? 0 : buf[i];
        crc ^= b;
        for (int j = 0; j < 8; j++)
            crc = (crc >> 1) ^ (0xEDB88320U & -(crc & 1));
    }
    crc = ~crc;
    if (crc != stored) return -5;
    return 0;
}

const uint8_t *anl_section(const uint8_t *buf, uint16_t sh_type, uint32_t *out_size)
{
    const AnlFileHeader *fh = (const AnlFileHeader *)buf;
    const AnlSectionHeader *sh = (const AnlSectionHeader *)(buf + sizeof(AnlFileHeader));
    for (int i = 0; i < fh->shnum; i++) {
        if (sh[i].sh_type == sh_type) {
            if (out_size) *out_size = sh[i].sh_size;
            return buf + sh[i].sh_offset;
        }
    }
    return NULL;
}

static const AnlSectionHeader *get_shdr(const uint8_t *buf, int idx)
{
    const AnlFileHeader *fh = (const AnlFileHeader *)buf;
    if (idx < 0 || idx >= fh->shnum) return NULL;
    return (const AnlSectionHeader *)(buf + sizeof(AnlFileHeader)) + idx;
}

int anl_load(const char *name, const uint8_t *buf, size_t len)
{
    int ret = anl_validate(buf, len);
    if (ret) {
        printk("anl_load[%s]: validate failed %d\n", name, ret);
        return ret;
    }

    const AnlFileHeader *fh = (const AnlFileHeader *)buf;
    const AnlSectionHeader *shdrs = (const AnlSectionHeader *)(buf + sizeof(AnlFileHeader));

    /* Calculate total alloc size for SHF_ALLOC sections */
    uint32_t total = 0;
    for (int i = 0; i < fh->shnum; i++) {
        if (shdrs[i].sh_flags & SHF_ALLOC)
            total += shdrs[i].sh_size;
    }

    /* Allocate aligned memory (RISC-V requires 4-byte alignment, use 8 for safety) */
    uint8_t *mem = k_aligned_alloc(8, total);
    if (!mem) {
        printk("anl_load[%s]: OOM (%u bytes)\n", name, total);
        return -ENOMEM;
    }
    memset(mem, 0, total);

    printk("anl_load[%s]: allocated %u bytes at 0x%08x (aligned)\n",
           name, total, (unsigned)mem);

    /* Map section index -> runtime base address */
    uintptr_t sec_base[16] = {0};
    uint32_t off = 0;
    for (int i = 0; i < fh->shnum && i < 16; i++) {
        if (shdrs[i].sh_flags & SHF_ALLOC) {
            sec_base[i] = (uintptr_t)(mem + off);
            if (shdrs[i].sh_type != SHT_BSS)
                memcpy(mem + off, buf + shdrs[i].sh_offset, shdrs[i].sh_size);
            off += shdrs[i].sh_size;
        }
    }

    /* Find CODE section base */
    uintptr_t code_base = 0;
    for (int i = 0; i < fh->shnum && i < 16; i++) {
        if (shdrs[i].sh_type == SHT_CODE) { code_base = sec_base[i]; break; }
    }

    /* Process RELA sections */
    for (int i = 0; i < fh->shnum; i++) {
        if (shdrs[i].sh_type != SHT_RELA) continue;
        const AnlRelaEntry *relas = (const AnlRelaEntry *)(buf + shdrs[i].sh_offset);
        uint32_t nrela = shdrs[i].sh_size / sizeof(AnlRelaEntry);
        int symtab_idx = shdrs[i].sh_link;
        const AnlSectionHeader *symsh = get_shdr(buf, symtab_idx);
        if (!symsh) continue;
        const AnlSymEntry *syms = (const AnlSymEntry *)(buf + symsh->sh_offset);
        const AnlSectionHeader *strsh = get_shdr(buf, symsh->sh_link);
        const char *strtab = strsh ? (const char *)(buf + strsh->sh_offset) : NULL;

        for (uint32_t r = 0; r < nrela; r++) {
            uint32_t sym_idx = relas[r].r_info >> 8;
            uint8_t  r_type  = relas[r].r_info & 0xFF;
            const AnlSymEntry *sym = &syms[sym_idx];

            uintptr_t S = 0;
            if (sym->st_shndx == ANL_SHNDX_UNDEF) {
                /* Dynamic symbol lookup */
                const char *sname = strtab ? strtab + sym->st_name : "";
                for (int e = 0; e < _anl_exports_count; e++) {
                    if (strcmp(_anl_exports[e].name, sname) == 0) {
                        S = _anl_exports[e].addr;
                        break;
                    }
                }
                if (!S) {
                    printk("anl_load[%s]: unresolved symbol '%s'\n", name, sname);
                    k_free(mem);
                    return -ENOENT;
                }
            } else if (sym->st_shndx < 16) {
                S = sec_base[sym->st_shndx] + sym->st_value;
            }

            /* Patch location is relative to CODE section —
             * RV32C compressed instructions mean 32-bit insns can sit at
             * 2-byte aligned addresses, so use memcpy for all access. */
            uint8_t *patch_ptr = (uint8_t *)(code_base + relas[r].r_offset);
            int32_t   A     = relas[r].r_addend;
            uintptr_t P     = (uintptr_t)patch_ptr;

            printk("  rela[%u] type=%u sym=%u S=0x%08x P=0x%08x A=%d\n",
                   r, r_type, sym_idx, (unsigned)S, (unsigned)P, A);

            uint32_t orig;
            memcpy(&orig, patch_ptr, 4);

            uint32_t val = orig;
            switch (r_type) {
            case R_ANL_32:
            case R_ANL_ABS32:
                val = (uint32_t)(S + A);
                memcpy(patch_ptr, &val, 4);
                break;
            case R_ANL_PC32:
                val = (uint32_t)(S + A - P);
                memcpy(patch_ptr, &val, 4);
                break;
            case R_ANL_THM_CALL: {
                /* ARM Thumb BL: encode 26-bit offset into two 16-bit halfwords */
                int32_t offset = (int32_t)(S + A - P - 4);
                uint32_t s  = (offset >> 24) & 1;
                uint32_t i1 = (offset >> 23) & 1;
                uint32_t i2 = (offset >> 22) & 1;
                uint32_t j1 = (~(i1 ^ s)) & 1;
                uint32_t j2 = (~(i2 ^ s)) & 1;
                uint32_t imm10 = (offset >> 12) & 0x3FF;
                uint32_t imm11 = (offset >> 1)  & 0x7FF;
                uint16_t hw0 = (uint16_t)(0xF000 | (s << 10) | imm10);
                uint16_t hw1 = (uint16_t)(0xF800 | (j1 << 13) | (j2 << 11) | imm11);
                memcpy(patch_ptr, &hw0, 2);
                memcpy(patch_ptr + 2, &hw1, 2);
                break;
            }
            case R_ANL_HI20: {
                /* RISC-V LUI: upper 20 bits in [31:12] */
                uint32_t hi = (uint32_t)((S + A + 0x800) >> 12) & 0xFFFFF;
                val = (orig & 0xFFF) | (hi << 12);
                memcpy(patch_ptr, &val, 4);
                break;
            }
            case R_ANL_LO12_I: {
                /* RISC-V I-type: 12-bit signed immediate in [31:20] */
                uint32_t lo = (uint32_t)(S + A) & 0xFFF;
                val = (orig & 0x000FFFFF) | (lo << 20);
                memcpy(patch_ptr, &val, 4);
                break;
            }
            case R_ANL_CALL: {
                /* RISC-V CALL: AUIPC + JALR pair */
                int32_t offset = (int32_t)(S + A - P);
                int32_t hi = (offset + 0x800) >> 12;
                int32_t lo = offset & 0xFFF;

                /* Patch AUIPC */
                uint32_t auipc;
                memcpy(&auipc, patch_ptr, 4);
                uint32_t orig_auipc = auipc;
                auipc = (auipc & 0xFFF) | ((hi & 0xFFFFF) << 12);
                memcpy(patch_ptr, &auipc, 4);

                /* Patch JALR */
                uint32_t jalr;
                memcpy(&jalr, patch_ptr + 4, 4);
                uint32_t orig_jalr = jalr;
                jalr = (jalr & 0x000FFFFF) | ((lo & 0xFFF) << 20);
                memcpy(patch_ptr + 4, &jalr, 4);

                printk("    CALL: offset=0x%x hi=0x%x lo=0x%x\n", offset, hi, lo);
                printk("    auipc: 0x%08x -> 0x%08x\n", orig_auipc, auipc);
                printk("    jalr:  0x%08x -> 0x%08x\n", orig_jalr, jalr);
                break;
            }
            default:
                printk("anl_load[%s]: unknown reloc type %d\n", name, r_type);
                break;
            }

            uint32_t patched;
            memcpy(&patched, patch_ptr, 4);
            printk("    patched: 0x%08x -> 0x%08x\n", orig, patched);
        }
    }

    /* Jump to entry */
    uintptr_t entry = code_base + fh->entry_off;
    printk("anl_load[%s]: jumping to entry 0x%08x\n", name, (unsigned)entry);

    /* Debug: print first few instructions */
    uint32_t *code = (uint32_t *)code_base;
    printk("  code[0]=0x%08x code[1]=0x%08x code[2]=0x%08x\n",
           code[0], code[1], code[2]);
    printk("  code[3]=0x%08x code[4]=0x%08x code[5]=0x%08x\n",
           code[3], code[4], code[5]);

    /* Ensure all writes are visible before execution:
     * Architecture-specific memory and instruction cache synchronization */
#if defined(CONFIG_RISCV)
    /* RISC-V: fence - complete all prior stores (data ordering)
     *         fence.i - flush I-cache so instruction fetch sees new code */
    __asm__ volatile ("fence" ::: "memory");
    __asm__ volatile ("fence.i" ::: "memory");
#elif defined(CONFIG_ARM)
    /* ARM: DSB - data synchronization barrier
     *      ISB - instruction synchronization barrier (flushes pipeline) */
    __asm__ volatile ("dsb" ::: "memory");
    __asm__ volatile ("isb" ::: "memory");
#else
    /* Generic: just ensure compiler memory ordering */
    __asm__ volatile ("" ::: "memory");
#endif

    /* Set Thumb bit for ARM, no modification for RISC-V */
    if (fh->arch == ANL_ARCH_THUMB2) {
        entry |= 1;  /* ARM Thumb mode requires LSB set */
    }

    void (*fn)(void) = (void (*)(void))entry;
    fn();

    /* Note: mem is intentionally not freed here because spawned child
     * threads may still be executing code from this module. */
    return 0;
}
```

## src/anl_loader.h
```c
#ifndef ANL_LOADER_H
#define ANL_LOADER_H

#include <stdint.h>
#include <stddef.h>

/* Magic: \x7FANL */
#define ANL_MAGIC        0x4C4E417FU
#define ANL_VERSION      1
#define ANL_ARCH_RV32I   1
#define ANL_ARCH_THUMB2  2

/* File flags */
#define ANL_F_PIC        (1 << 0)
#define ANL_F_DYNAMIC    (1 << 1)
#define ANL_F_STRIP      (1 << 2)

/* Section types */
#define SHT_NULL    0
#define SHT_CODE    1
#define SHT_RODATA  2
#define SHT_DATA    3
#define SHT_BSS     4
#define SHT_SYMTAB  5
#define SHT_STRTAB  6
#define SHT_RELA    7
#define SHT_DYNSYM  8
#define SHT_DYNSTR  9

/* Section flags */
#define SHF_EXEC    (1 << 0)
#define SHF_WRITE   (1 << 1)
#define SHF_ALLOC   (1 << 2)

/* Relocation types (RISC-V RV32I and ARM Thumb2) */
#define R_ANL_32        1
#define R_ANL_PC32      2
#define R_ANL_THM_CALL  3  /* Thumb BL/BLX */
#define R_ANL_ABS32     4
#define R_ANL_HI20      5  /* RISC-V LUI high 20 bits */
#define R_ANL_LO12_I    6  /* RISC-V ADDI/LD low 12 bits */
#define R_ANL_CALL      7  /* RISC-V JAL/JALR */

#define ANL_SHNDX_UNDEF 0xFF

#pragma pack(push, 1)

typedef struct {
    uint32_t magic;
    uint8_t  version;
    uint8_t  arch;
    uint16_t flags;
    uint32_t entry_off;
    uint16_t shnum;
    uint16_t shentsize;
    uint32_t file_size;
    uint32_t crc32;
    uint32_t symtab_idx;
    uint32_t dynsym_idx;
} AnlFileHeader;  /* 32 bytes */

typedef struct {
    uint16_t sh_type;
    uint16_t sh_flags;
    uint32_t sh_offset;
    uint32_t sh_size;
    uint32_t sh_addr;
    uint32_t sh_link;
    uint32_t sh_entsize;
} AnlSectionHeader;  /* 24 bytes */

typedef struct {
    uint32_t st_name;
    uint32_t st_value;
    uint32_t st_size;
    uint8_t  st_type;
    uint8_t  st_bind;
    uint8_t  st_shndx;
    uint8_t  reserved;
} AnlSymEntry;  /* 16 bytes */

typedef struct {
    uint32_t r_offset;
    uint32_t r_info;
    int32_t  r_addend;
} AnlRelaEntry;  /* 12 bytes */

#pragma pack(pop)

struct anl_export {
    const char *name;
    uintptr_t   addr;
};

extern const struct anl_export _anl_exports[];
extern const int _anl_exports_count;

int anl_validate(const uint8_t *buf, size_t len);
const uint8_t *anl_section(const uint8_t *buf, uint16_t sh_type, uint32_t *out_size);
int anl_load(const char *name, const uint8_t *buf, size_t len);

#endif /* ANL_LOADER_H */
```

## src/bytecode_vm.h
```c
/*
 * Bytecode Virtual Machine for MCU
 * Simple stack-based VM for executing uploaded programs
 */

#ifndef BYTECODE_VM_H
#define BYTECODE_VM_H

#include <stdint.h>
#include <stddef.h>
#include <stdbool.h>

/* Bytecode Instruction Set */
enum vm_opcode {
    /* Stack Operations */
    OP_PUSH = 0x01,      // PUSH <value>      - Push immediate value to stack
    OP_POP = 0x02,       // POP               - Pop value from stack
    OP_DUP = 0x03,       // DUP               - Duplicate top of stack

    /* Arithmetic Operations */
    OP_ADD = 0x10,       // ADD               - Pop two values, push sum
    OP_SUB = 0x11,       // SUB               - Pop two values, push difference
    OP_MUL = 0x12,       // MUL               - Pop two values, push product
    OP_DIV = 0x13,       // DIV               - Pop two values, push quotient

    /* Comparison Operations */
    OP_EQ = 0x20,        // EQ                - Push 1 if equal, 0 otherwise
    OP_NE = 0x21,        // NE                - Push 1 if not equal
    OP_LT = 0x22,        // LT                - Push 1 if less than
    OP_GT = 0x23,        // GT                - Push 1 if greater than

    /* Control Flow */
    OP_JMP = 0x30,       // JMP <offset>      - Unconditional jump
    OP_JZ = 0x31,        // JZ <offset>       - Jump if top of stack is zero
    OP_JNZ = 0x32,       // JNZ <offset>      - Jump if top of stack is not zero

    /* System Calls */
    OP_PRINT = 0x40,     // PRINT             - Print top of stack as integer
    OP_PRINT_STR = 0x41, // PRINT_STR <len>   - Print string from bytecode
    OP_SLEEP = 0x42,     // SLEEP             - Sleep for top of stack ms
    OP_GETPID = 0x43,    // GETPID            - Push current process ID

    /* Program Control */
    OP_HALT = 0xFF,      // HALT              - Stop execution
};

/* VM Configuration */
#define VM_STACK_SIZE 64
#define VM_MAX_PROGRAM_SIZE 2048

/* VM State */
struct vm_state {
    int32_t stack[VM_STACK_SIZE];
    int sp;                      // Stack pointer (-1 = empty)
    const uint8_t *code;         // Program bytecode
    size_t code_size;            // Program size
    size_t pc;                   // Program counter
    bool running;                // Execution status
};

/* Program Metadata */
struct bytecode_program {
    char name[32];               // Program name
    uint8_t *code;               // Bytecode
    size_t code_size;            // Code size
    bool in_use;                 // Slot occupied
};

/* VM API */
int vm_init(struct vm_state *vm, const uint8_t *code, size_t code_size);
int vm_run(struct vm_state *vm);
void vm_cleanup(struct vm_state *vm);

/* Program Management */
int vm_load_program(const char *name, const uint8_t *code, size_t size);
int vm_delete_program(const char *name);
struct bytecode_program *vm_find_program(const char *name);
void vm_list_programs(void);
int vm_execute_program(const char *name, int argc, char **argv);

#endif /* BYTECODE_VM_H */
```

## src/debug.c
```c
/*
 * Copyright (c) 2024 OneWo-rtLinux Team
 *
 * SPDX-License-Identifier: Apache-2.0
 *
 * Debug utilities for stack trace
 */

#include <zephyr/kernel.h>
#include <zephyr/sys/printk.h>

/**
 * @brief Print current thread stack trace
 */
void print_stack_trace(void)
{
	struct k_thread *current = k_current_get();

	printk("\n=== Stack Trace ===\n");
	printk("Current thread: %p\n", current);

	if (current) {
		printk("Thread name: %s\n", k_thread_name_get(current));
		printk("Thread ID: %p\n", current);
		printk("Thread stack: %p\n", current->stack_info.start);
		printk("Thread stack size: %zu\n", current->stack_info.size);
	}

	/* Get frame pointer and print backtrace - architecture specific */
#if defined(CONFIG_RISCV)
	register unsigned long fp __asm__("s0");
	register unsigned long sp __asm__("sp");
	register unsigned long ra __asm__("ra");

	printk("\nRegisters (RISC-V):\n");
	printk("  fp (s0) = 0x%08lx\n", fp);
	printk("  sp      = 0x%08lx\n", sp);
	printk("  ra      = 0x%08lx\n", ra);
#elif defined(CONFIG_ARM)
	register unsigned long fp __asm__("r7");  /* ARM uses r7 as frame pointer */
	register unsigned long sp __asm__("sp");
	register unsigned long lr __asm__("lr");  /* Link register */

	printk("\nRegisters (ARM):\n");
	printk("  fp (r7) = 0x%08lx\n", fp);
	printk("  sp      = 0x%08lx\n", sp);
	printk("  lr      = 0x%08lx\n", lr);
#else
	unsigned long fp = 0, sp = 0;
	printk("\nRegisters (Generic):\n");
	printk("  Stack trace not supported on this architecture\n");
#endif

	printk("\nStack frames:\n");
	unsigned long *frame = (unsigned long *)fp;
	int depth = 0;

	while (frame && depth < 10) {
		unsigned long return_addr = *(frame - 1);
		unsigned long prev_fp = *(frame - 2);

		printk("  [%d] fp=0x%08lx, ra=0x%08lx\n",
		       depth, (unsigned long)frame, return_addr);

		/* Validate frame pointer */
		if (prev_fp == 0 || prev_fp < 0x20000000 || prev_fp > 0x20080000) {
			printk("  [%d] Invalid frame pointer, stopping\n", depth);
			break;
		}

		frame = (unsigned long *)prev_fp;
		depth++;
	}

	printk("===================\n\n");
}
```

## src/debug.h
```c
/*
 * Copyright (c) 2024 OneWo-rtLinux Team
 *
 * SPDX-License-Identifier: Apache-2.0
 *
 * Debug utilities header
 */

#ifndef DEBUG_H_
#define DEBUG_H_

/**
 * @brief Print current thread stack trace
 */
void print_stack_trace(void);

#endif /* DEBUG_H_ */
```

## src/signal.h
```c
/*
 * Copyright (c) 2024 OneWo-rtLinux Team
 * SPDX-License-Identifier: Apache-2.0
 */

#ifndef SIGNAL_H_
#define SIGNAL_H_

#include <zephyr/kernel.h>
#include <zephyr/kernel/process.h>

#ifdef __cplusplus
extern "C" {
#endif

/* Signal numbers (POSIX-like) */
#define SIGHUP    1   /* Hangup */
#define SIGINT    2   /* Interrupt (Ctrl+C) */
#define SIGQUIT   3   /* Quit (Ctrl+\) */
#define SIGILL    4   /* Illegal instruction */
#define SIGTRAP   5   /* Trace/breakpoint trap */
#define SIGABRT   6   /* Aborted */
#define SIGBUS    7   /* Bus error */
#define SIGFPE    8   /* Floating point exception */
#define SIGKILL   9   /* Kill (cannot be caught) */
#define SIGUSR1   10  /* User-defined signal 1 */
#define SIGSEGV   11  /* Segmentation fault */
#define SIGUSR2   12  /* User-defined signal 2 */
#define SIGPIPE   13  /* Broken pipe */
#define SIGALRM   14  /* Alarm clock */
#define SIGTERM   15  /* Termination */
#define SIGCHLD   17  /* Child stopped or terminated */
#define SIGCONT   18  /* Continue if stopped */
#define SIGSTOP   19  /* Stop process */
#define SIGTSTP   20  /* Stop typed at terminal (Ctrl+Z) */
#define SIGTTIN   21  /* Terminal input for background */
#define SIGTTOU   22  /* Terminal output for background */

#define _NSIG     32  /* Maximum number of signals */

/* Signal handler types */
#define SIG_DFL   ((signal_handler_t)0)  /* Default handler */
#define SIG_IGN   ((signal_handler_t)1)  /* Ignore signal */
#define SIG_ERR   ((signal_handler_t)-1) /* Error return */

/* Signal handler function type */
typedef void (*signal_handler_t)(int sig);

/* Per-process signal state */
struct process_signal {
	uint32_t pending_signals;        /* Pending signals bitmap */
	uint32_t blocked_signals;        /* Blocked signals bitmap */
	struct k_event signal_event;     /* Process-specific event for signal delivery */
	signal_handler_t handlers[_NSIG]; /* Signal handler functions */
	struct k_mutex lock;             /* Protect signal state */
};

/**
 * @brief Initialize signal subsystem for a process
 *
 * @param proc Process to initialize
 * @return 0 on success, negative errno on failure
 */
int signal_process_init(struct z_process *proc);

/**
 * @brief Cleanup signal subsystem for a process
 *
 * @param proc Process to cleanup
 */
void signal_process_cleanup(struct z_process *proc);

/**
 * @brief Send a signal to a process
 *
 * @param pid Target process ID
 * @param sig Signal number
 * @return 0 on success, negative errno on failure
 */
int kill(pid_t pid, int sig);

/**
 * @brief Send a signal to a process group
 *
 * @param pgid Process group ID
 * @param sig Signal number
 * @return 0 on success, negative errno on failure
 */
int killpg(pid_t pgid, int sig);

/**
 * @brief Set signal handler
 *
 * @param sig Signal number
 * @param handler Handler function (SIG_DFL, SIG_IGN, or function pointer)
 * @return Previous handler on success, SIG_ERR on failure
 */
signal_handler_t signal(int sig, signal_handler_t handler);

/**
 * @brief Block signals
 *
 * @param mask Signals to block (bitmap)
 * @return 0 on success, negative errno on failure
 */
int sigblock(uint32_t mask);

/**
 * @brief Unblock signals
 *
 * @param mask Signals to unblock (bitmap)
 * @return 0 on success, negative errno on failure
 */
int sigunblock(uint32_t mask);

/**
 * @brief Wait for signal event with timeout
 *
 * Check if any signals are pending for the current process.
 * This should be called periodically from process main loops.
 *
 * @param timeout_ms Timeout in milliseconds (K_MSEC value)
 * @return Signal number if pending, 0 if timeout, negative errno on error
 */
int signal_wait(k_timeout_t timeout);

/**
 * @brief Check and handle pending signals for current process
 *
 * Call this from interruptible wait loops.
 * Returns immediately if no signals pending.
 *
 * @return Number of signals handled, or negative errno on error
 */
int signal_check_pending(void);

/**
 * @brief Set foreground process group
 *
 * Only the foreground process group receives terminal signals (SIGINT, SIGTSTP, etc.)
 *
 * @param pgid Process group ID (0 = no foreground)
 */
void signal_set_foreground_pgid(pid_t pgid);

/**
 * @brief Get foreground process group
 *
 * @return Current foreground process group ID
 */
pid_t signal_get_foreground_pgid(void);

/**
 * @brief Get process signal state
 *
 * @param proc Process
 * @return Pointer to signal state, or NULL if not initialized
 */
struct process_signal *signal_get_state(struct z_process *proc);

#ifdef __cplusplus
}
#endif

#endif /* SIGNAL_H_ */
```

## src/vfs_commands.c
```c
/*
 * VFS RAMFS commands for as32x601_shell_process
 * Mounts ramfs at /tmp and provides: ls <path>, mkdir, cat
 * SPDX-License-Identifier: Apache-2.0
 */

#include <zephyr/kernel.h>
#include <zephyr/fs/fs.h>
#include <string.h>
#include <errno.h>
#include "shell_process.h"

#define VFS_TMP_MOUNT "/tmp"

static struct fs_mount_t tmp_mnt = {
	.type        = FS_TYPE_EXTERNAL_BASE,
	.mnt_point   = VFS_TMP_MOUNT,
	.storage_dev = (void *)"ramfs",
	.flags       = 0,
};

static int vfs_mount_tmp(void)
{
	int ret = fs_mount(&tmp_mnt);

	if (ret != 0) {
		printk("VFS: failed to mount ramfs at /tmp: %d\n", ret);
	} else {
		printk("VFS: ramfs mounted at /tmp\n");
	}
	return 0; /* non-fatal: shell still boots */
}

SYS_INIT(vfs_mount_tmp, APPLICATION, 100);

/* ------------------------------------------------------------------ */
/* ls [path]  — list a VFS directory                                   */
/* ------------------------------------------------------------------ */
int cmd_ls_vfs(int argc, char **argv)
{
	const char *path = (argc > 1) ? argv[1] : VFS_TMP_MOUNT;
	struct fs_dir_t dir;
	struct fs_dirent ent;
	int ret;

	fs_dir_t_init(&dir);
	ret = fs_opendir(&dir, path);
	if (ret != 0) {
		printk("ls: cannot open '%s': %d\n", path, ret);
		return ret;
	}

	while (true) {
		ret = fs_readdir(&dir, &ent);
		if (ret != 0 || ent.name[0] == '\0') {
			break;
		}
		if (ent.type == FS_DIR_ENTRY_DIR) {
			printk("%s/\n", ent.name);
		} else {
			printk("%-24s %zu bytes\n", ent.name, ent.size);
		}
	}

	fs_closedir(&dir);
	return 0;
}

/* ------------------------------------------------------------------ */
/* mkdir <path>                                                        */
/* ------------------------------------------------------------------ */
static int cmd_mkdir_vfs(int argc, char **argv)
{
	if (argc < 2) {
		printk("Usage: mkdir <path>\n");
		return -EINVAL;
	}

	int ret = fs_mkdir(argv[1]);

	if (ret != 0) {
		printk("mkdir: '%s': %d\n", argv[1], ret);
	}
	return ret;
}

/* ------------------------------------------------------------------ */
/* cat <file>                                                          */
/* ------------------------------------------------------------------ */
static int cmd_cat_vfs(int argc, char **argv)
{
	if (argc < 2) {
		printk("Usage: cat <file>\n");
		return -EINVAL;
	}

	struct fs_file_t f;
	char buf[128];
	ssize_t n;

	fs_file_t_init(&f);
	int ret = fs_open(&f, argv[1], FS_O_READ);

	if (ret != 0) {
		printk("cat: cannot open '%s': %d\n", argv[1], ret);
		return ret;
	}

	while ((n = fs_read(&f, buf, sizeof(buf) - 1)) > 0) {
		buf[n] = '\0';
		printk("%s", buf);
	}
	/* ensure trailing newline if file doesn't end with one */
	if (n == 0 && buf[0] != '\0' && buf[strlen(buf) - 1] != '\n') {
		printk("\n");
	}

	fs_close(&f);
	return 0;
}

/* ------------------------------------------------------------------ */
/* Register commands                                                   */
/* ------------------------------------------------------------------ */
static const struct shell_cmd vfs_cmd_mkdir = {
	.name  = "mkdir",
	.exec  = cmd_mkdir_vfs,
	.brief = "Create VFS directory",
};

static const struct shell_cmd vfs_cmd_cat = {
	.name  = "cat",
	.exec  = cmd_cat_vfs,
	.brief = "Print VFS file",
};

static int register_vfs_commands(void)
{
	shell_cmd_register(&vfs_cmd_mkdir);
	shell_cmd_register(&vfs_cmd_cat);
	return 0;
}

SYS_INIT(register_vfs_commands, APPLICATION, 101);
```
