## CMakeLists.txt
```
# SPDX-License-Identifier: Apache-2.0

cmake_minimum_required(VERSION 3.20.0)

find_package(Zephyr REQUIRED HINTS $ENV{ZEPHYR_BASE})
project(qemu_process_test)

target_sources(app PRIVATE
    src/main.c
    src/shell_process.c
    src/bytecode_vm.c
)
```

## prj.conf
```kconfig
# Shell configuration
CONFIG_SHELL=y
CONFIG_SHELL_BACKEND_SERIAL=y
CONFIG_SHELL_PROMPT_UART="qemu> "
CONFIG_SHELL_CMD_BUFF_SIZE=128
CONFIG_SHELL_PRINTF_BUFF_SIZE=128

# Process support
CONFIG_PROCESS_MODEL=y
CONFIG_MAX_PROCESS_COUNT=8
CONFIG_MAX_FD_PER_PROCESS=4

# Memory configuration - reduced for Cortex-M3
CONFIG_HEAP_MEM_POOL_SIZE=16384
CONFIG_MAIN_STACK_SIZE=2048
CONFIG_SHELL_STACK_SIZE=2048

# Thread configuration
CONFIG_NUM_PREEMPT_PRIORITIES=15

# Logging
CONFIG_LOG=n
CONFIG_BOOT_BANNER=n

# System configuration
CONFIG_CONSOLE=y
CONFIG_UART_CONSOLE=y
CONFIG_SERIAL=y
CONFIG_PRINTK=y

# Dynamic memory
CONFIG_DYNAMIC_THREAD=y
CONFIG_THREAD_STACK_INFO=y
CONFIG_THREAD_NAME=y
```

## src/main.c
```c
/*
 * Copyright (c) 2025 UCAS
 * SPDX-License-Identifier: Apache-2.0
 */

#include <zephyr/kernel.h>
#include <zephyr/kernel/process.h>
#include <zephyr/shell/shell.h>
#include <stdio.h>
#include "shell_process.h"

/* Test process entry function */
static void *test_process_main(void *arg)
{
	int id = (int)(uintptr_t)arg;

	printk("Process %d: Started (PID=%d)\n", id, process_current()->pid);

	for (int i = 0; i < 5; i++) {
		printk("Process %d: Iteration %d\n", id, i);
		k_msleep(1000);
	}

	printk("Process %d: Exiting\n", id);
	return (void *)(intptr_t)0;
}

/* Command: spawn - creates a new process */
static int exec_spawn(int argc, char **argv)
{
	if (argc < 2) {
		printk("Usage: spawn <id>\n");
		return -1;
	}

	int id = 0;
	for (const char *p = argv[1]; *p; p++) {
		if (*p >= '0' && *p <= '9') {
			id = id * 10 + (*p - '0');
		}
	}

	/* Create a new process using new_task */
	char name[32];
	snprintf(name, sizeof(name), "proc_%d", id);

	pid_t pid = new_task(name, test_process_main, (void *)(uintptr_t)id);

	if (pid > 0) {
		printk("Created process %d with PID %d\n", id, pid);
		return 0;
	} else {
		printk("Failed to create process: %d\n", pid);
		return -1;
	}
}

/* Command: ps - list processes */
static int exec_ps(int argc, char **argv)
{
	printk("PID  PPID NAME\n");
	printk("---  ---- ----\n");

	/* List all processes */
	for (int i = 0; i < CONFIG_MAX_PROCESS_COUNT; i++) {
		struct z_process *proc = process_get(i);
		if (proc && proc->pid > 0) {
			printk("%-4d %-4d %s\n",
			       proc->pid,
			       proc->parent ? proc->parent->pid : 0,
			       proc->threads.next ? "active" : "zombie");
		}
	}

	return 0;
}

/* Command: test */
static int exec_test(int argc, char **argv)
{
	printk("QEMU Process Test - Working!\n");
	printk("Available commands: spawn, ps, test\n");
	printk("\n");
	printk("Current process PID: %d\n", process_current()->pid);
	return 0;
}

/* Shell handlers - bridge to process-based commands */
static int shell_spawn_handler(const struct shell *sh, size_t argc, char **argv)
{
	const struct shell_cmd *cmd = shell_cmd_lookup("spawn");
	if (!cmd) {
		shell_error(sh, "Command not found");
		return -1;
	}

	int ret = shell_exec_command(cmd, argc, argv, true);
	if (ret != 0) {
		shell_error(sh, "Command failed: %d", ret);
	}
	return ret;
}

static int shell_ps_handler(const struct shell *sh, size_t argc, char **argv)
{
	const struct shell_cmd *cmd = shell_cmd_lookup("ps");
	if (!cmd) {
		shell_error(sh, "Command not found");
		return -1;
	}

	int ret = shell_exec_command(cmd, argc, argv, true);
	return ret;
}

static int shell_test_handler(const struct shell *sh, size_t argc, char **argv)
{
	const struct shell_cmd *cmd = shell_cmd_lookup("test");
	if (!cmd) {
		shell_error(sh, "Command not found");
		return -1;
	}

	int ret = shell_exec_command(cmd, argc, argv, true);
	return ret;
}

/* Register Zephyr shell commands */
SHELL_CMD_ARG_REGISTER(spawn, NULL, "Spawn a test process", shell_spawn_handler, 2, 0);
SHELL_CMD_ARG_REGISTER(ps, NULL, "List processes", shell_ps_handler, 1, 0);
SHELL_CMD_ARG_REGISTER(test, NULL, "Test command", shell_test_handler, 1, 0);

/* Bytecode VM shell handlers */
static int shell_ls_handler(const struct shell *sh, size_t argc, char **argv)
{
	const struct shell_cmd *cmd = shell_cmd_lookup("ls");
	if (!cmd) {
		shell_error(sh, "Command not found");
		return -1;
	}
	return shell_exec_command(cmd, argc, argv, true);
}

static int shell_upload_handler(const struct shell *sh, size_t argc, char **argv)
{
	const struct shell_cmd *cmd = shell_cmd_lookup("upload");
	if (!cmd) {
		shell_error(sh, "Command not found");
		return -1;
	}
	return shell_exec_command(cmd, argc, argv, true);
}

static int shell_run_handler(const struct shell *sh, size_t argc, char **argv)
{
	const struct shell_cmd *cmd = shell_cmd_lookup("run");
	if (!cmd) {
		shell_error(sh, "Command not found");
		return -1;
	}
	return shell_exec_command(cmd, argc, argv, true);
}

static int shell_rm_handler(const struct shell *sh, size_t argc, char **argv)
{
	const struct shell_cmd *cmd = shell_cmd_lookup("rm");
	if (!cmd) {
		shell_error(sh, "Command not found");
		return -1;
	}
	return shell_exec_command(cmd, argc, argv, true);
}

/* Register bytecode VM shell commands */
SHELL_CMD_ARG_REGISTER(ls, NULL, "List available programs", shell_ls_handler, 1, 0);
SHELL_CMD_ARG_REGISTER(upload, NULL, "Upload bytecode program", shell_upload_handler, 3, 0);
SHELL_CMD_ARG_REGISTER(run, NULL, "Execute bytecode program", shell_run_handler, 2, 0);
SHELL_CMD_ARG_REGISTER(rm, NULL, "Delete bytecode program", shell_rm_handler, 2, 0);

/* Register custom commands */
static struct shell_cmd cmd_spawn = {
	.name = "spawn",
	.brief = "Spawn a test process",
	.exec = exec_spawn,
};

static struct shell_cmd cmd_ps = {
	.name = "ps",
	.brief = "List processes",
	.exec = exec_ps,
};

static struct shell_cmd cmd_test = {
	.name = "test",
	.brief = "Test command",
	.exec = exec_test,
};

int main(void)
{
	printk("\n=== QEMU Process Test ===\n");
	printk("Process model enabled\n");
	printk("Shell ready. Try: test, spawn 1, ps\n\n");

	/* Register commands */
	shell_cmd_register(&cmd_spawn);
	shell_cmd_register(&cmd_ps);
	shell_cmd_register(&cmd_test);

	return 0;
}
```

## src/bytecode_vm.c
```c
/*
 * Bytecode Virtual Machine Implementation
 */

#include "bytecode_vm.h"
#include <zephyr/kernel.h>
#include <zephyr/shell/shell.h>
#include <string.h>

#define MAX_PROGRAMS 8

static struct bytecode_program program_pool[MAX_PROGRAMS];

/* Initialize VM state */
int vm_init(struct vm_state *vm, const uint8_t *code, size_t code_size)
{
    if (!vm || !code || code_size == 0 || code_size > VM_MAX_PROGRAM_SIZE) {
        return -EINVAL;
    }

    memset(vm, 0, sizeof(*vm));
    vm->code = code;
    vm->code_size = code_size;
    vm->pc = 0;
    vm->sp = -1;  // Empty stack
    vm->running = true;

    return 0;
}

/* Stack operations */
static inline int vm_push(struct vm_state *vm, int32_t value)
{
    if (vm->sp >= VM_STACK_SIZE - 1) {
        printk("VM ERROR: Stack overflow\n");
        return -ENOMEM;
    }
    vm->stack[++vm->sp] = value;
    return 0;
}

static inline int vm_pop(struct vm_state *vm, int32_t *value)
{
    if (vm->sp < 0) {
        printk("VM ERROR: Stack underflow\n");
        return -EINVAL;
    }
    *value = vm->stack[vm->sp--];
    return 0;
}

static inline int32_t vm_peek(struct vm_state *vm)
{
    if (vm->sp < 0) {
        return 0;
    }
    return vm->stack[vm->sp];
}

/* Read bytecode helpers */
static inline uint8_t read_byte(struct vm_state *vm)
{
    if (vm->pc >= vm->code_size) {
        return OP_HALT;
    }
    return vm->code[vm->pc++];
}

static inline int32_t read_int32(struct vm_state *vm)
{
    int32_t value = 0;
    if (vm->pc + 4 <= vm->code_size) {
        value = (vm->code[vm->pc] << 24) |
                (vm->code[vm->pc + 1] << 16) |
                (vm->code[vm->pc + 2] << 8) |
                vm->code[vm->pc + 3];
        vm->pc += 4;
    }
    return value;
}

/* Execute one instruction */
static int vm_step(struct vm_state *vm)
{
    uint8_t opcode = read_byte(vm);
    int32_t a, b, result;
    int ret;

    switch (opcode) {
    case OP_PUSH:
        result = read_int32(vm);
        return vm_push(vm, result);

    case OP_POP:
        return vm_pop(vm, &a);

    case OP_DUP:
        a = vm_peek(vm);
        return vm_push(vm, a);

    case OP_ADD:
        ret = vm_pop(vm, &b);
        if (ret < 0) return ret;
        ret = vm_pop(vm, &a);
        if (ret < 0) return ret;
        return vm_push(vm, a + b);

    case OP_SUB:
        ret = vm_pop(vm, &b);
        if (ret < 0) return ret;
        ret = vm_pop(vm, &a);
        if (ret < 0) return ret;
        return vm_push(vm, a - b);

    case OP_MUL:
        ret = vm_pop(vm, &b);
        if (ret < 0) return ret;
        ret = vm_pop(vm, &a);
        if (ret < 0) return ret;
        return vm_push(vm, a * b);

    case OP_DIV:
        ret = vm_pop(vm, &b);
        if (ret < 0) return ret;
        if (b == 0) {
            printk("VM ERROR: Division by zero\n");
            return -EINVAL;
        }
        ret = vm_pop(vm, &a);
        if (ret < 0) return ret;
        return vm_push(vm, a / b);

    case OP_EQ:
        ret = vm_pop(vm, &b);
        if (ret < 0) return ret;
        ret = vm_pop(vm, &a);
        if (ret < 0) return ret;
        return vm_push(vm, a == b ? 1 : 0);

    case OP_NE:
        ret = vm_pop(vm, &b);
        if (ret < 0) return ret;
        ret = vm_pop(vm, &a);
        if (ret < 0) return ret;
        return vm_push(vm, a != b ? 1 : 0);

    case OP_LT:
        ret = vm_pop(vm, &b);
        if (ret < 0) return ret;
        ret = vm_pop(vm, &a);
        if (ret < 0) return ret;
        return vm_push(vm, a < b ? 1 : 0);

    case OP_GT:
        ret = vm_pop(vm, &b);
        if (ret < 0) return ret;
        ret = vm_pop(vm, &a);
        if (ret < 0) return ret;
        return vm_push(vm, a > b ? 1 : 0);

    case OP_JMP:
        result = read_int32(vm);
        vm->pc = (size_t)result;
        if (vm->pc >= vm->code_size) {
            printk("VM ERROR: Jump out of bounds\n");
            return -EINVAL;
        }
        return 0;

    case OP_JZ:
        result = read_int32(vm);
        ret = vm_pop(vm, &a);
        if (ret < 0) return ret;
        if (a == 0) {
            vm->pc = (size_t)result;
            if (vm->pc >= vm->code_size) {
                printk("VM ERROR: Jump out of bounds\n");
                return -EINVAL;
            }
        }
        return 0;

    case OP_JNZ:
        result = read_int32(vm);
        ret = vm_pop(vm, &a);
        if (ret < 0) return ret;
        if (a != 0) {
            vm->pc = (size_t)result;
            if (vm->pc >= vm->code_size) {
                printk("VM ERROR: Jump out of bounds\n");
                return -EINVAL;
            }
        }
        return 0;

    case OP_PRINT:
        ret = vm_pop(vm, &a);
        if (ret < 0) return ret;
        printk("%d\n", a);
        return 0;

    case OP_PRINT_STR: {
        uint8_t len = read_byte(vm);
        if (vm->pc + len > vm->code_size) {
            printk("VM ERROR: String out of bounds\n");
            return -EINVAL;
        }
        for (uint8_t i = 0; i < len; i++) {
            printk("%c", vm->code[vm->pc++]);
        }
        return 0;
    }

    case OP_SLEEP:
        ret = vm_pop(vm, &a);
        if (ret < 0) return ret;
        if (a > 0) {
            k_msleep(a);
        }
        return 0;

    case OP_GETPID:
        /* In Zephyr, we can use k_current_get() */
        return vm_push(vm, (int32_t)(uintptr_t)k_current_get());

    case OP_HALT:
        vm->running = false;
        return 0;

    default:
        printk("VM ERROR: Unknown opcode 0x%02x at PC=%zu\n", opcode, vm->pc - 1);
        return -EINVAL;
    }
}

/* Run the VM until halt or error */
int vm_run(struct vm_state *vm)
{
    int ret;
    int instruction_count = 0;
    const int MAX_INSTRUCTIONS = 100000;  // Prevent infinite loops

    if (!vm || !vm->running) {
        return -EINVAL;
    }

    while (vm->running && vm->pc < vm->code_size) {
        ret = vm_step(vm);
        if (ret < 0) {
            printk("VM execution failed at PC=%zu\n", vm->pc);
            return ret;
        }

        instruction_count++;
        if (instruction_count > MAX_INSTRUCTIONS) {
            printk("VM ERROR: Instruction limit exceeded (infinite loop?)\n");
            return -ETIMEDOUT;
        }

        /* Yield to other threads periodically */
        if (instruction_count % 100 == 0) {
            k_yield();
        }
    }

    return 0;
}

/* Cleanup VM state */
void vm_cleanup(struct vm_state *vm)
{
    if (vm) {
        vm->running = false;
        vm->sp = -1;
        vm->pc = 0;
    }
}

/* Program Management Functions */

int vm_load_program(const char *name, const uint8_t *code, size_t size)
{
    if (!name || !code || size == 0 || size > VM_MAX_PROGRAM_SIZE) {
        return -EINVAL;
    }

    /* Check if program already exists */
    for (int i = 0; i < MAX_PROGRAMS; i++) {
        if (program_pool[i].in_use &&
            strcmp(program_pool[i].name, name) == 0) {
            printk("Program '%s' already exists\n", name);
            return -EEXIST;
        }
    }

    /* Find free slot */
    for (int i = 0; i < MAX_PROGRAMS; i++) {
        if (!program_pool[i].in_use) {
            /* Allocate memory for bytecode */
            program_pool[i].code = k_malloc(size);
            if (!program_pool[i].code) {
                printk("Failed to allocate memory for program\n");
                return -ENOMEM;
            }

            /* Copy bytecode */
            memcpy(program_pool[i].code, code, size);
            strncpy(program_pool[i].name, name, sizeof(program_pool[i].name) - 1);
            program_pool[i].name[sizeof(program_pool[i].name) - 1] = '\0';
            program_pool[i].code_size = size;
            program_pool[i].in_use = true;

            printk("Program '%s' loaded (%zu bytes)\n", name, size);
            return 0;
        }
    }

    printk("No free program slots\n");
    return -ENOMEM;
}

int vm_delete_program(const char *name)
{
    if (!name) {
        return -EINVAL;
    }

    for (int i = 0; i < MAX_PROGRAMS; i++) {
        if (program_pool[i].in_use &&
            strcmp(program_pool[i].name, name) == 0) {
            k_free(program_pool[i].code);
            memset(&program_pool[i], 0, sizeof(program_pool[i]));
            printk("Program '%s' deleted\n", name);
            return 0;
        }
    }

    printk("Program '%s' not found\n", name);
    return -ENOENT;
}

struct bytecode_program *vm_find_program(const char *name)
{
    if (!name) {
        return NULL;
    }

    for (int i = 0; i < MAX_PROGRAMS; i++) {
        if (program_pool[i].in_use &&
            strcmp(program_pool[i].name, name) == 0) {
            return &program_pool[i];
        }
    }

    return NULL;
}

void vm_list_programs(void)
{
    int count = 0;

    printk("Loaded programs:\n");
    for (int i = 0; i < MAX_PROGRAMS; i++) {
        if (program_pool[i].in_use) {
            printk("  %-16s  %5zu bytes\n",
                   program_pool[i].name,
                   program_pool[i].code_size);
            count++;
        }
    }

    if (count == 0) {
        printk("  (none)\n");
    }
}

/* Execute program in current context (for testing) */
int vm_execute_program(const char *name, int argc, char **argv)
{
    struct bytecode_program *prog = vm_find_program(name);
    if (!prog) {
        printk("Program '%s' not found\n", name);
        return -ENOENT;
    }

    struct vm_state vm;
    int ret;

    ret = vm_init(&vm, prog->code, prog->code_size);
    if (ret < 0) {
        printk("Failed to initialize VM\n");
        return ret;
    }

    printk("Executing '%s'...\n", name);
    ret = vm_run(&vm);

    if (ret == 0) {
        printk("Program '%s' completed successfully\n", name);
    } else {
        printk("Program '%s' failed with error %d\n", name, ret);
    }

    vm_cleanup(&vm);
    return ret;
}
```

## src/shell_process.c
```c
/*
 * Copyright (c) 2024 OneWo-rtLinux Team
 *
 * SPDX-License-Identifier: Apache-2.0
 *
 * Shell Process Execution Implementation
 * Based on Embox's tish.c and new_task() mechanism
 */

#include <zephyr/kernel.h>
#include <zephyr/kernel/process.h>
#include <string.h>
#include <errno.h>
#include <stdio.h>
#include "shell_process.h"

#define MAX_COMMANDS 32
#define TASK_STACK_SIZE 2048

/* Command registry */
static const struct shell_cmd *command_registry[MAX_COMMANDS];
static int command_count = 0;
static struct k_mutex cmd_registry_lock;

/* Process exit message structure */
struct process_exit_msg {
	pid_t pid;
	int exit_code;
};

/* Process wait queue for waitpid() */
K_MSGQ_DEFINE(process_exit_queue, sizeof(struct process_exit_msg), 16, 4);

/* Stack tracking for cleanup - maps PID to stack pointer */
#define MAX_TRACKED_STACKS 16

/* Static stack pool - must use K_THREAD_STACK_DEFINE for proper alignment */
#define MAX_STACK_POOL 8
K_THREAD_STACK_ARRAY_DEFINE(stack_pool, MAX_STACK_POOL, TASK_STACK_SIZE);
static bool stack_pool_used[MAX_STACK_POOL];
static struct k_mutex stack_pool_lock;

static struct {
	pid_t pid;
	int stack_index;  /* Index into stack_pool instead of pointer */
	struct k_thread *thread;
} stack_tracker[MAX_TRACKED_STACKS];
static struct k_mutex stack_tracker_lock;

/* Thread entry point trampoline */
struct task_trampoline_arg {
	void *(*run)(void *);
	void *run_arg;
};

/**
 * @brief Task trampoline - wraps user function
 *
 * Similar to Embox's task_trampoline() in multi.c
 */
static void task_trampoline(void *arg1, void *arg2, void *arg3)
{
	struct task_trampoline_arg *arg = (struct task_trampoline_arg *)arg1;
	void *result;

	//printk("DEBUG: task_trampoline started, arg=%p\n", arg);
	k_msleep(10); /* Small delay to ensure parent is ready */

	if (!arg || !arg->run) {
		//printk("DEBUG: task_trampoline - invalid arg\n");
		return;
	}

	/* Execute user function */
	//printk("DEBUG: task_trampoline - calling user function at %p\n", arg->run);
	result = arg->run(arg->run_arg);
	//printk("DEBUG: task_trampoline - user function returned %p\n", result);

	/* Send exit notification */
	struct z_process *proc = process_current();
	//printk("DEBUG: task_trampoline - process_current returned %p\n", proc);
	if (proc) {
		//printk("DEBUG: task_trampoline - sending exit msg for PID %d\n", proc->pid);
		struct process_exit_msg msg = {
			.pid = proc->pid,
			.exit_code = (int)(intptr_t)result,
		};
		int ret = k_msgq_put(&process_exit_queue, &msg, K_NO_WAIT);
		//printk("DEBUG: task_trampoline - k_msgq_put returned %d\n", ret);
	}

	/* Free trampoline argument */
	//printk("DEBUG: task_trampoline - freeing trampoline arg\n");
	k_free(arg);

	/* CRITICAL: Yield to let waitpid start processing before we exit */
	//printk("DEBUG: task_trampoline - yielding before exit\n");
	k_yield();
	k_msleep(100);  /* Give plenty of time for waitpid to call k_thread_join */

	//printk("DEBUG: task_trampoline - about to return (thread will exit)\n");
	//printk("DEBUG: task_trampoline - SP=%p\n", (void *)__builtin_frame_address(0));
}

/**
 * @brief Create a new task/process
 *
 * Implementation based on Embox's new_task() in multi.c
 */
pid_t new_task(const char *name, void *(*run)(void *), void *arg)
{
	if (!run) {
		return -EINVAL;
	}

	//printk("DEBUG: new_task - getting parent process\n");
	/* Get current process as parent */
	struct z_process *parent = process_current();
	if (!parent) {
		//printk("DEBUG: new_task - no parent process!\n");
		return -ESRCH;
	}
	//printk("DEBUG: new_task - parent PID = %d\n", parent->pid);

	/* Create new process */
	//printk("DEBUG: new_task - creating child process\n");
	struct z_process *child = process_create(parent);
	if (!child) {
		//printk("DEBUG: new_task - process_create failed!\n");
		return -ENOMEM;
	}
	//printk("DEBUG: new_task - child PID = %d\n", child->pid);

	/* Allocate thread stack from pool */
	k_thread_stack_t *stack = NULL;
	int stack_index = -1;

	k_mutex_lock(&stack_pool_lock, K_FOREVER);
	for (int i = 0; i < MAX_STACK_POOL; i++) {
		if (!stack_pool_used[i]) {
			stack_pool_used[i] = true;
			stack = &stack_pool[i][0];  /* Direct array access */
			stack_index = i;
			//printk("DEBUG: new_task - allocated stack from pool index %d at %p\n", i, stack);
			break;
		}
	}
	k_mutex_unlock(&stack_pool_lock);

	if (!stack) {
		//printk("DEBUG: new_task - stack pool exhausted!\n");
		process_exit(child, -ENOMEM);
		return -ENOMEM;
	}

	/* Allocate thread structure */
	struct k_thread *thread = k_malloc(sizeof(struct k_thread));
	if (!thread) {
		k_mutex_lock(&stack_pool_lock, K_FOREVER);
		stack_pool_used[stack_index] = false;
		k_mutex_unlock(&stack_pool_lock);
		process_exit(child, -ENOMEM);
		return -ENOMEM;
	}

	/* Allocate trampoline argument */
	struct task_trampoline_arg *tramp_arg = k_malloc(sizeof(struct task_trampoline_arg));
	if (!tramp_arg) {
		k_free(thread);
		k_mutex_lock(&stack_pool_lock, K_FOREVER);
		stack_pool_used[stack_index] = false;
		k_mutex_unlock(&stack_pool_lock);
		process_exit(child, -ENOMEM);
		return -ENOMEM;
	}

	tramp_arg->run = run;
	tramp_arg->run_arg = arg;

	/* CRITICAL: Register thread with process BEFORE starting it
	 * Otherwise the thread starts immediately and gets the wrong process!
	 */
	//printk("DEBUG: new_task - registering thread with child process BEFORE create\n");
	process_register_thread(child, thread);

	/* Create and start thread */
	//printk("DEBUG: new_task - creating thread\n");
	k_tid_t tid = k_thread_create(
		thread,
		stack,
		K_THREAD_STACK_SIZEOF(TASK_STACK_SIZE),
		task_trampoline,
		tramp_arg,
		NULL,
		NULL,
		K_PRIO_PREEMPT(7),
		0,
		K_NO_WAIT
	);

	if (!tid) {
		process_unregister_thread(child, thread);
		k_free(tramp_arg);
		k_free(thread);
		k_mutex_lock(&stack_pool_lock, K_FOREVER);
		stack_pool_used[stack_index] = false;
		k_mutex_unlock(&stack_pool_lock);
		process_exit(child, -EAGAIN);
		return -EAGAIN;
	}

	//printk("DEBUG: new_task - thread created, tid = %p\n", tid);

	/* Store stack index and thread pointers for later cleanup */
	k_mutex_lock(&stack_tracker_lock, K_FOREVER);
	for (int i = 0; i < MAX_TRACKED_STACKS; i++) {
		if (stack_tracker[i].pid == 0) {
			stack_tracker[i].pid = child->pid;
			stack_tracker[i].stack_index = stack_index;
			stack_tracker[i].thread = thread;
			/*printk("DEBUG: new_task - stored stack index %d for PID %d\n",
			  stack_index, child->pid);*/
			break;
		}
	}
	k_mutex_unlock(&stack_tracker_lock);

	/* Set thread name */
	if (name && name[0] != '\0') {
		k_thread_name_set(tid, name);
	} else {
		char default_name[16];
		snprintf(default_name, sizeof(default_name), "task_%d", child->pid);
		k_thread_name_set(tid, default_name);
	}

	//printk("DEBUG: new_task - returning PID %d\n", child->pid);
	return child->pid;
}

/**
 * @brief Wait for a process to complete
 *
 * Simplified waitpid for shell command execution
 */
pid_t waitpid(pid_t pid, int *status, int options)
{
	struct process_exit_msg msg;
	int ret;

	//printk("DEBUG: waitpid - waiting for PID %d\n", pid);

	/* Wait for exit message from the specified process */
	while (1) {
		ret = k_msgq_get(&process_exit_queue, &msg, K_FOREVER);
		if (ret == 0) {
			//printk("DEBUG: waitpid - got exit msg for PID %d\n", msg.pid);
			if (msg.pid == pid || pid == -1) {
				if (status) {
					*status = msg.exit_code;
				}

				/* CRITICAL: Wait for the thread to fully exit before cleanup */
				//printk("DEBUG: waitpid - getting process %d\n", msg.pid);
				struct z_process *proc = process_get(msg.pid);
				//printk("DEBUG: waitpid - process_get returned %p\n", proc);

				if (proc && proc->main_thread) {
					//printk("DEBUG: waitpid - main_thread = %p\n", proc->main_thread);

					/* Retrieve stack index from tracker */
					int stack_index = -1;
					struct k_thread *thread = proc->main_thread;

					k_mutex_lock(&stack_tracker_lock, K_FOREVER);
					for (int i = 0; i < MAX_TRACKED_STACKS; i++) {
						if (stack_tracker[i].pid == msg.pid) {
							stack_index = stack_tracker[i].stack_index;
							/*printk("DEBUG: waitpid - found stack index %d for PID %d\n",
							  stack_index, msg.pid);*/
							stack_tracker[i].pid = 0; /* Clear entry */
							stack_tracker[i].stack_index = -1;
							stack_tracker[i].thread = NULL;
							break;
						}
					}
					k_mutex_unlock(&stack_tracker_lock);

					//printk("DEBUG: waitpid - stack_index = %d\n", stack_index);

					/* Join the thread to ensure it's completely done */
					//printk("DEBUG: waitpid - calling k_thread_join...\n");
					k_thread_join(proc->main_thread, K_FOREVER);
					//printk("DEBUG: waitpid - k_thread_join completed\n");

					/* Unregister thread from process */
					//printk("DEBUG: waitpid - unregistering thread\n");
					process_unregister_thread(proc, thread);

					/* Free thread structure (but NOT the stack - it's static) */
					//printk("DEBUG: waitpid - freeing thread\n");
					k_free(thread);

					/* Return stack to pool */
					if (stack_index >= 0 && stack_index < MAX_STACK_POOL) {
						k_mutex_lock(&stack_pool_lock, K_FOREVER);
						stack_pool_used[stack_index] = false;
						k_mutex_unlock(&stack_pool_lock);
						//printk("DEBUG: waitpid - returned stack index %d to pool\n", stack_index);
					}

					/* Clean up process */
					//printk("DEBUG: waitpid - cleaning up process\n");
					process_exit(proc, msg.exit_code);
				}

				//printk("DEBUG: waitpid - returning %d\n", msg.pid);
				return msg.pid;
			}
			/* Not our process, put it back */
			k_msgq_put(&process_exit_queue, &msg, K_NO_WAIT);
			k_yield();
		}
	}

	return -ECHILD;
}

/**
 * @brief Command execution wrapper
 *
 * Similar to Embox's run_cmd() in tish.c
 */
static void *run_cmd(void *data)
{
	struct cmd_data *cdata_ptr = (struct cmd_data *)data;
	struct cmd_data cdata;
	int ret;

	if (!cdata_ptr || !cdata_ptr->cmd || !cdata_ptr->cmd->exec) {
		if (cdata_ptr) {
			k_sem_give(&cdata_ptr->copied_sem);
		}
		return (void *)(intptr_t)(-EINVAL);
	}

	/* Copy command data to our stack FIRST - CRITICAL! */
	memcpy(&cdata, cdata_ptr, sizeof(struct cmd_data));

	/* Signal parent that we've copied the data - USE SEMAPHORE */
	k_sem_give(&cdata_ptr->copied_sem);

	/* Execute command using our local copy */
	ret = cdata.cmd->exec(cdata.argc, cdata.argv);

	return (void *)(intptr_t)ret;
}

/**
 * @brief Execute a shell command in a new process
 *
 * Similar to Embox's process_external() in tish.c
 */
int shell_exec_command(const struct shell_cmd *cmd, int argc, char **argv, bool on_fg)
{
	struct cmd_data cdata = {
		.argc = argc,
		.argv = argv,
		.cmd = cmd,
		.on_fg = on_fg,
		.result = 0,
	};

	//printk("DEBUG: shell_exec_command - starting for '%s'\n", cmd->name);

	/* Initialize semaphore for synchronization */
	k_sem_init(&cdata.copied_sem, 0, 1);

	/* Create new task for command execution */
	//printk("DEBUG: shell_exec_command - calling new_task\n");
	pid_t pid = new_task(cmd->name, run_cmd, &cdata);
	//printk("DEBUG: shell_exec_command - new_task returned PID %d\n", pid);
	if (pid < 0) {
	  /*printk("Error: Failed to create task for command '%s': %d\n",
	    cmd->name, pid);*/
		return pid;
	}

	/* CRITICAL: Wait for child to copy cmd_data using semaphore
	 * This is more reliable than polling with k_yield or k_msleep
	 */
	int ret = k_sem_take(&cdata.copied_sem, K_MSEC(1000));
	if (ret != 0) {
		//printk("ERROR: Timeout waiting for child process %d to copy data\n", pid);
		return -ETIMEDOUT;
	}

	/* Now safe - child has copied the data, we can continue */

	/* Wait for foreground commands to complete */
	if (on_fg) {
		int status = 0;
		pid_t wait_result = waitpid(pid, &status, 0);
		if (wait_result < 0) {
			//printk("Error: waitpid failed: %d\n", wait_result);
			return wait_result;
		}
		return status;
	} else {
		/* Background command */
		//printk("[%d] %s &\n", pid, cmd->name);
		return 0;
	}
}

/**
 * @brief Find a command by name
 */
const struct shell_cmd *shell_cmd_lookup(const char *name)
{
	if (!name) {
		return NULL;
	}

	k_mutex_lock(&cmd_registry_lock, K_FOREVER);

	for (int i = 0; i < command_count; i++) {
		if (command_registry[i] &&
		    strcmp(command_registry[i]->name, name) == 0) {
			k_mutex_unlock(&cmd_registry_lock);
			return command_registry[i];
		}
	}

	k_mutex_unlock(&cmd_registry_lock);
	return NULL;
}

/**
 * @brief Register a shell command
 */
int shell_cmd_register(const struct shell_cmd *cmd)
{
	if (!cmd || !cmd->name || !cmd->exec) {
		return -EINVAL;
	}

	k_mutex_lock(&cmd_registry_lock, K_FOREVER);

	if (command_count >= MAX_COMMANDS) {
		k_mutex_unlock(&cmd_registry_lock);
		return -ENOMEM;
	}

	command_registry[command_count++] = cmd;
	k_mutex_unlock(&cmd_registry_lock);

	return 0;
}

/**
 * @brief Initialize shell process subsystem
 */
void shell_process_init(void)
{
	k_mutex_init(&cmd_registry_lock);
	k_mutex_init(&stack_tracker_lock);
	k_mutex_init(&stack_pool_lock);
	command_count = 0;
	memset(command_registry, 0, sizeof(command_registry));
	memset(stack_tracker, 0, sizeof(stack_tracker));
	memset(stack_pool_used, 0, sizeof(stack_pool_used));
}

/* Initialize at startup */
static int shell_process_init_wrapper(void)
{
	shell_process_init();
	return 0;
}

SYS_INIT(shell_process_init_wrapper, APPLICATION, CONFIG_KERNEL_INIT_PRIORITY_DEFAULT);

/* Bytecode VM integration */
#include "bytecode_vm.h"

/**
 * @brief Shell command: ls - List available programs
 */
static int cmd_ls_exec(int argc, char **argv)
{
	printk("Built-in commands:\n");
	k_mutex_lock(&cmd_registry_lock, K_FOREVER);
	for (int i = 0; i < command_count; i++) {
		if (command_registry[i]) {
			printk("  %-16s  (builtin)\n", command_registry[i]->name);
		}
	}
	k_mutex_unlock(&cmd_registry_lock);

	printk("\n");
	vm_list_programs();

	return 0;
}

static const struct shell_cmd cmd_ls = {
	.name = "ls",
	.exec = cmd_ls_exec,
	.brief = "List available programs"
};

/**
 * @brief Shell command: upload - Upload bytecode program (simulated)
 * Usage: upload <name> <program_id>
 */
static int cmd_upload_exec(int argc, char **argv)
{
	if (argc < 3) {
		printk("Usage: upload <name> <program_id>\n");
		printk("Available program_id:\n");
		printk("  hello    - Hello world program\n");
		printk("  counter  - Count from 1 to 10\n");
		printk("  calc     - Simple calculator demo\n");
		return -EINVAL;
	}

	const char *name = argv[1];
	const char *prog_id = argv[2];

	/* Sample bytecode programs (for testing) */

	/* Program: hello - prints "Hello World!" and number 42 */
	static const uint8_t prog_hello[] = {
		OP_PRINT_STR, 13, 'H', 'e', 'l', 'l', 'o', ' ', 'W', 'o', 'r', 'l', 'd', '!', '\n',
		OP_PUSH, 0, 0, 0, 42,    // Push 42
		OP_PRINT,                // Print it
		OP_HALT
	};

	/* Program: counter - counts from 1 to 10 */
	static const uint8_t prog_counter[] = {
		// Initialize counter to 1
		OP_PUSH, 0, 0, 0, 1,     // counter = 1

		// Loop start (PC = 5)
		OP_DUP,                  // Duplicate counter for comparison
		OP_PUSH, 0, 0, 0, 11,    // Push 11
		OP_LT,                   // counter < 11 ?
		OP_JZ, 0, 0, 0, 33,      // If false, jump to end (PC 33)

		// Loop body
		OP_DUP,                  // Duplicate counter for printing
		OP_PRINT,                // Print counter
		OP_PUSH, 0, 0, 0, 1,     // Push 1
		OP_ADD,                  // counter++
		OP_PUSH, 0, 0, 0, 100,   // Push 100ms
		OP_SLEEP,                // Sleep
		OP_JMP, 0, 0, 0, 5,      // Jump back to loop start

		// End (PC = 33)
		OP_POP,                  // Clean up stack
		OP_HALT
	};

	/* Program: calc - demonstrates arithmetic (5 + 3) * 2 = 16 */
	static const uint8_t prog_calc[] = {
		OP_PRINT_STR, 17, 'C', 'a', 'l', 'c', ':', ' ', '(', '5', '+', '3', ')', '*', '2', ' ', '=', ' ','\n',
		OP_PUSH, 0, 0, 0, 5,     // Push 5
		OP_PUSH, 0, 0, 0, 3,     // Push 3
		OP_ADD,                  // 5 + 3 = 8
		OP_PUSH, 0, 0, 0, 2,     // Push 2
		OP_MUL,                  // 8 * 2 = 16
		OP_PRINT,                // Print result
		OP_HALT
	};

	const uint8_t *code = NULL;
	size_t code_size = 0;

	if (strcmp(prog_id, "hello") == 0) {
		code = prog_hello;
		code_size = sizeof(prog_hello);
	} else if (strcmp(prog_id, "counter") == 0) {
		code = prog_counter;
		code_size = sizeof(prog_counter);
	} else if (strcmp(prog_id, "calc") == 0) {
		code = prog_calc;
		code_size = sizeof(prog_calc);
	} else {
		printk("Unknown program_id: %s\n", prog_id);
		return -EINVAL;
	}

	printk("Uploading program '%s' (%zu bytes)...\n", name, code_size);
	int ret = vm_load_program(name, code, code_size);
	if (ret < 0) {
		printk("Failed to load program: %d\n", ret);
		return ret;
	}

	printk("Upload complete. Use './run %s' to execute.\n", name);
	return 0;
}

static const struct shell_cmd cmd_upload = {
	.name = "upload",
	.exec = cmd_upload_exec,
	.brief = "Upload bytecode program"
};

/**
 * @brief Shell command: run - Execute bytecode program
 * Usage: run <name>
 */
static int cmd_run_exec(int argc, char **argv)
{
	if (argc < 2) {
		printk("Usage: run <program_name>\n");
		return -EINVAL;
	}

	const char *name = argv[1];
	return vm_execute_program(name, argc - 1, &argv[1]);
}

static const struct shell_cmd cmd_run = {
	.name = "run",
	.exec = cmd_run_exec,
	.brief = "Execute bytecode program"
};

/**
 * @brief Shell command: rm - Delete bytecode program
 * Usage: rm <name>
 */
static int cmd_rm_exec(int argc, char **argv)
{
	if (argc < 2) {
		printk("Usage: rm <program_name>\n");
		return -EINVAL;
	}

	const char *name = argv[1];
	return vm_delete_program(name);
}

static const struct shell_cmd cmd_rm = {
	.name = "rm",
	.exec = cmd_rm_exec,
	.brief = "Delete bytecode program"
};

/**
 * @brief Register bytecode commands
 */
static int register_bytecode_commands(void)
{
	shell_cmd_register(&cmd_ls);
	shell_cmd_register(&cmd_upload);
	shell_cmd_register(&cmd_run);
	shell_cmd_register(&cmd_rm);
	return 0;
}

SYS_INIT(register_bytecode_commands, APPLICATION, 99);
```

## src/shell_process.h
```c
/*
 * Copyright (c) 2024 OneWo-rtLinux Team
 *
 * SPDX-License-Identifier: Apache-2.0
 */

#ifndef SHELL_PROCESS_H_
#define SHELL_PROCESS_H_

#include <zephyr/kernel.h>
#include <zephyr/kernel/process.h>

#ifdef __cplusplus
extern "C" {
#endif

/**
 * @brief Command execution function type
 *
 * Similar to Embox's cmd_exec_t
 */
typedef int (*cmd_exec_t)(int argc, char **argv);

/**
 * @brief Command descriptor
 *
 * Defines a shell command with its execution function
 */
struct shell_cmd {
	const char *name;        /* Command name */
	const char *brief;       /* Brief description */
	cmd_exec_t exec;         /* Execution function */
};

/**
 * @brief Command data structure
 *
 * Passed to new process when executing command.
 * Similar to Embox's struct cmd_data
 */
struct cmd_data {
	int argc;
	char **argv;
	const struct shell_cmd *cmd;
	bool on_fg;              /* Foreground execution flag */
	struct k_sem copied_sem; /* Semaphore for data copy synchronization */
	int result;              /* Command result code */
};

/**
 * @brief Create a new task/process
 *
 * Embox-compatible API for creating processes.
 * Creates a new process with its own thread.
 *
 * @param name Task name (can be empty string)
 * @param run Entry point function
 * @param arg Argument passed to entry point
 * @return Process ID (PID) on success, negative error code on failure
 */
pid_t new_task(const char *name, void *(*run)(void *), void *arg);

/**
 * @brief Wait for a process to complete
 *
 * Simplified waitpid implementation for foreground command execution.
 *
 * @param pid Process ID to wait for
 * @param status Pointer to store exit status (can be NULL)
 * @param options Wait options (currently unused)
 * @return PID on success, negative error code on failure
 */
pid_t waitpid(pid_t pid, int *status, int options);

/**
 * @brief Execute a shell command in a new process
 *
 * Similar to Embox's process_external() in tish.c
 *
 * @param cmd Command descriptor
 * @param argc Argument count
 * @param argv Argument array
 * @param on_fg True for foreground execution (wait), false for background
 * @return 0 on success, negative error code on failure
 */
int shell_exec_command(const struct shell_cmd *cmd, int argc, char **argv, bool on_fg);

/**
 * @brief Find a command by name
 *
 * @param name Command name to look up
 * @return Pointer to command descriptor or NULL if not found
 */
const struct shell_cmd *shell_cmd_lookup(const char *name);

/**
 * @brief Register a shell command
 *
 * @param cmd Command descriptor to register
 * @return 0 on success, negative error code on failure
 */
int shell_cmd_register(const struct shell_cmd *cmd);

/**
 * @brief Initialize shell process subsystem
 */
void shell_process_init(void);

/* Macro for command registration */
#define SHELL_CMD_REGISTER(_name, _brief, _exec) \
	static const struct shell_cmd _shell_cmd_##_name = { \
		.name = #_name, \
		.brief = _brief, \
		.exec = _exec, \
	}; \
	static int _shell_cmd_init_##_name(void) { \
		return shell_cmd_register(&_shell_cmd_##_name); \
	} \
	SYS_INIT(_shell_cmd_init_##_name, APPLICATION, \
		 CONFIG_KERNEL_INIT_PRIORITY_DEFAULT);

#ifdef __cplusplus
}
#endif

#endif /* SHELL_PROCESS_H_ */
```
