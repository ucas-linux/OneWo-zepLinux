## CMakeLists.txt
```
cmake_minimum_required(VERSION 3.20.0)
find_package(Zephyr REQUIRED HINTS $ENV{ZEPHYR_BASE})
project(irq_latency_pb1_once)

target_sources(app PRIVATE src/main.c src/devfd.c)
```

## sample.yaml
```
sample:
  name: Rocket Pi PB1 one-shot loopback with IRQ latency

tests:
  sample.basic.irq_latency_pb1_once:
    platform_allow:
      - rocket_pi/stm32f401xe
    integration_platforms:
      - rocket_pi/stm32f401xe
    tags:
      - samples
      - counter
      - gpio
```

## prj.conf
```kconfig
CONFIG_CONSOLE=y
CONFIG_PRINTK=y
CONFIG_COUNTER=y
CONFIG_GPIO=y
CONFIG_ZVFS=y
CONFIG_FDTABLE=y
CONFIG_ZVFS_POLL=y
CONFIG_ZVFS_SELECT=y
CONFIG_ZVFS_OPEN_MAX=8
```

## boards/rocket_pi_stm32f401xe.overlay
```dts
&timers2 {
	status = "okay";

	counter {
		status = "okay";
	};
};
```

## src/main.c
```c
#include <stdint.h>
#include <errno.h>
#include <stdarg.h>

#include <zephyr/devicetree.h>
#include <zephyr/drivers/counter.h>
#include <zephyr/kernel.h>
#include <zephyr/sys/printk.h>
#include <zephyr/sys/time_units.h>

#include "devfd.h"

#define open  dev_open
#define close dev_close
#define ioctl dev_ioctl

#define TIMER_NODE DT_NODELABEL(timers2)
#define COUNTER_NODE DT_CHILD(TIMER_NODE, counter)
#define LOOPBACK_OUT_NODE DT_ALIAS(loopback_out)
#define LOOPBACK_IN_NODE  DT_ALIAS(loopback_in)

#if !DT_NODE_HAS_STATUS(COUNTER_NODE, okay)
#error "TIM2 counter node is not enabled"
#endif

#if !DT_NODE_HAS_STATUS(LOOPBACK_OUT_NODE, okay)
#error "Unsupported board: loopback_out devicetree alias is not defined"
#endif

#if !DT_NODE_HAS_STATUS(LOOPBACK_IN_NODE, okay)
#error "Unsupported board: loopback_in devicetree alias is not defined"
#endif

#define TEST_PERIOD_US   1000U
#define ALARM_CHANNEL_ID 0U

static struct k_sem sample_sem;

static volatile uint32_t expected_counter_tick;
static volatile uint32_t expected_cycle;
static volatile uint32_t measured_cycle;
static volatile uint32_t measured_counter_tick;
static volatile uint32_t sample_ready;

static uint32_t cycles_to_ns_u32(uint32_t cycles)
{
	uint64_t ns = k_cyc_to_ns_floor64(cycles);

	if (ns > UINT32_MAX) {
		return UINT32_MAX;
	}

	return (uint32_t)ns;
}

static void alarm_callback(const struct device *dev, uint8_t chan_id,
			   uint32_t ticks, void *user_data)
{
	ARG_UNUSED(dev);
	ARG_UNUSED(chan_id);
	ARG_UNUSED(user_data);

	measured_cycle = k_cycle_get_32();
	measured_counter_tick = ticks;
	sample_ready = 1U;
	k_sem_give(&sample_sem);
}

int main(void)
{
	struct counter_alarm_cfg alarm_cfg = {
		.callback = alarm_callback,
		.user_data = NULL,
		.flags = COUNTER_ALARM_CFG_ABSOLUTE | COUNTER_ALARM_CFG_EXPIRE_WHEN_LATE,
	};
	struct gpio_ioctl_configure out_cfg = {
		.flags = GPIO_OUTPUT_INACTIVE,
	};
	struct gpio_ioctl_configure in_cfg = {
		.flags = GPIO_INPUT,
	};
	struct gpio_ioctl_set set_high = {
		.value = 1,
	};
	struct counter_ioctl_get_value get_value = {
		.ticks = (uint32_t *)&measured_counter_tick,
	};
	struct counter_ioctl_set_alarm set_alarm = {
		.chan_id = ALARM_CHANNEL_ID,
		.alarm_cfg = &alarm_cfg,
	};
	struct counter_ioctl_us_to_ticks us_to_ticks = {
		.us = TEST_PERIOD_US,
	};
	struct counter_ioctl_get_frequency get_freq;
	uint32_t period_ticks;
	uint32_t counter_freq;
	uint32_t delta_cycles;
	uint32_t counter_jitter;
	int counter_fd;
	int loopback_out_fd;
	int loopback_in_fd;
	int ret;
	int err;

	loopback_out_fd = open("/dev/loopback_out", 0);
	if (loopback_out_fd < 0) {
		printk("open loopback_out failed: %d\n", errno);
		return 0;
	}

	loopback_in_fd = open("/dev/loopback_in", 0);
	if (loopback_in_fd < 0) {
		printk("open loopback_in failed: %d\n", errno);
		(void)close(loopback_out_fd);
		return 0;
	}

	counter_fd = open("/dev/counter0", 0);
	if (counter_fd < 0) {
		printk("open counter failed: %d\n", errno);
		(void)close(loopback_in_fd);
		(void)close(loopback_out_fd);
		return 0;
	}

	ret = ioctl(loopback_out_fd, GPIO_IOCTL_CONFIGURE, &out_cfg);
	if (ret < 0) {
		printk("Failed to configure output: %d\n", ret);
		goto out;
	}

	ret = ioctl(loopback_in_fd, GPIO_IOCTL_CONFIGURE, &in_cfg);
	if (ret < 0) {
		printk("Failed to configure input: %d\n", ret);
		goto out;
	}

	err = ioctl(counter_fd, COUNTER_IOCTL_US_TO_TICKS, &us_to_ticks);
	if (err < 0) {
		printk("counter_us_to_ticks failed: %d\n", err);
		goto out;
	}

	period_ticks = *us_to_ticks.ticks;
	if (period_ticks == 0U) {
		period_ticks = 1U;
	}

	k_sem_init(&sample_sem, 0, 1);

	err = ioctl(counter_fd, COUNTER_IOCTL_START);
	if (err < 0 && err != -EALREADY) {
		printk("counter_start failed: %d\n", err);
		goto out;
	}

	err = ioctl(counter_fd, COUNTER_IOCTL_GET_FREQUENCY, &get_freq);
	if (err < 0) {
		printk("counter_get_frequency failed: %d\n", err);
		goto out;
	}

	counter_freq = *get_freq.frequency;

	printk("PB1 one-shot loopback + timer ISR latency\n");
	printk("counter freq: %u Hz\n", counter_freq);
	printk("cpu cycles per sec: %u\n", sys_clock_hw_cycles_per_sec());
	printk("test period: %u us, counter ticks: %u\n", TEST_PERIOD_US, period_ticks);

	ret = ioctl(loopback_out_fd, GPIO_IOCTL_SET, &set_high);
	if (ret < 0) {
		printk("Failed to drive output: %d\n", ret);
		goto out;
	}

	k_msleep(1);

	ret = ioctl(loopback_in_fd, GPIO_IOCTL_GET);
	if (ret < 0) {
		printk("Failed to sample input: %d\n", ret);
		goto out;
	}

	printk("loopback drive=%d sample=%d %s\n",
	       set_high.value, ret, (ret == set_high.value) ? "PASS" : "FAIL");

	err = ioctl(counter_fd, COUNTER_IOCTL_GET_VALUE, &get_value);
	if (err < 0) {
		printk("counter_get_value failed: %d\n", err);
		goto out;
	}

	expected_counter_tick = measured_counter_tick + period_ticks;
	expected_cycle = k_cycle_get_32() + k_us_to_cyc_ceil32(TEST_PERIOD_US);
	sample_ready = 0U;
	alarm_cfg.ticks = expected_counter_tick;

	err = ioctl(counter_fd, COUNTER_IOCTL_SET_ALARM, &set_alarm);
	if (err < 0) {
		printk("counter_set_channel_alarm failed: %d\n", err);
		goto out;
	}

	k_sem_take(&sample_sem, K_FOREVER);
	if (!sample_ready) {
		printk("sample not ready\n");
		goto out;
	}

	delta_cycles = measured_cycle - expected_cycle;
	counter_jitter = measured_counter_tick - expected_counter_tick;

	printk("irq latency=%u cyc (%u ns) counter_jitter=%u\n",
	       delta_cycles,
	       cycles_to_ns_u32(delta_cycles),
	       counter_jitter);

out:
	(void)close(counter_fd);
	(void)close(loopback_in_fd);
	(void)close(loopback_out_fd);

	return 0;
}
```

## src/devfd.c
```c
#include "devfd.h"

#include <errno.h>
#include <stdarg.h>
#include <string.h>

#include <zephyr/device.h>
#include <zephyr/devicetree.h>
#include <zephyr/drivers/counter.h>
#include <zephyr/drivers/gpio.h>
#include <zephyr/sys/fdtable.h>

int zvfs_close(int fd);

#define TIMER_NODE DT_NODELABEL(timers2)
#define COUNTER_NODE DT_CHILD(TIMER_NODE, counter)
#define LOOPBACK_OUT_NODE DT_ALIAS(loopback_out)
#define LOOPBACK_IN_NODE  DT_ALIAS(loopback_in)

enum devfd_kind {
	DEVFD_KIND_GPIO,
	DEVFD_KIND_COUNTER,
};

struct devfd_obj {
	enum devfd_kind kind;
	union {
		struct gpio_dt_spec gpio;
		const struct device *counter;
	};
	bool in_use;
	int fd;
};

static int devfd_ioctl_vmeth(void *obj, unsigned int request, va_list args);
static int devfd_close_vmeth(void *obj);

static const struct fd_op_vtable devfd_vtable = {
	.read = NULL,
	.write = NULL,
	.close = devfd_close_vmeth,
	.ioctl = devfd_ioctl_vmeth,
};

static struct devfd_obj devfd_objs[3] = {
	{
		.kind = DEVFD_KIND_GPIO,
		.gpio = GPIO_DT_SPEC_GET(LOOPBACK_OUT_NODE, gpios),
	},
	{
		.kind = DEVFD_KIND_GPIO,
		.gpio = GPIO_DT_SPEC_GET(LOOPBACK_IN_NODE, gpios),
	},
	{
		.kind = DEVFD_KIND_COUNTER,
		.counter = DEVICE_DT_GET(COUNTER_NODE),
	},
};

static struct devfd_obj *devfd_find(const char *name)
{
	if (strcmp(name, "/dev/loopback_out") == 0) {
		return &devfd_objs[0];
	}

	if (strcmp(name, "/dev/loopback_in") == 0) {
		return &devfd_objs[1];
	}

	if (strcmp(name, "/dev/counter0") == 0) {
		return &devfd_objs[2];
	}

	errno = ENOENT;
	return NULL;
}

int dev_open(const char *name, int flags)
{
	struct devfd_obj *obj;
	int fd;

	ARG_UNUSED(flags);

	obj = devfd_find(name);
	if (obj == NULL) {
		return -1;
	}

	if (obj->in_use) {
		errno = EBUSY;
		return -1;
	}

	fd = zvfs_reserve_fd();
	if (fd < 0) {
		return -1;
	}

	obj->in_use = true;
	obj->fd = fd;
	zvfs_finalize_typed_fd(fd, obj, &devfd_vtable, ZVFS_MODE_IFCHR);

	return fd;
}

int dev_close(int fd)
{
	return zvfs_close(fd);
}

int dev_ioctl(int fd, unsigned long request, ...)
{
	struct devfd_obj *obj;
	va_list args;
	int ret;

	obj = zvfs_get_fd_obj(fd, &devfd_vtable, EBADF);
	if (obj == NULL) {
		return -1;
	}

	va_start(args, request);
	ret = devfd_ioctl_vmeth(obj, request, args);
	va_end(args);

	if (ret < 0) {
		errno = -ret;
		return -1;
	}

	return ret;
}

static int devfd_close_vmeth(void *obj)
{
	struct devfd_obj *devfd = obj;

	devfd->in_use = false;
	devfd->fd = -1;

	return 0;
}

static int devfd_gpio_ioctl(struct devfd_obj *obj, unsigned int request, va_list args)
{
	switch (request) {
	case GPIO_IOCTL_CONFIGURE: {
		const struct gpio_ioctl_configure *cfg = va_arg(args,
			const struct gpio_ioctl_configure *);

		return gpio_pin_configure_dt(&obj->gpio, cfg->flags);
	}

	case GPIO_IOCTL_SET: {
		const struct gpio_ioctl_set *set = va_arg(args,
			const struct gpio_ioctl_set *);

		return gpio_pin_set_dt(&obj->gpio, set->value);
	}

	case GPIO_IOCTL_GET:
		return gpio_pin_get_dt(&obj->gpio);

	default:
		return -EINVAL;
	}
}

static int devfd_counter_ioctl(struct devfd_obj *obj, unsigned int request, va_list args)
{
	switch (request) {
	case COUNTER_IOCTL_START:
		return counter_start(obj->counter);

	case COUNTER_IOCTL_GET_VALUE: {
		const struct counter_ioctl_get_value *get = va_arg(args,
			const struct counter_ioctl_get_value *);

		return counter_get_value(obj->counter, get->ticks);
	}

	case COUNTER_IOCTL_SET_ALARM: {
		const struct counter_ioctl_set_alarm *alarm = va_arg(args,
			const struct counter_ioctl_set_alarm *);

		return counter_set_channel_alarm(obj->counter, alarm->chan_id,
						 alarm->alarm_cfg);
	}

	case COUNTER_IOCTL_US_TO_TICKS: {
		const struct counter_ioctl_us_to_ticks *conv = va_arg(args,
			const struct counter_ioctl_us_to_ticks *);

		*conv->ticks = counter_us_to_ticks(obj->counter, conv->us);
		return 0;
	}

	case COUNTER_IOCTL_GET_FREQUENCY: {
		const struct counter_ioctl_get_frequency *freq = va_arg(args,
			const struct counter_ioctl_get_frequency *);

		*freq->frequency = counter_get_frequency(obj->counter);
		return 0;
	}

	default:
		return -EINVAL;
	}
}

static int devfd_ioctl_vmeth(void *obj, unsigned int request, va_list args)
{
	struct devfd_obj *devfd = obj;

	if (devfd->kind == DEVFD_KIND_GPIO) {
		return devfd_gpio_ioctl(devfd, request, args);
	}

	return devfd_counter_ioctl(devfd, request, args);
}
```

## src/devfd.h
```c
#ifndef DEVFD_H_
#define DEVFD_H_

#include <zephyr/drivers/counter.h>
#include <zephyr/drivers/gpio.h>

enum devfd_ioctl_request {
	GPIO_IOCTL_CONFIGURE = 0x1000,
	GPIO_IOCTL_SET,
	GPIO_IOCTL_GET,
	COUNTER_IOCTL_START = 0x2000,
	COUNTER_IOCTL_GET_VALUE,
	COUNTER_IOCTL_SET_ALARM,
	COUNTER_IOCTL_US_TO_TICKS,
	COUNTER_IOCTL_GET_FREQUENCY,
};

struct gpio_ioctl_configure {
	gpio_flags_t flags;
};

struct gpio_ioctl_set {
	int value;
};

struct counter_ioctl_get_value {
	uint32_t *ticks;
};

struct counter_ioctl_set_alarm {
	uint8_t chan_id;
	struct counter_alarm_cfg *alarm_cfg;
};

struct counter_ioctl_us_to_ticks {
	uint32_t us;
	uint32_t *ticks;
};

struct counter_ioctl_get_frequency {
	uint32_t *frequency;
};

int dev_open(const char *name, int flags);
int dev_close(int fd);
int dev_ioctl(int fd, unsigned long request, ...);

#endif
```
