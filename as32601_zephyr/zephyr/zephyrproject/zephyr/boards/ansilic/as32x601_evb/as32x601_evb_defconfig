## as32601_zephyr/zephyr/zephyrproject/zephyr/boards/ansilic/as32x601_evb/as32x601_evb_defconfig
```kconfig
CONFIG_SOC_AS32X601=y
CONFIG_GPIO=y
CONFIG_SERIAL=y
CONFIG_CONSOLE=y
CONFIG_UART_CONSOLE=y
CONFIG_PRINTK=y
```

## as32601_zephyr/zephyr/zephyrproject/zephyr/boards/ansilic/as32x601_evb/board.yml
```yaml
board:
  name: as32x601_evb
  full_name: Ansilic AS32X601 Evaluation Board
  vendor: ansilic
  socs:
    - name: as32x601
```

## as32601_zephyr/zephyr/zephyrproject/zephyr/boards/others/rocket_pi/rocket_pi_stm32f401xe_defconfig
```kconfig
CONFIG_GPIO=y
CONFIG_PINCTRL=y
CONFIG_SERIAL=y
CONFIG_CONSOLE=y
CONFIG_UART_CONSOLE=y
CONFIG_CLOCK_CONTROL=y
CONFIG_CLOCK_CONTROL_STM32_CUBE=y
CONFIG_GPIO_STM32=y
```

## as32601_zephyr/zephyr/zephyrproject/zephyr/drivers/interrupt_controller/Kconfig.as32x601_plic
```kconfig
# SPDX-License-Identifier: Apache-2.0

config AS32X601_PLIC
	bool "Ansilic AS32X601 PLIC"
	default y
	depends on DT_HAS_ANSILIC_AS32X601_PLIC_ENABLED
	help
	  AS32X601 custom PLIC with Zephyr interrupt-controller integration.
```

## as32601_zephyr/zephyr/zephyrproject/zephyr/drivers/serial/Kconfig.as32x601
```kconfig
# SPDX-License-Identifier: Apache-2.0

config UART_AS32X601
	bool "Ansilic AS32X601 UART driver"
	default y
	depends on SERIAL
	select SERIAL_HAS_DRIVER
	select PINCTRL
	help
	  Enable native UART driver for Ansilic AS32X601 USART instances.
```

## as32601_zephyr/zephyr/zephyrproject/zephyr/dts/bindings/counter/ansilic,as32x601-timer.yaml
```yaml
# Copyright (c) 2024 Ansilic Technology Co., Ltd
# SPDX-License-Identifier: Apache-2.0

description: Ansilic AS32X601 Timer peripheral used as counter

compatible: "ansilic,as32x601-timer"

include: [base.yaml]

properties:
  reg:
    required: true

  interrupts:
    required: true
```

## as32601_zephyr/zephyr/zephyrproject/zephyr/dts/bindings/gpio/ansilic,as32x601-gpio.yaml
```yaml
# SPDX-License-Identifier: Apache-2.0

description: Ansilic AS32X601 GPIO controller

compatible: "ansilic,as32x601-gpio"

include: [gpio-controller.yaml, base.yaml]

properties:
  reg:
    required: true

  interrupts:
    required: true

  interrupt-parent:
    required: true

  "#gpio-cells":
    const: 2

gpio-cells:
  - pin
  - flags
```

## as32601_zephyr/zephyr/zephyrproject/zephyr/dts/bindings/i2c/ansilic,as32x601-i2c.yaml
```yaml
description: Ansilic AS32X601 I2C controller

compatible: "ansilic,as32x601-i2c"

include: [i2c-controller.yaml, pinctrl-device.yaml]

properties:
  reg:
    required: true

  clock-frequency:
    type: int
    required: true
    description: Input clock frequency for the I2C controller in Hz

  interrupts:
    required: true
```

## as32601_zephyr/zephyr/zephyrproject/zephyr/dts/bindings/interrupt-controller/ansilic,as32x601-plic.yaml
```yaml
# SPDX-License-Identifier: Apache-2.0

description: Ansilic AS32X601 custom PLIC interrupt controller

compatible: "ansilic,as32x601-plic"

include: riscv,plic0.yaml

properties:
  riscv,ndev:
    type: int
    required: true
    description: Number of external interrupts supported
```

## as32601_zephyr/zephyr/zephyrproject/zephyr/dts/bindings/pinctrl/ansilic,as32x601-pinctrl.yaml
```yaml
# SPDX-License-Identifier: Apache-2.0

description: |
  Ansilic AS32X601 pin controller.

  All device pin configurations should be placed in child nodes of the
  `pinctrl` node. Each child node encodes a device state, and each state
  contains one or more groups with a `pinmux` array and shared pin properties.

compatible: "ansilic,as32x601-pinctrl"

include: base.yaml

child-binding:
  description: Definitions for an AS32X601 pinctrl state.
  child-binding:
    include:
      - name: pincfg-node.yaml
        property-allowlist:
          - bias-pull-up
          - bias-pull-down
          - drive-open-drain
          - drive-push-pull
          - output-high
          - output-low
          - input-enable
          - output-enable

    properties:
      pinmux:
        required: true
        type: array
        description: Encoded port/pin/alternate-function selection.
      slew-rate:
        type: int
        description: Encoded drive strength value.
```

## as32601_zephyr/zephyr/zephyrproject/zephyr/dts/bindings/serial/ansilic,as32x601-uart.yaml
```yaml
# SPDX-License-Identifier: Apache-2.0

description: Ansilic AS32X601 UART/USART controller

compatible: "ansilic,as32x601-uart"

include: [uart-controller.yaml, pinctrl-device.yaml, base.yaml]

properties:
  reg:
    required: true
  current-speed:
    type: int
    required: true
  interrupts:
    required: true
  interrupt-parent:
    required: true
  clock-frequency:
    type: int
```

## as32601_zephyr/zephyr/zephyrproject/zephyr/dts/bindings/spi/ansilic,as32x601-spi.yaml
```yaml
description: Ansilic AS32X601 SPI controller

compatible: "ansilic,as32x601-spi"

include: [spi-controller.yaml, pinctrl-device.yaml]

properties:
  reg:
    required: true

  clock-frequency:
    type: int
    required: true
    description: Input clock frequency for the SPI controller in Hz

  interrupts:
    required: true
```

## as32601_zephyr/zephyr/zephyrproject/zephyr/dts/bindings/spi/ti,adc128s102.yaml
```yaml
description: TI ADC128S102 8-channel 12-bit A/D converter

compatible: "ti,adc128s102"

include: spi-device.yaml
```

## as32601_zephyr/zephyr/zephyrproject/zephyr/soc/ansilic/as32x601/Kconfig.soc
```kconfig
# SPDX-License-Identifier: Apache-2.0

config SOC_SERIES_AS32X601
	bool
	select SOC_FAMILY_ANSILIC

config SOC_SERIES
	default "as32x601" if SOC_SERIES_AS32X601

rsource "Kconfig.soc.*"
```

## zephyr/boards/ansilic/as32x601_evb/Kconfig.as32x601_evb
```kconfig
# SPDX-License-Identifier: Apache-2.0

config BOARD_AS32X601_EVB
	bool
	select SOC_AS32X601
```

## zephyr/drivers/adc/Kconfig.as32x601
```kconfig
# SPDX-License-Identifier: Apache-2.0

config ADC_AS32X601
	bool "Ansilic AS32X601 ADC driver"
	default y
	depends on DT_HAS_ANSILIC_AS32X601_ADC_ENABLED
	help
	  Enable the ADC driver for the AS32X601 on-chip ADC controllers.
	  The driver exposes Zephyr's adc_driver_api and supports adc0 and
	  adc1 instances described by devicetree.
```

## zephyr/drivers/can/Kconfig.as32x601
```kconfig
# SPDX-License-Identifier: Apache-2.0

config CAN_AS32X601
	bool "Ansilic AS32X601 CANFD driver"
	default y
	depends on DT_HAS_ANSILIC_AS32X601_CANFD_ENABLED
	select CAN_FD_MODE
	help
	  Enable the CAN driver for the AS32X601 on-chip CANFD controllers.
	  The driver exposes Zephyr's can_driver_api and supports the
	  canfd0..canfd3 instances described by devicetree.
```

## zephyr/drivers/counter/Kconfig.as32x601_timer
```kconfig
# Copyright (c) 2024 Ansilic Technology Co., Ltd
# SPDX-License-Identifier: Apache-2.0

config COUNTER_AS32X601_TIMER
	bool "Ansilic AS32X601 Timer counter driver"
	default y
	depends on DT_HAS_ANSILIC_AS32X601_TIMER_ENABLED
	help
	  Enable counter driver for Ansilic AS32X601 TIM peripheral.
```

## zephyr/drivers/ethernet/Kconfig.as32x601
```kconfig
# AS32X601 Ethernet driver

# Copyright (c) 2026 Ansilic
# SPDX-License-Identifier: Apache-2.0

menuconfig ETH_AS32X601
	bool "Ansilic AS32X601 Ethernet driver"
	default y
	depends on DT_HAS_ANSILIC_AS32X601_ETH_ENABLED
	select PINCTRL
	help
	  Ethernet driver for Ansilic AS32X601 SoC.
	  Core10100 MAC with DP83867IR PHY (MDIO).
```

## zephyr/drivers/flash/Kconfig.as32x601
```kconfig
# SPDX-License-Identifier: Apache-2.0

config FLASH_AS32X601_QSPI
	bool "Ansilic AS32X601 QSPI NOR flash driver"
	default y
	depends on DT_HAS_ANSILIC_AS32X601_QSPI_NOR_ENABLED
	select FLASH_HAS_DRIVER_ENABLED
	select FLASH_HAS_PAGE_LAYOUT
	select PINCTRL
	help
	  Driver for the AS32X601 QSPI controller with an attached S25FL512S
	  NOR flash. Exposes Zephyr's flash_driver_api so file systems
	  (LittleFS, FCB, settings) can be mounted on it.
```

## zephyr/drivers/i2c/Kconfig.as32x601
```kconfig
# AS32X601 I2C driver

config I2C_AS32X601
	bool "AS32X601 I2C driver"
	default y
	depends on DT_HAS_ANSILIC_AS32X601_I2C_ENABLED
	help
	  Enable I2C driver for Ansilic AS32X601 SoC.
```

## zephyr/drivers/spi/Kconfig.as32x601
```kconfig
# AS32X601 SPI driver

config SPI_AS32X601
	bool "AS32X601 SPI driver"
	default y
	depends on DT_HAS_ANSILIC_AS32X601_SPI_ENABLED
	help
	  Enable SPI driver for Ansilic AS32X601 SoC.
```
